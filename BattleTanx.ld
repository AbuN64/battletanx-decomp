/* generated from config.toml; do not edit */
OUTPUT_ARCH(mips)
SECTIONS
{
    .retained_0 0x00000000 : AT(0x0) SUBALIGN(1)
    {
        assets/retained_0.bin.o(.data);
    }
    .span_1000 0x80071000 : AT(0x1000) SUBALIGN(1)
    {
        src/span_1000/80071000.c.o(.data.D_80071000);
        . = MAX(., 0x40);
        . = ALIGN(8) /* src/game/sys_80076000/code_800768E4.c.o */;
        src/game/sys_80076000/code_800768E4.c.o(.rodata .rdata);
        . = MAX(., 0x68);
        src/game/sys_80076000/code_800768E4.c.o(.data.D_80071068);
        . = MAX(., 0x70);
        src/span_1000/80071070.c.o(.rodata.D_80071070 .rdata.D_80071070);
        . = MAX(., 0x74);
        src/span_1000/80071070.c.o(.data.D_80071074);
        . = MAX(., 0x84);
        src/span_1000/80071084.c.o(.rodata.D_80071084 .rdata.D_80071084);
        . = MAX(., 0x8C);
        src/span_1000/80071084.c.o(.data.D_8007108C);
        . = MAX(., 0x98);
        src/span_1000/80071098.c.o(.rodata.D_80071098 .rdata.D_80071098);
        . = MAX(., 0xB4);
        src/span_1000/80071098.c.o(.rodata.D_800710B4 .rdata.D_800710B4);
        . = MAX(., 0xB8);
        src/span_1000/80071098.c.o(.rodata.D_800710B8 .rdata.D_800710B8);
        . = MAX(., 0xC0);
        . = ALIGN(8) /* src/game/sys_80076000/code_80078F60.c.o */;
        src/game/sys_80076000/code_80078F60.c.o(.rodata .rdata);
        . = MAX(., 0xD4);
        src/game/sys_80076000/code_80078F60.c.o(.data.D_800710D4);
        . = MAX(., 0xE0);
        src/span_1000/800710E0.c.o(.rodata.D_800710E0 .rdata.D_800710E0);
        . = MAX(., 0xE4);
        src/span_1000/800710E0.c.o(.data.D_800710E4);
        . = MAX(., 0xE8);
        src/span_1000/800710E8.c.o(.rodata.D_800710E8 .rdata.D_800710E8);
        . = MAX(., 0xF0);
        src/span_1000/800710E8.c.o(.rodata.D_800710F0 .rdata.D_800710F0);
        . = MAX(., 0xF4);
        src/game/sys_80076000/code_8007AD2C.c.o(.rodata .rdata);
        . = MAX(., 0xFC);
        src/game/sys_80076000/code_8007AD2C.c.o(.rodata.D_800710FC .rdata.D_800710FC);
        . = MAX(., 0x100);
        src/game/sys_80076000/code_8007AD2C.c.o(.rodata.D_80071100 .rdata.D_80071100);
        . = MAX(., 0x104);
        src/game/sys_80076000/code_8007AD2C.c.o(.data.D_80071104);
        . = MAX(., 0x138);
        src/span_1000/80071138.c.o(.rodata.D_80071138 .rdata.D_80071138);
        . = MAX(., 0x150);
        src/span_1000/80071138.c.o(.rodata.D_80071150 .rdata.D_80071150);
        . = MAX(., 0x16C);
        src/span_1000/80071138.c.o(.rodata.D_8007116C .rdata.D_8007116C);
        . = MAX(., 0x174);
        src/span_1000/80071138.c.o(.data.D_80071174);
        . = MAX(., 0x178);
        src/span_1000/80071178.c.o(.rodata.D_80071178 .rdata.D_80071178);
        . = MAX(., 0x1C8);
        . = ALIGN(8) /* src/game/sys_80076000/code_8007C58C.c.o */;
        src/game/sys_80076000/code_8007C58C.c.o(.rodata .rdata);
        . = MAX(., 0x1DC);
        src/game/sys_80076000/code_8007C58C.c.o(.rodata.D_800711DC .rdata.D_800711DC);
        . = MAX(., 0x1E8);
        src/game/sys_80076000/code_8007C58C.c.o(.rodata.D_800711E8 .rdata.D_800711E8);
        . = MAX(., 0x1F4);
        src/game/sys_80076000/code_8007C58C.c.o(.rodata.D_800711F4 .rdata.D_800711F4);
        . = MAX(., 0x204);
        src/game/sys_80076000/code_8007C58C.c.o(.rodata.D_80071204 .rdata.D_80071204);
        . = MAX(., 0x228);
        src/game/sys_80076000/code_8007C58C.c.o(.rodata.D_80071228 .rdata.D_80071228);
        . = MAX(., 0x24C);
        src/game/sys_80076000/code_8007C58C.c.o(.rodata.D_8007124C .rdata.D_8007124C);
        . = MAX(., 0x25C);
        src/game/sys_80076000/code_8007C58C.c.o(.rodata.D_8007125C .rdata.D_8007125C);
        . = MAX(., 0x274);
        src/game/sys_80076000/code_8007C58C.c.o(.rodata.D_80071274 .rdata.D_80071274);
        . = MAX(., 0x2AC);
        src/game/sys_80076000/code_8007C58C.c.o(.rodata.D_800712AC .rdata.D_800712AC);
        . = MAX(., 0x2D0);
        src/game/sys_80076000/code_8007C58C.c.o(.rodata.D_800712D0 .rdata.D_800712D0);
        . = MAX(., 0x2F8);
        src/game/sys_80076000/code_8007C58C.c.o(.rodata.D_800712F8 .rdata.D_800712F8);
        . = MAX(., 0x340);
        src/game/sys_80076000/code_8007C58C.c.o(.rodata.D_80071340 .rdata.D_80071340);
        . = MAX(., 0x348);
        src/game/sys_80076000/code_8007C58C.c.o(.rodata.D_80071348 .rdata.D_80071348);
        . = MAX(., 0x350);
        src/game/sys_80076000/code_8007C58C.c.o(.rodata.D_80071350 .rdata.D_80071350);
        . = MAX(., 0x378);
        . = ALIGN(8) /* src/game/sys_80076000/code_8007D2A0.c.o */;
        src/game/sys_80076000/code_8007D2A0.c.o(.rodata .rdata);
        . = MAX(., 0x3C8);
        src/game/sys_80076000/code_8007D2A0.c.o(.data.D_800713C8);
        . = MAX(., 0x3D0);
        src/span_1000/800713D0.c.o(.rodata.D_800713D0 .rdata.D_800713D0);
        . = MAX(., 0x3E0);
        src/span_1000/800713D0.c.o(.rodata.D_800713E0 .rdata.D_800713E0);
        . = MAX(., 0x404);
        src/span_1000/800713D0.c.o(.rodata.D_80071404 .rdata.D_80071404);
        . = MAX(., 0x45C);
        src/span_1000/800713D0.c.o(.data.D_8007145C);
        . = MAX(., 0x460);
        src/span_1000/80071460.c.o(.rodata.D_80071460 .rdata.D_80071460);
        . = MAX(., 0x488);
        src/span_1000/80071460.c.o(.data.D_80071488);
        . = MAX(., 0x490);
        src/span_1000/80071490.c.o(.rodata.D_80071490 .rdata.D_80071490);
        . = MAX(., 0x4A0);
        src/span_1000/80071490.c.o(.rodata.D_800714A0 .rdata.D_800714A0);
        . = MAX(., 0x4A4);
        src/span_1000/80071490.c.o(.data.D_800714A4);
        . = MAX(., 0x4A8);
        src/span_1000/80071490.c.o(.data.D_800714A8);
        . = MAX(., 0x4AC);
        src/span_1000/80071490.c.o(.rodata.D_800714AC .rdata.D_800714AC);
        . = MAX(., 0x4B4);
        src/span_1000/80071490.c.o(.rodata.D_800714B4 .rdata.D_800714B4);
        . = MAX(., 0x4C4);
        src/span_1000/80071490.c.o(.rodata.D_800714C4 .rdata.D_800714C4);
        . = MAX(., 0x4D4);
        src/span_1000/80071490.c.o(.rodata.D_800714D4 .rdata.D_800714D4);
        . = MAX(., 0x4D8);
        . = ALIGN(8) /* src/game/sys_80076000/code_80083394.c.o */;
        src/game/sys_80076000/code_80083394.c.o(.rodata .rdata);
        . = MAX(., 0x4E8);
        src/game/sys_80076000/code_80083394.c.o(.data.D_800714E8);
        . = MAX(., 0x518);
        src/span_1000/80071518.c.o(.rodata.D_80071518 .rdata.D_80071518);
        . = MAX(., 0x520);
        src/span_1000/80071518.c.o(.rodata.D_80071520 .rdata.D_80071520);
        . = MAX(., 0x534);
        src/span_1000/80071518.c.o(.data.D_80071534);
        . = MAX(., 0x538);
        src/span_1000/80071538.c.o(.rodata.D_80071538 .rdata.D_80071538);
        . = MAX(., 0x554);
        src/span_1000/80071538.c.o(.data.D_80071554);
        . = MAX(., 0x560);
        src/span_1000/80071560.c.o(.rodata.D_80071560 .rdata.D_80071560);
        . = MAX(., 0x564);
        src/span_1000/80071560.c.o(.rodata.D_80071564 .rdata.D_80071564);
        . = MAX(., 0x568);
        . = ALIGN(8) /* src/game/sys_80076000/code_800863F4.c.o */;
        src/game/sys_80076000/code_800863F4.c.o(.rodata .rdata);
        . = MAX(., 0x6D8);
        src/game/sys_80076000/code_800863F4.c.o(.data.D_800716D8);
        . = MAX(., 0x6E0);
        . = ALIGN(8) /* src/game/sys_80076000/code_80086B48.c.o */;
        src/game/sys_80076000/code_80086B48.c.o(.rodata .rdata);
        . = MAX(., 0x6F8);
        src/game/sys_80076000/code_80086B48.c.o(.rodata.D_800716F8 .rdata.D_800716F8);
        . = MAX(., 0x6FC);
        src/game/sys_80076000/code_80086B48.c.o(.data.D_800716FC);
        . = MAX(., 0x700);
        src/game/sys_80076000/code_80086B48.c.o(.rodata.D_80071700 .rdata.D_80071700);
        . = MAX(., 0x708);
        . = ALIGN(8) /* src/game/sys_80076000/code_80088590.c.o */;
        src/game/sys_80076000/code_80088590.c.o(.rodata .rdata);
        . = MAX(., 0x764);
        src/game/sys_80076000/code_80088590.c.o(.data.D_80071764);
        . = MAX(., 0x768);
        src/span_1000/80071768.c.o(.rodata.D_80071768 .rdata.D_80071768);
        . = MAX(., 0x804);
        src/span_1000/80071768.c.o(.data.D_80071804);
        . = MAX(., 0x838);
        src/span_1000/80071838.c.o(.rodata.D_80071838 .rdata.D_80071838);
        . = MAX(., 0x864);
        src/span_1000/80071838.c.o(.data.D_80071864);
        . = MAX(., 0x894);
        src/span_1000/80071894.c.o(.rodata.D_80071894 .rdata.D_80071894);
        . = MAX(., 0x954);
        src/span_1000/80071894.c.o(.data.D_80071954);
        . = MAX(., 0x960);
        . = ALIGN(8) /* src/game/sys_80076000/code_8008ADE0.c.o */;
        src/game/sys_80076000/code_8008ADE0.c.o(.rodata .rdata);
        . = MAX(., 0x9E4);
        src/game/sys_80076000/code_8008ADE0.c.o(.data.D_800719E4);
        . = MAX(., 0x9E8);
        src/span_1000/800719E8.c.o(.rodata.D_800719E8 .rdata.D_800719E8);
        . = MAX(., 0xA6C);
        src/span_1000/800719E8.c.o(.data.D_80071A6C);
        . = MAX(., 0xA70);
        src/span_1000/80071A70.c.o(.rodata.D_80071A70 .rdata.D_80071A70);
        . = MAX(., 0xA74);
        src/span_1000/80071A70.c.o(.rodata.D_80071A74 .rdata.D_80071A74);
        . = MAX(., 0xA94);
        src/span_1000/80071A70.c.o(.data.D_80071A94);
        . = MAX(., 0xA98);
        src/span_1000/80071A98.c.o(.rodata.D_80071A98 .rdata.D_80071A98);
        . = MAX(., 0xAA0);
        src/span_1000/80071A98.c.o(.data.D_80071AA0);
        . = MAX(., 0xB00);
        src/span_1000/80071B00.c.o(.rodata.D_80071B00 .rdata.D_80071B00);
        . = MAX(., 0xB10);
        src/span_1000/80071B00.c.o(.data.D_80071B10);
        . = MAX(., 0xB54);
        src/span_1000/80071B54.c.o(.rodata.D_80071B54 .rdata.D_80071B54);
        . = MAX(., 0xB68);
        src/span_1000/80071B54.c.o(.rodata.D_80071B68 .rdata.D_80071B68);
        . = MAX(., 0xB6C);
        src/span_1000/80071B54.c.o(.data.D_80071B6C);
        . = MAX(., 0xBAC);
        src/span_1000/80071BAC.c.o(.rodata.D_80071BAC .rdata.D_80071BAC);
        . = MAX(., 0xBB0);
        src/span_1000/80071BAC.c.o(.data.D_80071BB0);
        . = MAX(., 0xBB4);
        src/span_1000/80071BAC.c.o(.rodata.D_80071BB4 .rdata.D_80071BB4);
        . = MAX(., 0xBC0);
        src/span_1000/80071BAC.c.o(.rodata.D_80071BC0 .rdata.D_80071BC0);
        . = MAX(., 0xBCC);
        src/span_1000/80071BAC.c.o(.data.D_80071BCC);
        . = MAX(., 0xBD0);
        src/span_1000/80071BD0.c.o(.rodata.D_80071BD0 .rdata.D_80071BD0);
        . = MAX(., 0xBE0);
        src/span_1000/80071BD0.c.o(.rodata.D_80071BE0 .rdata.D_80071BE0);
        . = MAX(., 0xBE4);
        src/span_1000/80071BD0.c.o(.data.D_80071BE4);
        . = MAX(., 0xBE8);
        src/span_1000/80071BE8.c.o(.rodata.D_80071BE8 .rdata.D_80071BE8);
        . = MAX(., 0xC04);
        src/span_1000/80071BE8.c.o(.data.D_80071C04);
        . = MAX(., 0xC48);
        src/span_1000/80071C48.c.o(.rodata.D_80071C48 .rdata.D_80071C48);
        . = MAX(., 0xC50);
        . = ALIGN(8) /* src/game/sys_80076000/code_8008F040.c.o */;
        src/game/sys_80076000/code_8008F040.c.o(.rodata .rdata);
        . = MAX(., 0xC58);
        src/game/sys_80076000/code_8008F040.c.o(.rodata.D_80071C58 .rdata.D_80071C58);
        . = MAX(., 0xC64);
        src/game/sys_80076000/code_8008F040.c.o(.rodata.D_80071C64 .rdata.D_80071C64);
        . = MAX(., 0xC68);
        src/game/sys_80076000/code_8008F040.c.o(.rodata.D_80071C68 .rdata.D_80071C68);
        . = MAX(., 0xC6C);
        src/game/sys_80076000/code_8008F040.c.o(.rodata.D_80071C6C .rdata.D_80071C6C);
        . = MAX(., 0xC70);
        src/game/sys_80076000/code_8008F040.c.o(.data.D_80071C70);
        . = MAX(., 0xC7C);
        src/span_1000/80071C7C.c.o(.rodata.D_80071C7C .rdata.D_80071C7C);
        . = MAX(., 0xC80);
        src/span_1000/80071C7C.c.o(.data.D_80071C80);
        . = MAX(., 0xCC0);
        src/span_1000/80071CC0.c.o(.rodata.D_80071CC0 .rdata.D_80071CC0);
        . = MAX(., 0xCDC);
        src/span_1000/80071CC0.c.o(.rodata.D_80071CDC .rdata.D_80071CDC);
        . = MAX(., 0xCE0);
        src/span_1000/80071CC0.c.o(.rodata.D_80071CE0 .rdata.D_80071CE0);
        . = MAX(., 0xCE8);
        src/span_1000/80071CC0.c.o(.rodata.D_80071CE8 .rdata.D_80071CE8);
        . = MAX(., 0xCEC);
        src/span_1000/80071CC0.c.o(.rodata.D_80071CEC .rdata.D_80071CEC);
        . = MAX(., 0xCF0);
        src/span_1000/80071CC0.c.o(.rodata.D_80071CF0 .rdata.D_80071CF0);
        . = MAX(., 0xCF4);
        src/span_1000/80071CC0.c.o(.data.D_80071CF4);
        . = MAX(., 0xCF8);
        src/span_1000/80071CF8.c.o(.rodata.D_80071CF8 .rdata.D_80071CF8);
        . = MAX(., 0xD84);
        src/span_1000/80071CF8.c.o(.data.D_80071D84);
        . = MAX(., 0xD88);
        src/span_1000/80071D88.c.o(.rodata.D_80071D88 .rdata.D_80071D88);
        . = MAX(., 0xE14);
        src/span_1000/80071D88.c.o(.data.D_80071E14);
        . = MAX(., 0xE64);
        src/span_1000/80071D88.c.o(.data.D_80071E64);
        . = MAX(., 0xE90);
        src/span_1000/80071E90.c.o(.rodata.D_80071E90 .rdata.D_80071E90);
        . = MAX(., 0xE94);
        src/span_1000/80071E90.c.o(.rodata.D_80071E94 .rdata.D_80071E94);
        . = MAX(., 0xE9C);
        src/span_1000/80071E90.c.o(.rodata.D_80071E9C .rdata.D_80071E9C);
        . = MAX(., 0xEA0);
        src/span_1000/80071E90.c.o(.rodata.D_80071EA0 .rdata.D_80071EA0);
        . = MAX(., 0xEA4);
        src/span_1000/80071E90.c.o(.data.D_80071EA4);
        . = MAX(., 0xEA8);
        src/span_1000/80071EA8.c.o(.rodata.D_80071EA8 .rdata.D_80071EA8);
        . = MAX(., 0xEC0);
        src/span_1000/80071EA8.c.o(.rodata.D_80071EC0 .rdata.D_80071EC0);
        . = MAX(., 0xF4C);
        src/span_1000/80071EA8.c.o(.data.D_80071F4C);
        . = MAX(., 0xF50);
        src/span_1000/80071F50.c.o(.rodata.D_80071F50 .rdata.D_80071F50);
        . = MAX(., 0x1004);
        src/span_1000/80071F50.c.o(.data.D_80072004);
        . = MAX(., 0x1008);
        src/span_1000/80072008.c.o(.rodata.D_80072008 .rdata.D_80072008);
        . = MAX(., 0x1018);
        src/span_1000/80072008.c.o(.data.D_80072018);
        . = MAX(., 0x1020);
        src/span_1000/80072020.c.o(.rodata.D_80072020 .rdata.D_80072020);
        . = MAX(., 0x1028);
        src/span_1000/80072020.c.o(.data.D_80072028);
        . = MAX(., 0x1030);
        . = ALIGN(8) /* src/game/sys_80076000/code_800942A8.c.o */;
        src/game/sys_80076000/code_800942A8.c.o(.rodata .rdata);
        . = MAX(., 0x1034);
        src/game/sys_80076000/code_800942A8.c.o(.data.D_80072034);
        . = MAX(., 0x1038);
        . = ALIGN(8) /* src/game/sys_80076000/code_80094C58.c.o */;
        src/game/sys_80076000/code_80094C58.c.o(.rodata .rdata);
        . = MAX(., 0x10EC);
        src/game/sys_80076000/code_80094C58.c.o(.data.D_800720EC);
        . = MAX(., 0x10F0);
        src/span_1000/800720F0.c.o(.rodata.D_800720F0 .rdata.D_800720F0);
        . = MAX(., 0x1118);
        src/span_1000/800720F0.c.o(.data.D_80072118);
        . = MAX(., 0x1120);
        src/span_1000/80072120.c.o(.rodata.D_80072120 .rdata.D_80072120);
        . = MAX(., 0x1124);
        src/span_1000/80072120.c.o(.data.D_80072124);
        . = MAX(., 0x1128);
        src/span_1000/80072120.c.o(.data.D_80072128);
        . = MAX(., 0x112C);
        src/span_1000/80072120.c.o(.data.D_8007212C);
        . = MAX(., 0x1130);
        src/span_1000/80072120.c.o(.data.D_80072130);
        . = MAX(., 0x1134);
        src/span_1000/80072120.c.o(.data.D_80072134);
        . = MAX(., 0x1138);
        src/span_1000/80072120.c.o(.data.D_80072138);
        . = MAX(., 0x113C);
        src/span_1000/80072120.c.o(.data.D_8007213C);
        . = MAX(., 0x1140);
        src/span_1000/80072120.c.o(.data.D_80072140);
        . = MAX(., 0x1144);
        src/span_1000/80072120.c.o(.data.D_80072144);
        . = MAX(., 0x1148);
        src/span_1000/80072120.c.o(.data.D_80072148);
        . = MAX(., 0x114C);
        src/span_1000/80072120.c.o(.data.D_8007214C);
        . = MAX(., 0x1150);
        src/span_1000/80072150.c.o(.rodata.D_80072150 .rdata.D_80072150);
        . = MAX(., 0x118C);
        src/span_1000/80072150.c.o(.data.D_8007218C);
        . = MAX(., 0x1190);
        src/span_1000/80072190.c.o(.rodata.D_80072190 .rdata.D_80072190);
        . = MAX(., 0x11A4);
        src/span_1000/80072190.c.o(.data.D_800721A4);
        . = MAX(., 0x11A8);
        src/span_1000/800721A8.c.o(.rodata.D_800721A8 .rdata.D_800721A8);
        . = MAX(., 0x11D0);
        src/span_1000/800721A8.c.o(.rodata.D_800721D0 .rdata.D_800721D0);
        . = MAX(., 0x11E0);
        src/span_1000/800721A8.c.o(.rodata.D_800721E0 .rdata.D_800721E0);
        . = MAX(., 0x11F8);
        src/span_1000/800721A8.c.o(.rodata.D_800721F8 .rdata.D_800721F8);
        . = MAX(., 0x1204);
        src/span_1000/800721A8.c.o(.rodata.D_80072204 .rdata.D_80072204);
        . = MAX(., 0x1214);
        src/span_1000/800721A8.c.o(.rodata.D_80072214 .rdata.D_80072214);
        . = MAX(., 0x122C);
        src/span_1000/800721A8.c.o(.rodata.D_8007222C .rdata.D_8007222C);
        . = MAX(., 0x1238);
        src/span_1000/800721A8.c.o(.data.D_80072238);
        . = MAX(., 0x1248);
        src/span_1000/80072248.c.o(.rodata.D_80072248 .rdata.D_80072248);
        . = MAX(., 0x1294);
        src/span_1000/80072248.c.o(.data.D_80072294);
        . = MAX(., 0x1298);
        src/span_1000/80072298.c.o(.rodata.D_80072298 .rdata.D_80072298);
        . = MAX(., 0x12B4);
        src/span_1000/80072298.c.o(.data.D_800722B4);
        . = MAX(., 0x12B8);
        src/span_1000/800722B8.c.o(.rodata.D_800722B8 .rdata.D_800722B8);
        . = MAX(., 0x12F4);
        src/span_1000/800722B8.c.o(.data.D_800722F4);
        . = MAX(., 0x12F8);
        src/span_1000/800722F8.c.o(.rodata.D_800722F8 .rdata.D_800722F8);
        . = MAX(., 0x1374);
        src/span_1000/800722F8.c.o(.data.D_80072374);
        . = MAX(., 0x1378);
        src/span_1000/80072378.c.o(.rodata.D_80072378 .rdata.D_80072378);
        . = MAX(., 0x13AC);
        src/span_1000/80072378.c.o(.data.D_800723AC);
        . = MAX(., 0x13B0);
        src/span_1000/800723B0.c.o(.rodata.D_800723B0 .rdata.D_800723B0);
        . = MAX(., 0x13C0);
        src/span_1000/800723B0.c.o(.rodata.D_800723C0 .rdata.D_800723C0);
        . = MAX(., 0x1418);
        src/span_1000/800723B0.c.o(.rodata.D_80072418 .rdata.D_80072418);
        . = MAX(., 0x1498);
        src/span_1000/800723B0.c.o(.data.D_80072498);
        . = MAX(., 0x14A8);
        src/span_1000/800724A8.c.o(.rodata.D_800724A8 .rdata.D_800724A8);
        . = MAX(., 0x14C4);
        src/span_1000/800724A8.c.o(.data.D_800724C4);
        . = MAX(., 0x14C8);
        src/span_1000/800724C8.c.o(.rodata.D_800724C8 .rdata.D_800724C8);
        . = MAX(., 0x1524);
        src/span_1000/800724C8.c.o(.data.D_80072524);
        . = MAX(., 0x1528);
        src/span_1000/80072528.c.o(.rodata.D_80072528 .rdata.D_80072528);
        . = MAX(., 0x153C);
        src/span_1000/80072528.c.o(.data.D_8007253C);
        . = MAX(., 0x1540);
        src/span_1000/80072540.c.o(.rodata.D_80072540 .rdata.D_80072540);
        . = MAX(., 0x157C);
        src/span_1000/80072540.c.o(.data.D_8007257C);
        . = MAX(., 0x1580);
        src/span_1000/80072580.c.o(.rodata.D_80072580 .rdata.D_80072580);
        . = MAX(., 0x15B4);
        src/span_1000/80072580.c.o(.data.D_800725B4);
        . = MAX(., 0x15B8);
        src/span_1000/800725B8.c.o(.rodata.D_800725B8 .rdata.D_800725B8);
        . = MAX(., 0x15C4);
        src/span_1000/800725B8.c.o(.data.D_800725C4);
        . = MAX(., 0x15C8);
        src/span_1000/800725C8.c.o(.rodata.D_800725C8 .rdata.D_800725C8);
        . = MAX(., 0x162C);
        src/span_1000/800725C8.c.o(.data.D_8007262C);
        . = MAX(., 0x1630);
        src/span_1000/80072630.c.o(.rodata.D_80072630 .rdata.D_80072630);
        . = MAX(., 0x1640);
        src/span_1000/80072630.c.o(.rodata.D_80072640 .rdata.D_80072640);
        . = MAX(., 0x1674);
        src/span_1000/80072630.c.o(.data.D_80072674);
        . = MAX(., 0x1678);
        src/span_1000/80072678.c.o(.rodata.D_80072678 .rdata.D_80072678);
        . = MAX(., 0x1694);
        src/span_1000/80072678.c.o(.data.D_80072694);
        . = MAX(., 0x1698);
        src/span_1000/80072698.c.o(.rodata.D_80072698 .rdata.D_80072698);
        . = MAX(., 0x16FC);
        src/span_1000/80072698.c.o(.data.D_800726FC);
        . = MAX(., 0x1700);
        src/span_1000/80072700.c.o(.rodata.D_80072700 .rdata.D_80072700);
        . = MAX(., 0x1710);
        src/span_1000/80072700.c.o(.rodata.D_80072710 .rdata.D_80072710);
        . = MAX(., 0x173C);
        src/span_1000/80072700.c.o(.rodata.D_8007273C .rdata.D_8007273C);
        . = MAX(., 0x177C);
        src/span_1000/80072700.c.o(.data.D_8007277C);
        . = MAX(., 0x1780);
        src/span_1000/80072780.c.o(.rodata.D_80072780 .rdata.D_80072780);
        . = MAX(., 0x1800);
        src/span_1000/80072780.c.o(.data.D_80072800);
        . = MAX(., 0x1884);
        src/span_1000/80072884.c.o(.rodata.D_80072884 .rdata.D_80072884);
        . = MAX(., 0x18AC);
        src/span_1000/80072884.c.o(.data.D_800728AC);
        . = MAX(., 0x18B0);
        src/span_1000/800728B0.c.o(.rodata.D_800728B0 .rdata.D_800728B0);
        . = MAX(., 0x1904);
        src/span_1000/800728B0.c.o(.data.D_80072904);
        . = MAX(., 0x1908);
        src/span_1000/80072908.c.o(.rodata.D_80072908 .rdata.D_80072908);
        . = MAX(., 0x1980);
        src/span_1000/80072908.c.o(.rodata.D_80072980 .rdata.D_80072980);
        . = MAX(., 0x1988);
        src/span_1000/80072908.c.o(.rodata.D_80072988 .rdata.D_80072988);
        . = MAX(., 0x1A40);
        src/span_1000/80072908.c.o(.rodata.D_80072A40 .rdata.D_80072A40);
        . = MAX(., 0x1A44);
        src/span_1000/80072908.c.o(.data.D_80072A44);
        . = MAX(., 0x1A48);
        src/span_1000/80072A48.c.o(.rodata.D_80072A48 .rdata.D_80072A48);
        . = MAX(., 0x1A68);
        src/span_1000/80072A48.c.o(.rodata.D_80072A68 .rdata.D_80072A68);
        . = MAX(., 0x1A7C);
        src/span_1000/80072A48.c.o(.data.D_80072A7C);
        . = MAX(., 0x1A80);
        src/span_1000/80072A80.c.o(.rodata.D_80072A80 .rdata.D_80072A80);
        . = MAX(., 0x1A88);
        src/span_1000/80072A80.c.o(.rodata.D_80072A88 .rdata.D_80072A88);
        . = MAX(., 0x1A8C);
        src/span_1000/80072A80.c.o(.data.D_80072A8C);
        . = MAX(., 0x1A90);
        src/span_1000/80072A90.c.o(.rodata.D_80072A90 .rdata.D_80072A90);
        . = MAX(., 0x1AD0);
        src/span_1000/80072A90.c.o(.rodata.D_80072AD0 .rdata.D_80072AD0);
        . = MAX(., 0x1AD4);
        src/span_1000/80072A90.c.o(.rodata.D_80072AD4 .rdata.D_80072AD4);
        . = MAX(., 0x1ADC);
        src/span_1000/80072A90.c.o(.data.D_80072ADC);
        . = MAX(., 0x1B24);
        src/span_1000/80072B24.c.o(.rodata.D_80072B24 .rdata.D_80072B24);
        . = MAX(., 0x1B28);
        src/span_1000/80072B24.c.o(.rodata.D_80072B28 .rdata.D_80072B28);
        . = MAX(., 0x1BDC);
        src/span_1000/80072B24.c.o(.data.D_80072BDC);
        . = MAX(., 0x1C78);
        src/span_1000/80072C78.c.o(.rodata.D_80072C78 .rdata.D_80072C78);
        . = MAX(., 0x1C80);
        src/span_1000/80072C78.c.o(.rodata.D_80072C80 .rdata.D_80072C80);
        . = MAX(., 0x1C84);
        src/span_1000/80072C78.c.o(.rodata.D_80072C84 .rdata.D_80072C84);
        . = MAX(., 0x1C88);
        src/span_1000/80072C78.c.o(.rodata.D_80072C88 .rdata.D_80072C88);
        . = MAX(., 0x1C94);
        src/span_1000/80072C78.c.o(.rodata.D_80072C94 .rdata.D_80072C94);
        . = MAX(., 0x1CCC);
        src/span_1000/80072C78.c.o(.data.D_80072CCC);
        . = MAX(., 0x1CD0);
        src/span_1000/80072CD0.c.o(.rodata.D_80072CD0 .rdata.D_80072CD0);
        . = MAX(., 0x1CD4);
        src/span_1000/80072CD0.c.o(.data.D_80072CD4);
        . = MAX(., 0x1CD8);
        src/span_1000/80072CD8.c.o(.rodata.D_80072CD8 .rdata.D_80072CD8);
        . = MAX(., 0x1D88);
        src/span_1000/80072CD8.c.o(.rodata.D_80072D88 .rdata.D_80072D88);
        . = MAX(., 0x1D94);
        src/span_1000/80072CD8.c.o(.rodata.D_80072D94 .rdata.D_80072D94);
        . = MAX(., 0x1D98);
        src/span_1000/80072CD8.c.o(.data.D_80072D98);
        . = MAX(., 0x1DA0);
        src/span_1000/80072DA0.c.o(.rodata.D_80072DA0 .rdata.D_80072DA0);
        . = MAX(., 0x1DD0);
        src/span_1000/80072DA0.c.o(.rodata.D_80072DD0 .rdata.D_80072DD0);
        . = MAX(., 0x1DDC);
        src/span_1000/80072DA0.c.o(.rodata.D_80072DDC .rdata.D_80072DDC);
        . = MAX(., 0x1DE4);
        src/span_1000/80072DA0.c.o(.rodata.D_80072DE4 .rdata.D_80072DE4);
        . = MAX(., 0x1DE8);
        src/span_1000/80072DA0.c.o(.rodata.D_80072DE8 .rdata.D_80072DE8);
        . = MAX(., 0x1DEC);
        src/span_1000/80072DA0.c.o(.rodata.D_80072DEC .rdata.D_80072DEC);
        . = MAX(., 0x1DF0);
        src/span_1000/80072DA0.c.o(.rodata.D_80072DF0 .rdata.D_80072DF0);
        . = MAX(., 0x1DF8);
        src/span_1000/80072DA0.c.o(.rodata.D_80072DF8 .rdata.D_80072DF8);
        . = MAX(., 0x1DFC);
        src/span_1000/80072DA0.c.o(.rodata.D_80072DFC .rdata.D_80072DFC);
        . = MAX(., 0x1E08);
        src/span_1000/80072DA0.c.o(.rodata.D_80072E08 .rdata.D_80072E08);
        . = MAX(., 0x1E14);
        src/span_1000/80072DA0.c.o(.rodata.D_80072E14 .rdata.D_80072E14);
        . = MAX(., 0x1E20);
        src/span_1000/80072DA0.c.o(.rodata.D_80072E20 .rdata.D_80072E20);
        . = MAX(., 0x1E34);
        src/span_1000/80072DA0.c.o(.data.D_80072E34);
        . = MAX(., 0x2020);
        src/span_1000/80073020.c.o(.rodata.D_80073020 .rdata.D_80073020);
        . = MAX(., 0x2048);
        src/span_1000/80073020.c.o(.data.D_80073048);
        . = MAX(., 0x2050);
        src/span_1000/80073050.c.o(.rodata.D_80073050 .rdata.D_80073050);
        . = MAX(., 0x2054);
        src/span_1000/80073050.c.o(.data.D_80073054);
        . = MAX(., 0x2098);
        src/span_1000/80073098.c.o(.rodata.D_80073098 .rdata.D_80073098);
        . = MAX(., 0x20A8);
        src/span_1000/80073098.c.o(.data.D_800730A8);
        . = MAX(., 0x20B0);
        src/span_1000/800730B0.c.o(.rodata.D_800730B0 .rdata.D_800730B0);
        . = MAX(., 0x20B4);
        src/span_1000/800730B0.c.o(.rodata.D_800730B4 .rdata.D_800730B4);
        . = MAX(., 0x20B8);
        src/span_1000/800730B0.c.o(.rodata.D_800730B8 .rdata.D_800730B8);
        . = MAX(., 0x20BC);
        src/span_1000/800730B0.c.o(.rodata.D_800730BC .rdata.D_800730BC);
        . = MAX(., 0x20C0);
        src/span_1000/800730B0.c.o(.rodata.D_800730C0 .rdata.D_800730C0);
        . = MAX(., 0x20C4);
        src/span_1000/800730B0.c.o(.rodata.D_800730C4 .rdata.D_800730C4);
        . = MAX(., 0x20C8);
        src/span_1000/800730B0.c.o(.rodata.D_800730C8 .rdata.D_800730C8);
        . = MAX(., 0x20CC);
        src/span_1000/800730B0.c.o(.rodata.D_800730CC .rdata.D_800730CC);
        . = MAX(., 0x20D0);
        src/span_1000/800730B0.c.o(.rodata.D_800730D0 .rdata.D_800730D0);
        . = MAX(., 0x20D4);
        src/span_1000/800730B0.c.o(.data.D_800730D4);
        . = MAX(., 0x20E0);
        src/span_1000/800730E0.c.o(.rodata.D_800730E0 .rdata.D_800730E0);
        . = MAX(., 0x20FC);
        src/span_1000/800730E0.c.o(.rodata.D_800730FC .rdata.D_800730FC);
        . = MAX(., 0x210C);
        src/span_1000/800730E0.c.o(.data.D_8007310C);
        . = MAX(., 0x2110);
        . = ALIGN(8) /* src/game/sys_80076000/code_800AB91C.c.o */;
        src/game/sys_80076000/code_800AB91C.c.o(.rodata .rdata);
        . = MAX(., 0x2124);
        src/game/sys_80076000/code_800AB91C.c.o(.data.D_80073124);
        . = MAX(., 0x2128);
        src/span_1000/80073128.c.o(.rodata.D_80073128 .rdata.D_80073128);
        . = MAX(., 0x2150);
        src/span_1000/80073128.c.o(.rodata.D_80073150 .rdata.D_80073150);
        . = MAX(., 0x2164);
        src/span_1000/80073128.c.o(.data.D_80073164);
        . = MAX(., 0x2168);
        src/span_1000/80073168.c.o(.rodata.D_80073168 .rdata.D_80073168);
        . = MAX(., 0x217C);
        src/span_1000/80073168.c.o(.data.D_8007317C);
        . = MAX(., 0x2180);
        src/span_1000/80073180.c.o(.rodata.D_80073180 .rdata.D_80073180);
        . = MAX(., 0x21AC);
        src/span_1000/80073180.c.o(.data.D_800731AC);
        . = MAX(., 0x21B0);
        src/span_1000/800731B0.c.o(.rodata.D_800731B0 .rdata.D_800731B0);
        . = MAX(., 0x21C0);
        src/span_1000/800731B0.c.o(.rodata.D_800731C0 .rdata.D_800731C0);
        . = MAX(., 0x21CC);
        src/span_1000/800731B0.c.o(.rodata.D_800731CC .rdata.D_800731CC);
        . = MAX(., 0x21D8);
        src/span_1000/800731B0.c.o(.rodata.D_800731D8 .rdata.D_800731D8);
        . = MAX(., 0x21DC);
        src/span_1000/800731B0.c.o(.rodata.D_800731DC .rdata.D_800731DC);
        . = MAX(., 0x21E0);
        src/span_1000/800731B0.c.o(.rodata.D_800731E0 .rdata.D_800731E0);
        . = MAX(., 0x21E4);
        src/span_1000/800731B0.c.o(.rodata.D_800731E4 .rdata.D_800731E4);
        . = MAX(., 0x21E8);
        src/span_1000/800731B0.c.o(.rodata.D_800731E8 .rdata.D_800731E8);
        . = MAX(., 0x21EC);
        src/span_1000/800731B0.c.o(.rodata.D_800731EC .rdata.D_800731EC);
        . = MAX(., 0x21F0);
        src/span_1000/800731B0.c.o(.rodata.D_800731F0 .rdata.D_800731F0);
        . = MAX(., 0x21F4);
        src/span_1000/800731B0.c.o(.rodata.D_800731F4 .rdata.D_800731F4);
        . = MAX(., 0x21F8);
        src/span_1000/800731B0.c.o(.rodata.D_800731F8 .rdata.D_800731F8);
        . = MAX(., 0x21FC);
        src/span_1000/800731B0.c.o(.rodata.D_800731FC .rdata.D_800731FC);
        . = MAX(., 0x2200);
        src/span_1000/800731B0.c.o(.rodata.D_80073200 .rdata.D_80073200);
        . = MAX(., 0x2204);
        src/span_1000/800731B0.c.o(.rodata.D_80073204 .rdata.D_80073204);
        . = MAX(., 0x2208);
        src/span_1000/800731B0.c.o(.rodata.D_80073208 .rdata.D_80073208);
        . = MAX(., 0x220C);
        src/span_1000/800731B0.c.o(.rodata.D_8007320C .rdata.D_8007320C);
        . = MAX(., 0x2210);
        . = ALIGN(8) /* src/game/sys_80076000/code_800B1520.c.o */;
        src/game/sys_80076000/code_800B1520.c.o(.rodata .rdata);
        . = MAX(., 0x23B4);
        src/span_1000/800733B4.c.o(.rodata.D_800733B4 .rdata.D_800733B4);
        . = MAX(., 0x23B8);
        . = ALIGN(8) /* src/game/sys_80076000/code_800B8750.c.o */;
        src/game/sys_80076000/code_800B8750.c.o(.rodata .rdata);
        . = MAX(., 0x23F4);
        src/game/sys_80076000/code_800B8750.c.o(.data.D_800733F4);
        . = MAX(., 0x2400);
        src/span_1000/80073400.c.o(.rodata.D_80073400 .rdata.D_80073400);
        . = MAX(., 0x2410);
        src/span_1000/80073400.c.o(.rodata.D_80073410 .rdata.D_80073410);
        . = MAX(., 0x2414);
        src/span_1000/80073400.c.o(.rodata.D_80073414 .rdata.D_80073414);
        . = MAX(., 0x2418);
        src/span_1000/80073400.c.o(.rodata.D_80073418 .rdata.D_80073418);
        . = MAX(., 0x241C);
        src/span_1000/80073400.c.o(.rodata.D_8007341C .rdata.D_8007341C);
        . = MAX(., 0x2420);
        src/span_1000/80073400.c.o(.rodata.D_80073420 .rdata.D_80073420);
        . = MAX(., 0x2424);
        src/span_1000/80073400.c.o(.rodata.D_80073424 .rdata.D_80073424);
        . = MAX(., 0x2428);
        src/span_1000/80073400.c.o(.rodata.D_80073428 .rdata.D_80073428);
        . = MAX(., 0x2440);
        src/span_1000/80073400.c.o(.rodata.D_80073440 .rdata.D_80073440);
        . = MAX(., 0x2444);
        src/game/sys_80076000/code_800BC448.c.o(.rodata .rdata);
        . = MAX(., 0x2464);
        src/game/sys_80076000/code_800BC448.c.o(.data.D_80073464);
        . = MAX(., 0x2470);
        src/span_1000/80073470.c.o(.rodata.D_80073470 .rdata.D_80073470);
        . = MAX(., 0x247C);
        src/span_1000/80073470.c.o(.rodata.D_8007347C .rdata.D_8007347C);
        . = MAX(., 0x2480);
        src/span_1000/80073470.c.o(.rodata.D_80073480 .rdata.D_80073480);
        . = MAX(., 0x2484);
        src/span_1000/80073470.c.o(.rodata.D_80073484 .rdata.D_80073484);
        . = MAX(., 0x2490);
        src/span_1000/80073470.c.o(.rodata.D_80073490 .rdata.D_80073490);
        . = MAX(., 0x24D0);
        src/span_1000/80073470.c.o(.rodata.D_800734D0 .rdata.D_800734D0);
        . = MAX(., 0x24D4);
        src/game/sys_80076000/code_800BFF68.c.o(.rodata .rdata);
        . = MAX(., 0x24F4);
        src/game/sys_80076000/code_800BFF68.c.o(.data.D_800734F4);
        . = MAX(., 0x2500);
        src/span_1000/80073500.c.o(.rodata.D_80073500 .rdata.D_80073500);
        . = MAX(., 0x2510);
        src/span_1000/80073500.c.o(.rodata.D_80073510 .rdata.D_80073510);
        . = MAX(., 0x2514);
        src/span_1000/80073500.c.o(.rodata.D_80073514 .rdata.D_80073514);
        . = MAX(., 0x2518);
        src/span_1000/80073500.c.o(.rodata.D_80073518 .rdata.D_80073518);
        . = MAX(., 0x251C);
        src/span_1000/80073500.c.o(.rodata.D_8007351C .rdata.D_8007351C);
        . = MAX(., 0x2520);
        src/span_1000/80073500.c.o(.rodata.D_80073520 .rdata.D_80073520);
        . = MAX(., 0x2524);
        src/span_1000/80073500.c.o(.rodata.D_80073524 .rdata.D_80073524);
        . = MAX(., 0x2528);
        src/span_1000/80073500.c.o(.rodata.D_80073528 .rdata.D_80073528);
        . = MAX(., 0x2570);
        src/span_1000/80073500.c.o(.rodata.D_80073570 .rdata.D_80073570);
        . = MAX(., 0x2574);
        src/game/sys_80076000/code_800C3730.c.o(.rodata .rdata);
        . = MAX(., 0x2594);
        src/game/sys_80076000/code_800C3730.c.o(.data.D_80073594);
        . = MAX(., 0x25A0);
        src/span_1000/800735A0.c.o(.rodata.D_800735A0 .rdata.D_800735A0);
        . = MAX(., 0x25A4);
        src/span_1000/800735A0.c.o(.rodata.D_800735A4 .rdata.D_800735A4);
        . = MAX(., 0x25AC);
        src/span_1000/800735A0.c.o(.rodata.D_800735AC .rdata.D_800735AC);
        . = MAX(., 0x25B0);
        src/span_1000/800735A0.c.o(.rodata.D_800735B0 .rdata.D_800735B0);
        . = MAX(., 0x25D0);
        src/span_1000/800735A0.c.o(.rodata.D_800735D0 .rdata.D_800735D0);
        . = MAX(., 0x25E0);
        src/span_1000/800735A0.c.o(.rodata.D_800735E0 .rdata.D_800735E0);
        . = MAX(., 0x25F0);
        src/span_1000/800735A0.c.o(.rodata.D_800735F0 .rdata.D_800735F0);
        . = MAX(., 0x25F4);
        src/span_1000/800735A0.c.o(.data.D_800735F4);
        . = MAX(., 0x2698);
        src/span_1000/80073698.c.o(.rodata.D_80073698 .rdata.D_80073698);
        . = MAX(., 0x26A0);
        src/span_1000/80073698.c.o(.rodata.D_800736A0 .rdata.D_800736A0);
        . = MAX(., 0x26A8);
        src/span_1000/80073698.c.o(.rodata.D_800736A8 .rdata.D_800736A8);
        . = MAX(., 0x26E8);
        src/span_1000/80073698.c.o(.rodata.D_800736E8 .rdata.D_800736E8);
        . = MAX(., 0x26F4);
        src/span_1000/80073698.c.o(.rodata.D_800736F4 .rdata.D_800736F4);
        . = MAX(., 0x2700);
        src/span_1000/80073698.c.o(.rodata.D_80073700 .rdata.D_80073700);
        . = MAX(., 0x2704);
        src/span_1000/80073698.c.o(.data.D_80073704);
        . = MAX(., 0x2708);
        src/span_1000/80073698.c.o(.data.D_80073708);
        . = MAX(., 0x2710);
        src/span_1000/80073710.c.o(.rodata.D_80073710 .rdata.D_80073710);
        . = MAX(., 0x2724);
        src/span_1000/80073710.c.o(.rodata.D_80073724 .rdata.D_80073724);
        . = MAX(., 0x2738);
        src/span_1000/80073710.c.o(.rodata.D_80073738 .rdata.D_80073738);
        . = MAX(., 0x2744);
        src/span_1000/80073710.c.o(.rodata.D_80073744 .rdata.D_80073744);
        . = MAX(., 0x2750);
        src/span_1000/80073710.c.o(.rodata.D_80073750 .rdata.D_80073750);
        . = MAX(., 0x2760);
        src/span_1000/80073710.c.o(.rodata.D_80073760 .rdata.D_80073760);
        . = MAX(., 0x2774);
        src/span_1000/80073710.c.o(.rodata.D_80073774 .rdata.D_80073774);
        . = MAX(., 0x2784);
        src/span_1000/80073710.c.o(.rodata.D_80073784 .rdata.D_80073784);
        . = MAX(., 0x278C);
        src/span_1000/80073710.c.o(.rodata.D_8007378C .rdata.D_8007378C);
        . = MAX(., 0x2798);
        src/span_1000/80073710.c.o(.rodata.D_80073798 .rdata.D_80073798);
        . = MAX(., 0x27A8);
        src/span_1000/80073710.c.o(.rodata.D_800737A8 .rdata.D_800737A8);
        . = MAX(., 0x27BC);
        src/span_1000/80073710.c.o(.data.D_800737BC);
        . = MAX(., 0x27C0);
        src/span_1000/800737C0.c.o(.rodata.D_800737C0 .rdata.D_800737C0);
        . = MAX(., 0x27CC);
        src/span_1000/800737C0.c.o(.rodata.D_800737CC .rdata.D_800737CC);
        . = MAX(., 0x27DC);
        src/span_1000/800737C0.c.o(.rodata.D_800737DC .rdata.D_800737DC);
        . = MAX(., 0x27E8);
        src/span_1000/800737C0.c.o(.rodata.D_800737E8 .rdata.D_800737E8);
        . = MAX(., 0x27F4);
        src/span_1000/800737C0.c.o(.rodata.D_800737F4 .rdata.D_800737F4);
        . = MAX(., 0x2804);
        src/span_1000/800737C0.c.o(.rodata.D_80073804 .rdata.D_80073804);
        . = MAX(., 0x2814);
        src/span_1000/800737C0.c.o(.rodata.D_80073814 .rdata.D_80073814);
        . = MAX(., 0x2824);
        src/span_1000/800737C0.c.o(.rodata.D_80073824 .rdata.D_80073824);
        . = MAX(., 0x2838);
        src/span_1000/800737C0.c.o(.rodata.D_80073838 .rdata.D_80073838);
        . = MAX(., 0x2840);
        src/span_1000/800737C0.c.o(.rodata.D_80073840 .rdata.D_80073840);
        . = MAX(., 0x2848);
        src/span_1000/800737C0.c.o(.rodata.D_80073848 .rdata.D_80073848);
        . = MAX(., 0x2850);
        src/span_1000/800737C0.c.o(.rodata.D_80073850 .rdata.D_80073850);
        . = MAX(., 0x2854);
        src/span_1000/800737C0.c.o(.rodata.D_80073854 .rdata.D_80073854);
        . = MAX(., 0x2860);
        src/span_1000/800737C0.c.o(.rodata.D_80073860 .rdata.D_80073860);
        . = MAX(., 0x2874);
        src/span_1000/800737C0.c.o(.rodata.D_80073874 .rdata.D_80073874);
        . = MAX(., 0x2884);
        src/span_1000/800737C0.c.o(.rodata.D_80073884 .rdata.D_80073884);
        . = MAX(., 0x289C);
        src/span_1000/800737C0.c.o(.rodata.D_8007389C .rdata.D_8007389C);
        . = MAX(., 0x28A8);
        src/span_1000/800737C0.c.o(.rodata.D_800738A8 .rdata.D_800738A8);
        . = MAX(., 0x28C8);
        . = ALIGN(8) /* src/game/sys_80076000/code_800CE214.c.o */;
        src/game/sys_80076000/code_800CE214.c.o(.rodata .rdata);
        . = MAX(., 0x28E8);
        src/game/sys_80076000/code_800CE214.c.o(.data.D_800738E8);
        . = MAX(., 0x28F0);
        src/span_1000/800738F0.c.o(.rodata.D_800738F0 .rdata.D_800738F0);
        . = MAX(., 0x2934);
        src/span_1000/800738F0.c.o(.rodata.D_80073934 .rdata.D_80073934);
        . = MAX(., 0x297C);
        src/span_1000/800738F0.c.o(.rodata.D_8007397C .rdata.D_8007397C);
        . = MAX(., 0x2998);
        src/span_1000/800738F0.c.o(.rodata.D_80073998 .rdata.D_80073998);
        . = MAX(., 0x29D4);
        src/span_1000/800738F0.c.o(.rodata.D_800739D4 .rdata.D_800739D4);
        . = MAX(., 0x2A10);
        src/span_1000/800738F0.c.o(.rodata.D_80073A10 .rdata.D_80073A10);
        . = MAX(., 0x2A1C);
        src/span_1000/800738F0.c.o(.rodata.D_80073A1C .rdata.D_80073A1C);
        . = MAX(., 0x2A34);
        src/span_1000/800738F0.c.o(.rodata.D_80073A34 .rdata.D_80073A34);
        . = MAX(., 0x2A4C);
        src/span_1000/800738F0.c.o(.rodata.D_80073A4C .rdata.D_80073A4C);
        . = MAX(., 0x2A98);
        src/span_1000/800738F0.c.o(.rodata.D_80073A98 .rdata.D_80073A98);
        . = MAX(., 0x2AC4);
        src/span_1000/800738F0.c.o(.rodata.D_80073AC4 .rdata.D_80073AC4);
        . = MAX(., 0x2AE4);
        src/span_1000/800738F0.c.o(.rodata.D_80073AE4 .rdata.D_80073AE4);
        . = MAX(., 0x2B40);
        src/span_1000/800738F0.c.o(.rodata.D_80073B40 .rdata.D_80073B40);
        . = MAX(., 0x2B58);
        src/span_1000/800738F0.c.o(.rodata.D_80073B58 .rdata.D_80073B58);
        . = MAX(., 0x2B7C);
        src/span_1000/800738F0.c.o(.rodata.D_80073B7C .rdata.D_80073B7C);
        . = MAX(., 0x2B84);
        src/span_1000/800738F0.c.o(.data.D_80073B84);
        . = MAX(., 0x2B88);
        src/span_1000/80073B88.c.o(.rodata.D_80073B88 .rdata.D_80073B88);
        . = MAX(., 0x2BB8);
        src/span_1000/80073B88.c.o(.rodata.D_80073BB8 .rdata.D_80073BB8);
        . = MAX(., 0x2BE4);
        src/span_1000/80073B88.c.o(.data.D_80073BE4);
        . = MAX(., 0x2BE8);
        src/span_1000/80073BE8.c.o(.rodata.D_80073BE8 .rdata.D_80073BE8);
        . = MAX(., 0x2C14);
        src/span_1000/80073BE8.c.o(.data.D_80073C14);
        . = MAX(., 0x2C18);
        src/span_1000/80073C18.c.o(.rodata.D_80073C18 .rdata.D_80073C18);
        . = MAX(., 0x2C48);
        src/span_1000/80073C18.c.o(.rodata.D_80073C48 .rdata.D_80073C48);
        . = MAX(., 0x2C50);
        src/span_1000/80073C18.c.o(.rodata.D_80073C50 .rdata.D_80073C50);
        . = MAX(., 0x2C58);
        src/span_1000/80073C18.c.o(.rodata.D_80073C58 .rdata.D_80073C58);
        . = MAX(., 0x2C60);
        src/span_1000/80073C18.c.o(.data.D_80073C60);
        . = MAX(., 0x2C64);
        src/span_1000/80073C64.c.o(.rodata.D_80073C64 .rdata.D_80073C64);
        . = MAX(., 0x2C68);
        src/span_1000/80073C64.c.o(.data.D_80073C68);
        . = MAX(., 0x2C70);
        src/span_1000/80073C70.c.o(.rodata.D_80073C70 .rdata.D_80073C70);
        . = MAX(., 0x2C74);
        src/span_1000/80073C70.c.o(.data.D_80073C74);
        . = MAX(., 0x2C80);
        src/span_1000/80073C80.c.o(.rodata.D_80073C80 .rdata.D_80073C80);
        . = MAX(., 0x2C8C);
        src/span_1000/80073C80.c.o(.rodata.D_80073C8C .rdata.D_80073C8C);
        . = MAX(., 0x2C94);
        src/span_1000/80073C80.c.o(.rodata.D_80073C94 .rdata.D_80073C94);
        . = MAX(., 0x2C9C);
        src/span_1000/80073C80.c.o(.rodata.D_80073C9C .rdata.D_80073C9C);
        . = MAX(., 0x2CA8);
        src/span_1000/80073C80.c.o(.rodata.D_80073CA8 .rdata.D_80073CA8);
        . = MAX(., 0x2CBC);
        src/span_1000/80073C80.c.o(.rodata.D_80073CBC .rdata.D_80073CBC);
        . = MAX(., 0x2CC8);
        src/span_1000/80073C80.c.o(.rodata.D_80073CC8 .rdata.D_80073CC8);
        . = MAX(., 0x2CDC);
        src/span_1000/80073C80.c.o(.rodata.D_80073CDC .rdata.D_80073CDC);
        . = MAX(., 0x2CEC);
        src/span_1000/80073C80.c.o(.rodata.D_80073CEC .rdata.D_80073CEC);
        . = MAX(., 0x2CF8);
        src/span_1000/80073C80.c.o(.rodata.D_80073CF8 .rdata.D_80073CF8);
        . = MAX(., 0x2D08);
        src/span_1000/80073C80.c.o(.rodata.D_80073D08 .rdata.D_80073D08);
        . = MAX(., 0x2D14);
        src/span_1000/80073C80.c.o(.rodata.D_80073D14 .rdata.D_80073D14);
        . = MAX(., 0x2D18);
        src/span_1000/80073C80.c.o(.rodata.D_80073D18 .rdata.D_80073D18);
        . = MAX(., 0x2D20);
        . = ALIGN(8) /* src/game/sys_80076000/code_800D1EBC.c.o */;
        src/game/sys_80076000/code_800D1EBC.c.o(.rodata .rdata);
        . = MAX(., 0x2D34);
        src/game/sys_80076000/code_800D1EBC.c.o(.rodata.D_80073D34 .rdata.D_80073D34);
        . = MAX(., 0x2D44);
        src/game/sys_80076000/code_800D1EBC.c.o(.data.D_80073D44);
        . = MAX(., 0x2D48);
        src/span_1000/80073D48.c.o(.rodata.D_80073D48 .rdata.D_80073D48);
        . = MAX(., 0x2D70);
        src/span_1000/80073D48.c.o(.rodata.D_80073D70 .rdata.D_80073D70);
        . = MAX(., 0x2D84);
        src/span_1000/80073D48.c.o(.rodata.D_80073D84 .rdata.D_80073D84);
        . = MAX(., 0x2D90);
        src/span_1000/80073D48.c.o(.rodata.D_80073D90 .rdata.D_80073D90);
        . = MAX(., 0x2D9C);
        src/span_1000/80073D48.c.o(.rodata.D_80073D9C .rdata.D_80073D9C);
        . = MAX(., 0x2DB0);
        src/span_1000/80073D48.c.o(.rodata.D_80073DB0 .rdata.D_80073DB0);
        . = MAX(., 0x2DBC);
        src/span_1000/80073D48.c.o(.rodata.D_80073DBC .rdata.D_80073DBC);
        . = MAX(., 0x2DD0);
        src/span_1000/80073D48.c.o(.rodata.D_80073DD0 .rdata.D_80073DD0);
        . = MAX(., 0x2DE4);
        src/span_1000/80073D48.c.o(.rodata.D_80073DE4 .rdata.D_80073DE4);
        . = MAX(., 0x2E00);
        src/span_1000/80073D48.c.o(.rodata.D_80073E00 .rdata.D_80073E00);
        . = MAX(., 0x2E20);
        src/span_1000/80073D48.c.o(.rodata.D_80073E20 .rdata.D_80073E20);
        . = MAX(., 0x2E3C);
        src/span_1000/80073D48.c.o(.rodata.D_80073E3C .rdata.D_80073E3C);
        . = MAX(., 0x2E50);
        src/span_1000/80073D48.c.o(.rodata.D_80073E50 .rdata.D_80073E50);
        . = MAX(., 0x2E68);
        src/span_1000/80073D48.c.o(.rodata.D_80073E68 .rdata.D_80073E68);
        . = MAX(., 0x2E84);
        src/span_1000/80073D48.c.o(.rodata.D_80073E84 .rdata.D_80073E84);
        . = MAX(., 0x2EA0);
        src/span_1000/80073D48.c.o(.data.D_80073EA0);
        . = MAX(., 0x2EBC);
        src/span_1000/80073D48.c.o(.rodata.D_80073EBC .rdata.D_80073EBC);
        . = MAX(., 0x2ED4);
        src/span_1000/80073D48.c.o(.rodata.D_80073ED4 .rdata.D_80073ED4);
        . = MAX(., 0x2EF4);
        src/span_1000/80073D48.c.o(.data.D_80073EF4);
        . = MAX(., 0x2EF8);
        src/span_1000/80073EF8.c.o(.rodata.D_80073EF8 .rdata.D_80073EF8);
        . = MAX(., 0x2F30);
        src/span_1000/80073EF8.c.o(.rodata.D_80073F30 .rdata.D_80073F30);
        . = MAX(., 0x2F50);
        src/span_1000/80073EF8.c.o(.rodata.D_80073F50 .rdata.D_80073F50);
        . = MAX(., 0x2F58);
        src/span_1000/80073EF8.c.o(.rodata.D_80073F58 .rdata.D_80073F58);
        . = MAX(., 0x2F70);
        src/span_1000/80073EF8.c.o(.rodata.D_80073F70 .rdata.D_80073F70);
        . = MAX(., 0x2F88);
        src/span_1000/80073EF8.c.o(.rodata.D_80073F88 .rdata.D_80073F88);
        . = MAX(., 0x2FA4);
        src/span_1000/80073EF8.c.o(.rodata.D_80073FA4 .rdata.D_80073FA4);
        . = MAX(., 0x2FBC);
        src/span_1000/80073EF8.c.o(.rodata.D_80073FBC .rdata.D_80073FBC);
        . = MAX(., 0x2FC4);
        src/span_1000/80073EF8.c.o(.rodata.D_80073FC4 .rdata.D_80073FC4);
        . = MAX(., 0x2FDC);
        src/span_1000/80073EF8.c.o(.rodata.D_80073FDC .rdata.D_80073FDC);
        . = MAX(., 0x2FE8);
        src/span_1000/80073EF8.c.o(.rodata.D_80073FE8 .rdata.D_80073FE8);
        . = MAX(., 0x2FFC);
        src/span_1000/80073EF8.c.o(.rodata.D_80073FFC .rdata.D_80073FFC);
        . = MAX(., 0x3008);
        src/span_1000/80073EF8.c.o(.rodata.D_80074008 .rdata.D_80074008);
        . = MAX(., 0x3024);
        src/span_1000/80073EF8.c.o(.rodata.D_80074024 .rdata.D_80074024);
        . = MAX(., 0x3038);
        src/span_1000/80073EF8.c.o(.rodata.D_80074038 .rdata.D_80074038);
        . = MAX(., 0x3044);
        src/span_1000/80073EF8.c.o(.rodata.D_80074044 .rdata.D_80074044);
        . = MAX(., 0x3050);
        src/span_1000/80073EF8.c.o(.data.D_80074050);
        . = MAX(., 0x30AC);
        src/span_1000/800740AC.c.o(.rodata.D_800740AC .rdata.D_800740AC);
        . = MAX(., 0x30B4);
        src/span_1000/800740AC.c.o(.rodata.D_800740B4 .rdata.D_800740B4);
        . = MAX(., 0x30C0);
        src/span_1000/800740AC.c.o(.rodata.D_800740C0 .rdata.D_800740C0);
        . = MAX(., 0x30C8);
        src/span_1000/800740AC.c.o(.rodata.D_800740C8 .rdata.D_800740C8);
        . = MAX(., 0x30E8);
        src/span_1000/800740AC.c.o(.rodata.D_800740E8 .rdata.D_800740E8);
        . = MAX(., 0x30F8);
        src/span_1000/800740AC.c.o(.rodata.D_800740F8 .rdata.D_800740F8);
        . = MAX(., 0x3110);
        src/span_1000/800740AC.c.o(.rodata.D_80074110 .rdata.D_80074110);
        . = MAX(., 0x311C);
        src/span_1000/800740AC.c.o(.rodata.D_8007411C .rdata.D_8007411C);
        . = MAX(., 0x3128);
        src/span_1000/800740AC.c.o(.data.D_80074128);
        . = MAX(., 0x3130);
        src/span_1000/80074130.c.o(.rodata.D_80074130 .rdata.D_80074130);
        . = MAX(., 0x3138);
        src/span_1000/80074130.c.o(.rodata.D_80074138 .rdata.D_80074138);
        . = MAX(., 0x3140);
        src/span_1000/80074130.c.o(.rodata.D_80074140 .rdata.D_80074140);
        . = MAX(., 0x3148);
        src/span_1000/80074130.c.o(.rodata.D_80074148 .rdata.D_80074148);
        . = MAX(., 0x3150);
        src/span_1000/80074130.c.o(.rodata.D_80074150 .rdata.D_80074150);
        . = MAX(., 0x317C);
        src/span_1000/80074130.c.o(.rodata.D_8007417C .rdata.D_8007417C);
        . = MAX(., 0x3188);
        src/span_1000/80074130.c.o(.rodata.D_80074188 .rdata.D_80074188);
        . = MAX(., 0x319C);
        src/span_1000/80074130.c.o(.rodata.D_8007419C .rdata.D_8007419C);
        . = MAX(., 0x31A0);
        src/span_1000/80074130.c.o(.data.D_800741A0);
        . = MAX(., 0x3268);
        src/span_1000/80074268.c.o(.rodata.D_80074268 .rdata.D_80074268);
        . = MAX(., 0x3270);
        src/span_1000/80074268.c.o(.rodata.D_80074270 .rdata.D_80074270);
        . = MAX(., 0x3278);
        src/span_1000/80074268.c.o(.rodata.D_80074278 .rdata.D_80074278);
        . = MAX(., 0x3280);
        src/span_1000/80074268.c.o(.rodata.D_80074280 .rdata.D_80074280);
        . = MAX(., 0x3294);
        src/span_1000/80074268.c.o(.rodata.D_80074294 .rdata.D_80074294);
        . = MAX(., 0x32AC);
        src/span_1000/80074268.c.o(.rodata.D_800742AC .rdata.D_800742AC);
        . = MAX(., 0x32C4);
        src/span_1000/80074268.c.o(.rodata.D_800742C4 .rdata.D_800742C4);
        . = MAX(., 0x32D0);
        src/span_1000/80074268.c.o(.rodata.D_800742D0 .rdata.D_800742D0);
        . = MAX(., 0x32E0);
        src/span_1000/80074268.c.o(.data.D_800742E0);
        . = MAX(., 0x32E4);
        src/span_1000/800742E4.c.o(.rodata.D_800742E4 .rdata.D_800742E4);
        . = MAX(., 0x3314);
        src/span_1000/800742E4.c.o(.rodata.D_80074314 .rdata.D_80074314);
        . = MAX(., 0x3320);
        src/span_1000/800742E4.c.o(.rodata.D_80074320 .rdata.D_80074320);
        . = MAX(., 0x332C);
        src/span_1000/800742E4.c.o(.data.D_8007432C);
        . = MAX(., 0x338C);
        src/span_1000/8007438C.c.o(.rodata.D_8007438C .rdata.D_8007438C);
        . = MAX(., 0x3390);
        src/span_1000/8007438C.c.o(.rodata.D_80074390 .rdata.D_80074390);
        . = MAX(., 0x3394);
        src/span_1000/8007438C.c.o(.data.D_80074394);
        . = MAX(., 0x3398);
        src/span_1000/8007438C.c.o(.data.D_80074398);
        . = MAX(., 0x339C);
        src/span_1000/8007438C.c.o(.rodata.D_8007439C .rdata.D_8007439C);
        . = MAX(., 0x33A8);
        src/span_1000/8007438C.c.o(.rodata.D_800743A8 .rdata.D_800743A8);
        . = MAX(., 0x33B4);
        src/span_1000/8007438C.c.o(.data.D_800743B4);
        . = MAX(., 0x33B8);
        . = ALIGN(8) /* src/game/sys_80076000/code_800DF214.c.o */;
        src/game/sys_80076000/code_800DF214.c.o(.rodata .rdata);
        . = MAX(., 0x33F4);
        src/game/sys_80076000/code_800DF214.c.o(.rodata.D_800743F4 .rdata.D_800743F4);
        . = MAX(., 0x33FC);
        src/game/sys_80076000/code_800DF214.c.o(.rodata.D_800743FC .rdata.D_800743FC);
        . = MAX(., 0x3404);
        src/game/sys_80076000/code_800DF214.c.o(.rodata.D_80074404 .rdata.D_80074404);
        . = MAX(., 0x3414);
        src/game/sys_80076000/code_800DF214.c.o(.rodata.D_80074414 .rdata.D_80074414);
        . = MAX(., 0x341C);
        src/game/sys_80076000/code_800DF214.c.o(.rodata.D_8007441C .rdata.D_8007441C);
        . = MAX(., 0x3428);
        . = ALIGN(8) /* src/game/sys_80076000/code_800E0B00.c.o */;
        src/game/sys_80076000/code_800E0B00.c.o(.rodata .rdata);
        . = MAX(., 0x342C);
        src/game/sys_80076000/code_800E0B00.c.o(.rodata.D_8007442C .rdata.D_8007442C);
        . = MAX(., 0x3430);
        src/game/sys_80076000/code_800E0B00.c.o(.data.D_80074430);
        . = MAX(., 0x3434);
        src/game/sys_80076000/code_800E0B00.c.o(.data.D_80074434);
        . = MAX(., 0x3438);
        src/game/sys_80076000/code_800E0B00.c.o(.data.D_80074438);
        . = MAX(., 0x343C);
        src/game/sys_80076000/code_800E0B00.c.o(.rodata.D_8007443C .rdata.D_8007443C);
        . = MAX(., 0x3440);
        src/game/sys_80076000/code_800E0B00.c.o(.data.D_80074440);
        . = MAX(., 0x3444);
        src/game/sys_80076000/code_800E0B00.c.o(.data.D_80074444);
        . = MAX(., 0x3448);
        src/game/sys_80076000/code_800E0B00.c.o(.data.D_80074448);
        . = MAX(., 0x344C);
        src/game/sys_80076000/code_800E0B00.c.o(.rodata.D_8007444C .rdata.D_8007444C);
        . = MAX(., 0x345C);
        src/game/sys_80076000/code_800E0B00.c.o(.rodata.D_8007445C .rdata.D_8007445C);
        . = MAX(., 0x3478);
        src/game/sys_80076000/code_800E0B00.c.o(.rodata.D_80074478 .rdata.D_80074478);
        . = MAX(., 0x347C);
        src/game/sys_80076000/code_800E0B00.c.o(.data.D_8007447C);
        . = MAX(., 0x3480);
        src/game/sys_80076000/code_800E0B00.c.o(.rodata.D_80074480 .rdata.D_80074480);
        . = MAX(., 0x34B0);
        src/game/sys_80076000/code_800E0B00.c.o(.rodata.D_800744B0 .rdata.D_800744B0);
        . = MAX(., 0x34B4);
        src/game/sys_80076000/code_800E0B00.c.o(.rodata.D_800744B4 .rdata.D_800744B4);
        . = MAX(., 0x34B8);
        src/game/sys_80076000/code_800E0B00.c.o(.rodata.D_800744B8 .rdata.D_800744B8);
        . = MAX(., 0x34C8);
        src/game/sys_80076000/code_800E0B00.c.o(.data.D_800744C8);
        . = MAX(., 0x34D0);
        src/span_1000/800744D0.c.o(.rodata.D_800744D0 .rdata.D_800744D0);
        . = MAX(., 0x34D4);
        src/span_1000/800744D0.c.o(.rodata.D_800744D4 .rdata.D_800744D4);
        . = MAX(., 0x34DC);
        src/span_1000/800744D0.c.o(.data.D_800744DC);
        . = MAX(., 0x34E0);
        src/span_1000/800744E0.c.o(.rodata.D_800744E0 .rdata.D_800744E0);
        . = MAX(., 0x34E4);
        src/span_1000/800744E0.c.o(.rodata.D_800744E4 .rdata.D_800744E4);
        . = MAX(., 0x34E8);
        src/span_1000/800744E0.c.o(.rodata.D_800744E8 .rdata.D_800744E8);
        . = MAX(., 0x34EC);
        src/span_1000/800744E0.c.o(.rodata.D_800744EC .rdata.D_800744EC);
        . = MAX(., 0x34F8);
        src/span_1000/800744E0.c.o(.rodata.D_800744F8 .rdata.D_800744F8);
        . = MAX(., 0x34FC);
        src/span_1000/800744E0.c.o(.data.D_800744FC);
        . = MAX(., 0x3500);
        src/span_1000/80074500.c.o(.rodata.D_80074500 .rdata.D_80074500);
        . = MAX(., 0x3504);
        src/span_1000/80074500.c.o(.rodata.D_80074504 .rdata.D_80074504);
        . = MAX(., 0x359C);
        src/span_1000/80074500.c.o(.rodata.D_8007459C .rdata.D_8007459C);
        . = MAX(., 0x35B0);
        . = ALIGN(8) /* src/game/sys_80076000/code_800E2ACC.c.o */;
        src/game/sys_80076000/code_800E2ACC.c.o(.rodata .rdata);
        . = MAX(., 0x35D0);
        src/game/sys_80076000/code_800E2ACC.c.o(.rodata.D_800745D0 .rdata.D_800745D0);
        . = MAX(., 0x35D4);
        src/game/sys_80076000/code_800E2ACC.c.o(.rodata.D_800745D4 .rdata.D_800745D4);
        . = MAX(., 0x35F4);
        src/game/sys_80076000/code_800E2ACC.c.o(.rodata.D_800745F4 .rdata.D_800745F4);
        . = MAX(., 0x3600);
        src/game/sys_80076000/code_800E2ACC.c.o(.rodata.D_80074600 .rdata.D_80074600);
        . = MAX(., 0x3628);
        src/game/sys_80076000/code_800E2ACC.c.o(.rodata.D_80074628 .rdata.D_80074628);
        . = MAX(., 0x3630);
        src/game/sys_80076000/code_800E2ACC.c.o(.rodata.D_80074630 .rdata.D_80074630);
        . = MAX(., 0x3638);
        src/game/sys_80076000/code_800E2ACC.c.o(.rodata.D_80074638 .rdata.D_80074638);
        . = MAX(., 0x363C);
        src/game/sys_80076000/code_800E2ACC.c.o(.rodata.D_8007463C .rdata.D_8007463C);
        . = MAX(., 0x3644);
        src/game/sys_80076000/code_800E2ACC.c.o(.data.D_80074644);
        . = MAX(., 0x3650);
        src/span_1000/80074650.c.o(.rodata.D_80074650 .rdata.D_80074650);
        . = MAX(., 0x3658);
        src/span_1000/80074650.c.o(.rodata.D_80074658 .rdata.D_80074658);
        . = MAX(., 0x365C);
        src/span_1000/80074650.c.o(.rodata.D_8007465C .rdata.D_8007465C);
        . = MAX(., 0x3664);
        src/span_1000/80074650.c.o(.data.D_80074664);
        . = MAX(., 0x3668);
        src/span_1000/80074668.c.o(.rodata.D_80074668 .rdata.D_80074668);
        . = MAX(., 0x36B0);
        src/span_1000/80074668.c.o(.rodata.D_800746B0 .rdata.D_800746B0);
        . = MAX(., 0x36B4);
        src/span_1000/80074668.c.o(.data.D_800746B4);
        . = MAX(., 0x36C0);
        . = ALIGN(8) /* src/game/sys_80076000/code_800E6C14.c.o */;
        src/game/sys_80076000/code_800E6C14.c.o(.rodata .rdata);
        . = MAX(., 0x36C4);
        src/game/sys_80076000/code_800E6CA4.c.o(.rodata .rdata);
        . = MAX(., 0x36C8);
        src/game/sys_80076000/code_800E6CA4.c.o(.rodata.D_800746C8 .rdata.D_800746C8);
        . = MAX(., 0x36D4);
        src/game/sys_80076000/code_800E6CA4.c.o(.rodata.D_800746D4 .rdata.D_800746D4);
        . = MAX(., 0x36D8);
        src/game/sys_80076000/code_800E6CA4.c.o(.rodata.D_800746D8 .rdata.D_800746D8);
        . = MAX(., 0x36DC);
        src/game/sys_80076000/code_800E6CA4.c.o(.rodata.D_800746DC .rdata.D_800746DC);
        . = MAX(., 0x36E0);
        src/game/sys_80076000/code_800E6CA4.c.o(.rodata.D_800746E0 .rdata.D_800746E0);
        . = MAX(., 0x36E8);
        src/game/sys_80076000/code_800E6CA4.c.o(.rodata.D_800746E8 .rdata.D_800746E8);
        . = MAX(., 0x36EC);
        src/game/sys_80076000/code_800E6CA4.c.o(.data.D_800746EC);
        . = MAX(., 0x36F0);
        src/game/sys_80076000/code_800E6CA4.c.o(.rodata.D_800746F0 .rdata.D_800746F0);
        . = MAX(., 0x36FC);
        src/game/sys_80076000/code_800E6CA4.c.o(.rodata.D_800746FC .rdata.D_800746FC);
        . = MAX(., 0x3704);
        src/game/sys_80076000/code_800E6CA4.c.o(.rodata.D_80074704 .rdata.D_80074704);
        . = MAX(., 0x370C);
        src/game/sys_80076000/code_800E6CA4.c.o(.rodata.D_8007470C .rdata.D_8007470C);
        . = MAX(., 0x3718);
        . = ALIGN(8) /* src/game/sys_80076000/code_800E76D0.c.o */;
        src/game/sys_80076000/code_800E76D0.c.o(.rodata .rdata);
        . = MAX(., 0x371C);
        src/game/sys_80076000/code_800E76D0.c.o(.rodata.D_8007471C .rdata.D_8007471C);
        . = MAX(., 0x3720);
        src/game/sys_80076000/code_800E76D0.c.o(.rodata.D_80074720 .rdata.D_80074720);
        . = MAX(., 0x3724);
        src/game/sys_80076000/code_800E76D0.c.o(.rodata.D_80074724 .rdata.D_80074724);
        . = MAX(., 0x3728);
        src/game/sys_80076000/code_800E76D0.c.o(.rodata.D_80074728 .rdata.D_80074728);
        . = MAX(., 0x372C);
        src/game/sys_80076000/code_800E76D0.c.o(.rodata.D_8007472C .rdata.D_8007472C);
        . = MAX(., 0x3734);
        src/game/sys_80076000/code_800E76D0.c.o(.rodata.D_80074734 .rdata.D_80074734);
        . = MAX(., 0x373C);
        src/game/sys_80076000/code_800E76D0.c.o(.rodata.D_8007473C .rdata.D_8007473C);
        . = MAX(., 0x3744);
        src/game/sys_80076000/code_800E76D0.c.o(.rodata.D_80074744 .rdata.D_80074744);
        . = MAX(., 0x374C);
        src/game/sys_80076000/code_800E76D0.c.o(.rodata.D_8007474C .rdata.D_8007474C);
        . = MAX(., 0x3750);
        src/game/sys_80076000/code_800E76D0.c.o(.rodata.D_80074750 .rdata.D_80074750);
        . = MAX(., 0x3754);
        src/game/sys_80076000/code_800E76D0.c.o(.rodata.D_80074754 .rdata.D_80074754);
        . = MAX(., 0x3758);
        src/game/sys_80076000/code_800E76D0.c.o(.rodata.D_80074758 .rdata.D_80074758);
        . = MAX(., 0x375C);
        src/game/sys_80076000/code_800E76D0.c.o(.rodata.D_8007475C .rdata.D_8007475C);
        . = MAX(., 0x3760);
        src/game/sys_80076000/code_800E76D0.c.o(.rodata.D_80074760 .rdata.D_80074760);
        . = MAX(., 0x3764);
        src/game/sys_80076000/code_800E76D0.c.o(.rodata.D_80074764 .rdata.D_80074764);
        . = MAX(., 0x3768);
        src/game/sys_80076000/code_800E76D0.c.o(.rodata.D_80074768 .rdata.D_80074768);
        . = MAX(., 0x376C);
        src/game/sys_80076000/code_800E76D0.c.o(.rodata.D_8007476C .rdata.D_8007476C);
        . = MAX(., 0x3770);
        src/game/sys_80076000/code_800E76D0.c.o(.rodata.D_80074770 .rdata.D_80074770);
        . = MAX(., 0x3778);
        src/game/sys_80076000/code_800E76D0.c.o(.rodata.D_80074778 .rdata.D_80074778);
        . = MAX(., 0x377C);
        src/game/sys_80076000/code_800E76D0.c.o(.rodata.D_8007477C .rdata.D_8007477C);
        . = MAX(., 0x3780);
        src/game/sys_80076000/code_800E76D0.c.o(.rodata.D_80074780 .rdata.D_80074780);
        . = MAX(., 0x3784);
        src/game/sys_80076000/code_800E76D0.c.o(.rodata.D_80074784 .rdata.D_80074784);
        . = MAX(., 0x3788);
        src/game/sys_80076000/code_800E76D0.c.o(.rodata.D_80074788 .rdata.D_80074788);
        . = MAX(., 0x378C);
        src/game/sys_80076000/code_800E76D0.c.o(.rodata.D_8007478C .rdata.D_8007478C);
        . = MAX(., 0x3794);
        src/game/sys_80076000/code_800E76D0.c.o(.rodata.D_80074794 .rdata.D_80074794);
        . = MAX(., 0x379C);
        src/game/sys_80076000/code_800E76D0.c.o(.rodata.D_8007479C .rdata.D_8007479C);
        . = MAX(., 0x37A4);
        src/game/sys_80076000/code_800E76D0.c.o(.rodata.D_800747A4 .rdata.D_800747A4);
        . = MAX(., 0x37AC);
        src/game/sys_80076000/code_800E867C.c.o(.rodata .rdata);
        . = MAX(., 0x37B0);
        src/game/sys_80076000/code_800E867C.c.o(.rodata.D_800747B0 .rdata.D_800747B0);
        . = MAX(., 0x37B4);
        src/game/sys_80076000/code_800E86C8.c.o(.rodata .rdata);
        . = MAX(., 0x37B8);
        src/game/sys_80076000/code_800E86C8.c.o(.rodata.D_800747B8 .rdata.D_800747B8);
        . = MAX(., 0x37BC);
        src/game/sys_80076000/code_800E86C8.c.o(.rodata.D_800747BC .rdata.D_800747BC);
        . = MAX(., 0x37C0);
        . = ALIGN(8) /* src/game/sys_80076000/code_800E8740.c.o */;
        src/game/sys_80076000/code_800E8740.c.o(.rodata .rdata);
        . = MAX(., 0x37C4);
        src/game/sys_80076000/code_800E8740.c.o(.rodata.D_800747C4 .rdata.D_800747C4);
        . = MAX(., 0x37C8);
        src/game/sys_80076000/code_800E8740.c.o(.rodata.D_800747C8 .rdata.D_800747C8);
        . = MAX(., 0x37D0);
        src/game/sys_80076000/code_800E8740.c.o(.rodata.D_800747D0 .rdata.D_800747D0);
        . = MAX(., 0x37D4);
        src/game/sys_80076000/code_800E8740.c.o(.rodata.D_800747D4 .rdata.D_800747D4);
        . = MAX(., 0x37D8);
        src/game/sys_80076000/code_800E8740.c.o(.rodata.D_800747D8 .rdata.D_800747D8);
        . = MAX(., 0x37E0);
        src/game/sys_80076000/code_800E8740.c.o(.rodata.D_800747E0 .rdata.D_800747E0);
        . = MAX(., 0x37E8);
        src/game/sys_80076000/code_800E8740.c.o(.rodata.D_800747E8 .rdata.D_800747E8);
        . = MAX(., 0x37F4);
        src/game/sys_80076000/code_800E8740.c.o(.rodata.D_800747F4 .rdata.D_800747F4);
        . = MAX(., 0x37FC);
        src/game/sys_80076000/code_800E8740.c.o(.rodata.D_800747FC .rdata.D_800747FC);
        . = MAX(., 0x3808);
        src/game/sys_80076000/code_800E8740.c.o(.rodata.D_80074808 .rdata.D_80074808);
        . = MAX(., 0x380C);
        src/game/sys_80076000/code_800E8740.c.o(.rodata.D_8007480C .rdata.D_8007480C);
        . = MAX(., 0x3810);
        src/game/sys_80076000/code_800E8740.c.o(.rodata.D_80074810 .rdata.D_80074810);
        . = MAX(., 0x3814);
        src/game/sys_80076000/code_800E8740.c.o(.rodata.D_80074814 .rdata.D_80074814);
        . = MAX(., 0x381C);
        src/game/sys_80076000/code_800E8DFC.c.o(.rodata .rdata);
        . = MAX(., 0x3820);
        src/game/sys_80076000/code_800E8DFC.c.o(.rodata.D_80074820 .rdata.D_80074820);
        . = MAX(., 0x3828);
        src/game/sys_80076000/code_800E8DFC.c.o(.rodata.D_80074828 .rdata.D_80074828);
        . = MAX(., 0x382C);
        src/game/sys_80076000/code_800E8DFC.c.o(.rodata.D_8007482C .rdata.D_8007482C);
        . = MAX(., 0x3830);
        src/game/sys_80076000/code_800E8DFC.c.o(.rodata.D_80074830 .rdata.D_80074830);
        . = MAX(., 0x3834);
        src/game/sys_80076000/code_800E8DFC.c.o(.rodata.D_80074834 .rdata.D_80074834);
        . = MAX(., 0x3838);
        src/game/sys_80076000/code_800E8DFC.c.o(.rodata.D_80074838 .rdata.D_80074838);
        . = MAX(., 0x383C);
        src/game/sys_80076000/code_800E8DFC.c.o(.rodata.D_8007483C .rdata.D_8007483C);
        . = MAX(., 0x3840);
        src/game/sys_80076000/code_800E8DFC.c.o(.rodata.D_80074840 .rdata.D_80074840);
        . = MAX(., 0x3844);
        src/game/sys_80076000/code_800E8DFC.c.o(.rodata.D_80074844 .rdata.D_80074844);
        . = MAX(., 0x3848);
        src/game/sys_80076000/code_800E8DFC.c.o(.rodata.D_80074848 .rdata.D_80074848);
        . = MAX(., 0x384C);
        src/game/sys_80076000/code_800E8DFC.c.o(.data.D_8007484C);
        . = MAX(., 0x3850);
        src/game/sys_80076000/code_800E8DFC.c.o(.rodata.D_80074850 .rdata.D_80074850);
        . = MAX(., 0x3854);
        src/game/sys_80076000/code_800E8DFC.c.o(.rodata.D_80074854 .rdata.D_80074854);
        . = MAX(., 0x3858);
        src/game/sys_80076000/code_800E8DFC.c.o(.rodata.D_80074858 .rdata.D_80074858);
        . = MAX(., 0x3860);
        . = ALIGN(8) /* src/game/sys_80076000/code_800E92F0.c.o */;
        src/game/sys_80076000/code_800E92F0.c.o(.rodata .rdata);
        . = MAX(., 0x3864);
        src/game/sys_80076000/code_800E92F0.c.o(.rodata.D_80074864 .rdata.D_80074864);
        . = MAX(., 0x386C);
        src/game/sys_80076000/code_800E92F0.c.o(.rodata.D_8007486C .rdata.D_8007486C);
        . = MAX(., 0x3870);
        src/game/sys_80076000/code_800E92F0.c.o(.rodata.D_80074870 .rdata.D_80074870);
        . = MAX(., 0x3878);
        src/game/sys_80076000/code_800E92F0.c.o(.rodata.D_80074878 .rdata.D_80074878);
        . = MAX(., 0x3884);
        src/game/sys_80076000/code_800E9538.c.o(.rodata .rdata);
        . = MAX(., 0x3888);
        src/game/sys_80076000/code_800E9538.c.o(.rodata.D_80074888 .rdata.D_80074888);
        . = MAX(., 0x388C);
        src/game/sys_80076000/code_800E9538.c.o(.rodata.D_8007488C .rdata.D_8007488C);
        . = MAX(., 0x3890);
        src/game/sys_80076000/code_800E9538.c.o(.data.D_80074890);
        . = MAX(., 0x3894);
        src/game/sys_80076000/code_800E9538.c.o(.rodata.D_80074894 .rdata.D_80074894);
        . = MAX(., 0x3898);
        src/game/sys_80076000/code_800E9538.c.o(.data.D_80074898);
        . = MAX(., 0x389C);
        src/game/sys_80076000/code_800E9538.c.o(.rodata.D_8007489C .rdata.D_8007489C);
        . = MAX(., 0x38A4);
        src/game/sys_80076000/code_800E9538.c.o(.rodata.D_800748A4 .rdata.D_800748A4);
        . = MAX(., 0x38AC);
        src/game/sys_80076000/code_800E9538.c.o(.data.D_800748AC);
        . = MAX(., 0x38E4);
        src/span_1000/800748E4.c.o(.rodata.D_800748E4 .rdata.D_800748E4);
        . = MAX(., 0x38E8);
        src/span_1000/800748E4.c.o(.rodata.D_800748E8 .rdata.D_800748E8);
        . = MAX(., 0x38F0);
        src/span_1000/800748E4.c.o(.rodata.D_800748F0 .rdata.D_800748F0);
        . = MAX(., 0x3904);
        src/span_1000/800748E4.c.o(.rodata.D_80074904 .rdata.D_80074904);
        . = MAX(., 0x3914);
        src/game/sys_80076000/code_800E9B9C.c.o(.rodata .rdata);
        . = MAX(., 0x3928);
        src/game/sys_80076000/code_800E9B9C.c.o(.rodata.D_80074928 .rdata.D_80074928);
        . = MAX(., 0x3948);
        src/game/sys_80076000/code_800E9B9C.c.o(.rodata.D_80074948 .rdata.D_80074948);
        . = MAX(., 0x394C);
        src/game/sys_80076000/code_800E9B9C.c.o(.rodata.D_8007494C .rdata.D_8007494C);
        . = MAX(., 0x3950);
        . = ALIGN(8) /* src/game/sys_80076000/code_800E9DA4.c.o */;
        src/game/sys_80076000/code_800E9DA4.c.o(.rodata .rdata);
        . = MAX(., 0x395C);
        src/game/sys_80076000/code_800E9DA4.c.o(.rodata.D_8007495C .rdata.D_8007495C);
        . = MAX(., 0x3960);
        src/game/sys_80076000/code_800E9DA4.c.o(.rodata.D_80074960 .rdata.D_80074960);
        . = MAX(., 0x39A0);
        src/game/sys_80076000/code_800E9DA4.c.o(.rodata.D_800749A0 .rdata.D_800749A0);
        . = MAX(., 0x39A4);
        src/game/sys_80076000/code_800E9DA4.c.o(.data.D_800749A4);
        . = MAX(., 0x39A8);
        src/game/sys_80076000/code_800E9DA4.c.o(.rodata.D_800749A8 .rdata.D_800749A8);
        . = MAX(., 0x39AC);
        src/game/sys_80076000/code_800E9DA4.c.o(.data.D_800749AC);
        . = MAX(., 0x39B0);
        . = ALIGN(8) /* src/game/sys_80076000/code_800EC3F0.c.o */;
        src/game/sys_80076000/code_800EC3F0.c.o(.rodata .rdata);
        . = MAX(., 0x39E0);
        src/game/sys_80076000/code_800EC3F0.c.o(.rodata.D_800749E0 .rdata.D_800749E0);
        . = MAX(., 0x39E4);
        src/game/sys_80076000/code_800EC3F0.c.o(.data.D_800749E4);
        . = MAX(., 0x39E8);
        src/game/sys_80076000/code_800EC3F0.c.o(.data.D_800749E8);
        . = MAX(., 0x39F0);
        src/span_1000/800749F0.c.o(.rodata.D_800749F0 .rdata.D_800749F0);
        . = MAX(., 0x39F4);
        src/span_1000/800749F0.c.o(.rodata.D_800749F4 .rdata.D_800749F4);
        . = MAX(., 0x3A04);
        src/span_1000/800749F0.c.o(.data.D_80074A04);
        . = MAX(., 0x3A08);
        src/span_1000/80074A08.c.o(.rodata.D_80074A08 .rdata.D_80074A08);
        . = MAX(., 0x3B04);
        src/span_1000/80074A08.c.o(.rodata.D_80074B04 .rdata.D_80074B04);
        . = MAX(., 0x3B14);
        src/span_1000/80074A08.c.o(.rodata.D_80074B14 .rdata.D_80074B14);
        . = MAX(., 0x3B24);
        src/span_1000/80074A08.c.o(.data.D_80074B24);
        . = MAX(., 0x3B30);
        src/span_1000/80074B30.c.o(.rodata.D_80074B30 .rdata.D_80074B30);
        . = MAX(., 0x3B34);
        src/span_1000/80074B30.c.o(.data.D_80074B34);
        . = MAX(., 0x3B40);
        src/span_1000/80074B40.c.o(.rodata.D_80074B40 .rdata.D_80074B40);
        . = MAX(., 0x3B54);
        src/span_1000/80074B40.c.o(.data.D_80074B54);
        . = MAX(., 0x3B58);
        src/span_1000/80074B58.c.o(.rodata.D_80074B58 .rdata.D_80074B58);
        . = MAX(., 0x3B64);
        src/span_1000/80074B58.c.o(.data.D_80074B64);
        . = MAX(., 0x3B68);
        src/span_1000/80074B68.c.o(.rodata.D_80074B68 .rdata.D_80074B68);
        . = MAX(., 0x3B70);
        src/span_1000/80074B68.c.o(.data.D_80074B70);
        . = MAX(., 0x3BB8);
        src/span_1000/80074BB8.c.o(.rodata.D_80074BB8 .rdata.D_80074BB8);
        . = MAX(., 0x3BC4);
        src/span_1000/80074BB8.c.o(.data.D_80074BC4);
        . = MAX(., 0x3BC8);
        src/span_1000/80074BC8.c.o(.rodata.D_80074BC8 .rdata.D_80074BC8);
        . = MAX(., 0x3BD0);
        src/span_1000/80074BC8.c.o(.rodata.D_80074BD0 .rdata.D_80074BD0);
        . = MAX(., 0x3BE0);
        src/span_1000/80074BC8.c.o(.rodata.D_80074BE0 .rdata.D_80074BE0);
        . = MAX(., 0x3BE8);
        src/span_1000/80074BC8.c.o(.rodata.D_80074BE8 .rdata.D_80074BE8);
        . = MAX(., 0x3BF4);
        src/span_1000/80074BC8.c.o(.rodata.D_80074BF4 .rdata.D_80074BF4);
        . = MAX(., 0x3C04);
        src/span_1000/80074BC8.c.o(.data.D_80074C04);
        . = MAX(., 0x3C20);
        src/span_1000/80074C20.c.o(.rodata.D_80074C20 .rdata.D_80074C20);
        . = MAX(., 0x3C28);
        src/span_1000/80074C20.c.o(.data.D_80074C28);
        . = MAX(., 0x3C74);
        src/span_1000/80074C74.c.o(.rodata.D_80074C74 .rdata.D_80074C74);
        . = MAX(., 0x3C7C);
        src/span_1000/80074C74.c.o(.data.D_80074C7C);
        . = MAX(., 0x3C80);
        . = ALIGN(8) /* src/game/sys_80076000/code_800F0738.c.o */;
        src/game/sys_80076000/code_800F0738.c.o(.rodata .rdata);
        . = MAX(., 0x3D20);
        src/game/sys_80076000/code_800F0738.c.o(.rodata.D_80074D20 .rdata.D_80074D20);
        . = MAX(., 0x3D28);
        src/game/sys_80076000/code_800F0738.c.o(.data.D_80074D28);
        . = MAX(., 0x3DBC);
        src/span_1000/80074DBC.c.o(.rodata.D_80074DBC .rdata.D_80074DBC);
        . = MAX(., 0x3DC4);
        src/span_1000/80074DBC.c.o(.rodata.D_80074DC4 .rdata.D_80074DC4);
        . = MAX(., 0x3DDC);
        src/span_1000/80074DBC.c.o(.rodata.D_80074DDC .rdata.D_80074DDC);
        . = MAX(., 0x3DE0);
        src/span_1000/80074DBC.c.o(.rodata.D_80074DE0 .rdata.D_80074DE0);
        . = MAX(., 0x3DE4);
        src/span_1000/80074DBC.c.o(.data.D_80074DE4);
        . = MAX(., 0x3DE8);
        src/span_1000/80074DBC.c.o(.rodata.D_80074DE8 .rdata.D_80074DE8);
        . = MAX(., 0x3DF4);
        src/span_1000/80074DBC.c.o(.data.D_80074DF4);
        . = MAX(., 0x3DF8);
        src/span_1000/80074DF8.c.o(.rodata.D_80074DF8 .rdata.D_80074DF8);
        . = MAX(., 0x3E00);
        src/span_1000/80074DF8.c.o(.rodata.D_80074E00 .rdata.D_80074E00);
        . = MAX(., 0x3E04);
        src/span_1000/80074DF8.c.o(.rodata.D_80074E04 .rdata.D_80074E04);
        . = MAX(., 0x3E08);
        src/span_1000/80074DF8.c.o(.data.D_80074E08);
        . = MAX(., 0x3E4C);
        src/span_1000/80074E4C.c.o(.rodata.D_80074E4C .rdata.D_80074E4C);
        . = MAX(., 0x3E68);
        src/span_1000/80074E4C.c.o(.data.D_80074E68);
        . = MAX(., 0x3E70);
        src/span_1000/80074E70.c.o(.rodata.D_80074E70 .rdata.D_80074E70);
        . = MAX(., 0x3E78);
        src/span_1000/80074E70.c.o(.rodata.D_80074E78 .rdata.D_80074E78);
        . = MAX(., 0x3E90);
        src/span_1000/80074E70.c.o(.data.D_80074E90);
        . = MAX(., 0x3ED4);
        src/span_1000/80074ED4.c.o(.rodata.D_80074ED4 .rdata.D_80074ED4);
        . = MAX(., 0x3EEC);
        src/game/sys_80076000/code_800F3490.c.o(.rodata .rdata);
        . = MAX(., 0x3F0C);
        src/game/sys_80076000/code_800F3490.c.o(.rodata.D_80074F0C .rdata.D_80074F0C);
        . = MAX(., 0x3F10);
        src/game/sys_80076000/code_800F3490.c.o(.rodata.D_80074F10 .rdata.D_80074F10);
        . = MAX(., 0x3F18);
        src/game/sys_80076000/code_800F3490.c.o(.data.D_80074F18);
        . = MAX(., 0x3F1C);
        src/game/sys_80076000/code_800F3490.c.o(.data.D_80074F1C);
        . = MAX(., 0x3F20);
        . = ALIGN(8) /* src/game/sys_80076000/code_800F3880.c.o */;
        src/game/sys_80076000/code_800F3880.c.o(.rodata .rdata);
        . = MAX(., 0x3F3C);
        src/game/sys_80076000/code_800F3880.c.o(.rodata.D_80074F3C .rdata.D_80074F3C);
        . = MAX(., 0x3F44);
        src/game/sys_80076000/code_800F3880.c.o(.data.D_80074F44);
        . = MAX(., 0x3F50);
        src/span_1000/80074F50.c.o(.rodata.D_80074F50 .rdata.D_80074F50);
        . = MAX(., 0x3F54);
        src/span_1000/80074F50.c.o(.rodata.D_80074F54 .rdata.D_80074F54);
        . = MAX(., 0x3F58);
        src/span_1000/80074F50.c.o(.rodata.D_80074F58 .rdata.D_80074F58);
        . = MAX(., 0x3F5C);
        src/span_1000/80074F50.c.o(.data.D_80074F5C);
        . = MAX(., 0x3F60);
        src/span_1000/80074F60.c.o(.rodata.D_80074F60 .rdata.D_80074F60);
        . = MAX(., 0x3F68);
        src/span_1000/80074F60.c.o(.data.D_80074F68);
        . = MAX(., 0x3F70);
        src/span_1000/80074F60.c.o(.rodata.D_80074F70 .rdata.D_80074F70);
        . = MAX(., 0x3F74);
        src/span_1000/80074F60.c.o(.rodata.D_80074F74 .rdata.D_80074F74);
        . = MAX(., 0x3F78);
        src/span_1000/80074F60.c.o(.rodata.D_80074F78 .rdata.D_80074F78);
        . = MAX(., 0x3F7C);
        src/span_1000/80074F60.c.o(.data.D_80074F7C);
        . = MAX(., 0x3F80);
        src/span_1000/80074F60.c.o(.data.D_80074F80);
        . = MAX(., 0x3F84);
        src/span_1000/80074F60.c.o(.data.D_80074F84);
        . = MAX(., 0x3F88);
        src/span_1000/80074F60.c.o(.data.D_80074F88);
        . = MAX(., 0x3FCC);
        src/span_1000/80074FCC.c.o(.rodata.D_80074FCC .rdata.D_80074FCC);
        . = MAX(., 0x3FFC);
        src/span_1000/80074FCC.c.o(.data.D_80074FFC);
        . = MAX(., 0x4000);
        src/span_1000/80075000.c.o(.rodata.D_80075000 .rdata.D_80075000);
        . = MAX(., 0x4018);
        src/span_1000/80075000.c.o(.rodata.D_80075018 .rdata.D_80075018);
        . = MAX(., 0x4030);
        src/span_1000/80075000.c.o(.rodata.D_80075030 .rdata.D_80075030);
        . = MAX(., 0x4038);
        src/span_1000/80075000.c.o(.rodata.D_80075038 .rdata.D_80075038);
        . = MAX(., 0x4040);
        src/span_1000/80075000.c.o(.rodata.D_80075040 .rdata.D_80075040);
        . = MAX(., 0x4044);
        src/span_1000/80075000.c.o(.rodata.D_80075044 .rdata.D_80075044);
        . = MAX(., 0x4048);
        src/span_1000/80075000.c.o(.rodata.D_80075048 .rdata.D_80075048);
        . = MAX(., 0x404C);
        src/span_1000/80075000.c.o(.rodata.D_8007504C .rdata.D_8007504C);
        . = MAX(., 0x4050);
        src/span_1000/80075000.c.o(.rodata.D_80075050 .rdata.D_80075050);
        . = MAX(., 0x4054);
        src/span_1000/80075000.c.o(.rodata.D_80075054 .rdata.D_80075054);
        . = MAX(., 0x4068);
        src/span_1000/80075000.c.o(.rodata.D_80075068 .rdata.D_80075068);
        . = MAX(., 0x4074);
        src/span_1000/80075000.c.o(.rodata.D_80075074 .rdata.D_80075074);
        . = MAX(., 0x4078);
        src/span_1000/80075000.c.o(.rodata.D_80075078 .rdata.D_80075078);
        . = MAX(., 0x407C);
        src/span_1000/80075000.c.o(.rodata.D_8007507C .rdata.D_8007507C);
        . = MAX(., 0x408C);
        src/span_1000/80075000.c.o(.data.D_8007508C);
        . = MAX(., 0x4090);
        src/span_1000/80075090.c.o(.rodata.D_80075090 .rdata.D_80075090);
        . = MAX(., 0x40A4);
        src/span_1000/80075090.c.o(.data.D_800750A4);
        . = MAX(., 0x40A8);
        src/span_1000/800750A8.c.o(.rodata.D_800750A8 .rdata.D_800750A8);
        . = MAX(., 0x40BC);
        src/span_1000/800750A8.c.o(.rodata.D_800750BC .rdata.D_800750BC);
        . = MAX(., 0x40CC);
        src/span_1000/800750A8.c.o(.rodata.D_800750CC .rdata.D_800750CC);
        . = MAX(., 0x40D4);
        src/span_1000/800750A8.c.o(.rodata.D_800750D4 .rdata.D_800750D4);
        . = MAX(., 0x40D8);
        src/span_1000/800750A8.c.o(.rodata.D_800750D8 .rdata.D_800750D8);
        . = MAX(., 0x40E0);
        src/span_1000/800750A8.c.o(.rodata.D_800750E0 .rdata.D_800750E0);
        . = MAX(., 0x40EC);
        src/span_1000/800750A8.c.o(.rodata.D_800750EC .rdata.D_800750EC);
        . = MAX(., 0x40FC);
        src/span_1000/800750A8.c.o(.rodata.D_800750FC .rdata.D_800750FC);
        . = MAX(., 0x4104);
        src/span_1000/800750A8.c.o(.rodata.D_80075104 .rdata.D_80075104);
        . = MAX(., 0x410C);
        src/span_1000/800750A8.c.o(.rodata.D_8007510C .rdata.D_8007510C);
        . = MAX(., 0x4114);
        src/span_1000/800750A8.c.o(.rodata.D_80075114 .rdata.D_80075114);
        . = MAX(., 0x411C);
        src/span_1000/800750A8.c.o(.rodata.D_8007511C .rdata.D_8007511C);
        . = MAX(., 0x4130);
        src/span_1000/800750A8.c.o(.rodata.D_80075130 .rdata.D_80075130);
        . = MAX(., 0x4170);
        src/span_1000/800750A8.c.o(.rodata.D_80075170 .rdata.D_80075170);
        . = MAX(., 0x4174);
        src/span_1000/800750A8.c.o(.rodata.D_80075174 .rdata.D_80075174);
        . = MAX(., 0x4178);
        src/span_1000/800750A8.c.o(.rodata.D_80075178 .rdata.D_80075178);
        . = MAX(., 0x417C);
        src/span_1000/800750A8.c.o(.data.D_8007517C);
        . = MAX(., 0x4420);
        src/span_1000/80075420.c.o(.rodata.D_80075420 .rdata.D_80075420);
        . = MAX(., 0x4424);
        src/span_1000/80075420.c.o(.rodata.D_80075424 .rdata.D_80075424);
        . = MAX(., 0x4428);
        src/span_1000/80075420.c.o(.rodata.D_80075428 .rdata.D_80075428);
        . = MAX(., 0x4430);
        src/span_1000/80075420.c.o(.rodata.D_80075430 .rdata.D_80075430);
        . = MAX(., 0x4460);
        src/span_1000/80075420.c.o(.rodata.D_80075460 .rdata.D_80075460);
        . = MAX(., 0x4490);
        src/span_1000/80075420.c.o(.rodata.D_80075490 .rdata.D_80075490);
        . = MAX(., 0x4494);
        src/span_1000/80075420.c.o(.rodata.D_80075494 .rdata.D_80075494);
        . = MAX(., 0x44B0);
        src/span_1000/80075420.c.o(.rodata.D_800754B0 .rdata.D_800754B0);
        . = MAX(., 0x44B4);
        src/span_1000/80075420.c.o(.data.D_800754B4);
        . = MAX(., 0x44B8);
        . = ALIGN(8) /* src/game/sys_80076000/code_8010AA6C.c.o */;
        src/game/sys_80076000/code_8010AA6C.c.o(.rodata .rdata);
        . = MAX(., 0x44C0);
        src/game/sys_80076000/code_8010AA6C.c.o(.rodata.D_800754C0 .rdata.D_800754C0);
        . = MAX(., 0x4500);
        . = ALIGN(8) /* src/game/sys_80076000/code_8010BC08.c.o */;
        src/game/sys_80076000/code_8010BC08.c.o(.rodata .rdata);
        . = MAX(., 0x4508);
        src/game/sys_80076000/code_8010BC08.c.o(.data.D_80075508);
        . = MAX(., 0x4510);
        src/span_1000/80075510.c.o(.rodata.D_80075510 .rdata.D_80075510);
        . = MAX(., 0x4514);
        src/game/sys_80076000/code_8010BDA0.c.o(.rodata .rdata);
        . = MAX(., 0x4518);
        src/game/sys_80076000/code_8010BDA0.c.o(.rodata.D_80075518 .rdata.D_80075518);
        . = MAX(., 0x451C);
        src/game/sys_80076000/code_8010BEFC.c.o(.rodata .rdata);
        . = MAX(., 0x4520);
        src/game/sys_80076000/code_8010BEFC.c.o(.data.D_80075520);
        . = MAX(., 0x4564);
        src/span_1000/80075564.c.o(.rodata.D_80075564 .rdata.D_80075564);
        . = MAX(., 0x4588);
        src/span_1000/80075564.c.o(.rodata.D_80075588 .rdata.D_80075588);
        . = MAX(., 0x458C);
        src/span_1000/80075564.c.o(.rodata.D_8007558C .rdata.D_8007558C);
        . = MAX(., 0x4590);
        src/span_1000/80075564.c.o(.rodata.D_80075590 .rdata.D_80075590);
        . = MAX(., 0x45A0);
        src/span_1000/80075564.c.o(.rodata.D_800755A0 .rdata.D_800755A0);
        . = MAX(., 0x45A4);
        src/span_1000/80075564.c.o(.data.D_800755A4);
        . = MAX(., 0x45B0);
        src/span_1000/800755B0.c.o(.rodata.D_800755B0 .rdata.D_800755B0);
        . = MAX(., 0x45B4);
        src/span_1000/800755B0.c.o(.data.D_800755B4);
        . = MAX(., 0x45C0);
        src/span_1000/800755C0.c.o(.rodata.D_800755C0 .rdata.D_800755C0);
        . = MAX(., 0x45C8);
        src/span_1000/800755C0.c.o(.data.D_800755C8);
        . = MAX(., 0x4614);
        src/span_1000/80075614.c.o(.rodata.D_80075614 .rdata.D_80075614);
        . = MAX(., 0x4618);
        . = ALIGN(8) /* src/game/sys_80076000/code_8010DF90.c.o */;
        src/game/sys_80076000/code_8010DF90.c.o(.rodata .rdata);
        . = MAX(., 0x4624);
        src/game/sys_80076000/code_8010DF90.c.o(.data.D_80075624);
        . = MAX(., 0x4930);
        src/span_1000/80075930.c.o(.rodata.D_80075930 .rdata.D_80075930);
        . = MAX(., 0x4948);
        src/span_1000/80075930.c.o(.data.D_80075948);
        . = MAX(., 0x4958);
        src/span_1000/80075958.c.o(.rodata.D_80075958 .rdata.D_80075958);
        . = MAX(., 0x4978);
        src/span_1000/80075958.c.o(.data.D_80075978);
        . = MAX(., 0x4980);
        src/span_1000/80075980.c.o(.rodata.D_80075980 .rdata.D_80075980);
        . = MAX(., 0x4990);
        src/span_1000/80075980.c.o(.data.D_80075990);
        . = MAX(., 0x49F0);
        src/span_1000/800759F0.c.o(.rodata.D_800759F0 .rdata.D_800759F0);
        . = MAX(., 0x49F4);
        src/span_1000/800759F0.c.o(.data.D_800759F4);
        . = MAX(., 0x4A00);
        src/span_1000/80075A00.c.o(.rodata.D_80075A00 .rdata.D_80075A00);
        . = MAX(., 0x4A08);
        src/span_1000/80075A00.c.o(.data.D_80075A08);
        . = MAX(., 0x4A10);
        src/span_1000/80075A10.c.o(.rodata.D_80075A10 .rdata.D_80075A10);
        . = MAX(., 0x4A2C);
        src/span_1000/80075A10.c.o(.data.D_80075A2C);
        . = MAX(., 0x4A30);
        src/span_1000/80075A30.c.o(.rodata.D_80075A30 .rdata.D_80075A30);
        . = MAX(., 0x4A38);
        src/span_1000/80075A30.c.o(.rodata.D_80075A38 .rdata.D_80075A38);
        . = MAX(., 0x4A40);
        src/span_1000/80075A30.c.o(.rodata.D_80075A40 .rdata.D_80075A40);
        . = MAX(., 0x4C18);
        src/span_1000/80075A30.c.o(.rodata.D_80075C18 .rdata.D_80075C18);
        . = MAX(., 0x4C78);
        src/span_1000/80075A30.c.o(.data.D_80075C78);
        . = MAX(., 0x4C80);
        src/span_1000/80075C80.c.o(.rodata.D_80075C80 .rdata.D_80075C80);
        . = MAX(., 0x4C84);
        src/span_1000/80075C80.c.o(.data.D_80075C84);
        . = MAX(., 0x4D18);
        src/span_1000/80075D18.c.o(.rodata.D_80075D18 .rdata.D_80075D18);
        . = MAX(., 0x4D50);
        src/span_1000/80075D18.c.o(.data.D_80075D50);
        . = MAX(., 0x4D60);
        src/span_1000/80075D60.c.o(.rodata.D_80075D60 .rdata.D_80075D60);
        . = MAX(., 0x4D8C);
        src/span_1000/80075D60.c.o(.data.D_80075D8C);
        . = MAX(., 0x4D90);
        src/span_1000/80075D90.c.o(.rodata.D_80075D90 .rdata.D_80075D90);
        . = MAX(., 0x4D9C);
        src/span_1000/80075D90.c.o(.data.D_80075D9C);
        . = MAX(., 0x4DA0);
        src/span_1000/80075DA0.c.o(.rodata.D_80075DA0 .rdata.D_80075DA0);
        . = MAX(., 0x4DA8);
        src/span_1000/80075DA0.c.o(.rodata.D_80075DA8 .rdata.D_80075DA8);
        . = MAX(., 0x4DB0);
        src/span_1000/80075DA0.c.o(.rodata.D_80075DB0 .rdata.D_80075DB0);
        . = MAX(., 0x4DD0);
        src/span_1000/80075DA0.c.o(.rodata.D_80075DD0 .rdata.D_80075DD0);
        . = MAX(., 0x4DE0);
        src/span_1000/80075DA0.c.o(.rodata.D_80075DE0 .rdata.D_80075DE0);
        . = MAX(., 0x4E24);
        src/span_1000/80075DA0.c.o(.data.D_80075E24);
        . = MAX(., 0x4E30);
        src/span_1000/80075E30.c.o(.rodata.D_80075E30 .rdata.D_80075E30);
        . = MAX(., 0x4E54);
        src/span_1000/80075E30.c.o(.data.D_80075E54);
        . = MAX(., 0x4E58);
        src/span_1000/80075E58.c.o(.rodata.D_80075E58 .rdata.D_80075E58);
        . = MAX(., 0x4E60);
        src/span_1000/80075E58.c.o(.data.D_80075E60);
        . = MAX(., 0x4E70);
        src/span_1000/80075E70.c.o(.rodata.D_80075E70 .rdata.D_80075E70);
        . = MAX(., 0x4E98);
        src/span_1000/80075E70.c.o(.data.D_80075E98);
        . = MAX(., 0x4EA4);
        src/span_1000/80075EA4.c.o(.rodata.D_80075EA4 .rdata.D_80075EA4);
        . = MAX(., 0x4EAC);
        src/span_1000/80075EA4.c.o(.data.D_80075EAC);
        . = MAX(., 0x4EC4);
        src/span_1000/80075EC4.c.o(.rodata.D_80075EC4 .rdata.D_80075EC4);
        . = MAX(., 0x4F94);
        src/span_1000/80075EC4.c.o(.data.D_80075F94);
        . = MAX(., 0x4FA0);
        src/span_1000/80075FA0.c.o(.rodata.D_80075FA0 .rdata.D_80075FA0);
        . = MAX(., 0x4FA4);
        src/span_1000/80075FA0.c.o(.data.D_80075FA4);
        . = MAX(., 0x4FE8);
        src/span_1000/80075FE8.c.o(.rodata.D_80075FE8 .rdata.D_80075FE8);
        . = MAX(., 0x4FF0);
        src/span_1000/80075FE8.c.o(.data.D_80075FF0);
        . = MAX(., 0x4FF8);
        src/span_1000/80075FF8.c.o(.rodata.D_80075FF8 .rdata.D_80075FF8);
        . = MAX(., 0x5000);
        src/game/sys_80076000/code_80076000.c.o(.text);
        src/game/sys_80076000/code_80076000.c.o(.rodata .rdata);
        . = MAX(., 0x58E4);
        src/game/sys_80076000/code_800768E4.c.o(.text);
        . = MAX(., 0x6098);
        src/span_1000/80077098.c.o(.data.D_80077098);
        . = MAX(., 0x60B4);
        src/span_1000/80077098.c.o(.data.D_800770B4);
        . = MAX(., 0x60B8);
        src/span_1000/80077098.c.o(.data.D_800770B8);
        . = MAX(., 0x60EC);
        src/span_1000/80077098.c.o(.data.D_800770EC);
        . = MAX(., 0x60F0);
        src/span_1000/80077098.c.o(.data.D_800770F0);
        . = MAX(., 0x6110);
        src/game/sys_80076000/code_80077110.c.o(.text);
        src/game/sys_80076000/code_80077110.c.o(.rodata .rdata);
        . = MAX(., 0x6B08);
        src/game/sys_80076000/code_80077110.c.o(.data.D_80077B08);
        . = MAX(., 0x6B10);
        src/game/sys_80076000/code_80077B10.c.o(.text);
        src/game/sys_80076000/code_80077B10.c.o(.rodata .rdata);
        . = MAX(., 0x7F60);
        src/game/sys_80076000/code_80078F60.c.o(.text);
        . = MAX(., 0x85A8);
        src/span_1000/800795A8.c.o(.data.D_800795A8);
        . = MAX(., 0x85B0);
        src/game/sys_80076000/code_800795B0.c.o(.text);
        src/game/sys_80076000/code_800795B0.c.o(.rodata .rdata);
        . = MAX(., 0x861C);
        src/game/sys_80076000/code_8007961C.c.o(.text);
        src/game/sys_80076000/code_8007961C.c.o(.rodata .rdata);
        . = MAX(., 0x867C);
        src/game/sys_80076000/code_8007967C.c.o(.text);
        src/game/sys_80076000/code_8007967C.c.o(.rodata .rdata);
        . = MAX(., 0x86B4);
        src/game/sys_80076000/code_800796B4.c.o(.text);
        src/game/sys_80076000/code_800796B4.c.o(.rodata .rdata);
        . = MAX(., 0x88C0);
        src/game/sys_80076000/code_800798C0.c.o(.text);
        src/game/sys_80076000/code_800798C0.c.o(.rodata .rdata);
        . = MAX(., 0x89C0);
        src/game/sys_80076000/code_800799C0.c.o(.text);
        src/game/sys_80076000/code_800799C0.c.o(.rodata .rdata);
        . = MAX(., 0x8A5C);
        src/game/sys_80076000/code_80079A5C.c.o(.text);
        src/game/sys_80076000/code_80079A5C.c.o(.rodata .rdata);
        . = MAX(., 0x8BB4);
        src/game/sys_80076000/code_80079BB4.c.o(.text);
        src/game/sys_80076000/code_80079BB4.c.o(.rodata .rdata);
        . = MAX(., 0x8BF4);
        src/game/sys_80076000/code_80079BF4.c.o(.text);
        src/game/sys_80076000/code_80079BF4.c.o(.rodata .rdata);
        . = MAX(., 0x8D58);
        src/game/sys_80076000/code_80079D58.c.o(.text);
        src/game/sys_80076000/code_80079D58.c.o(.rodata .rdata);
        . = MAX(., 0x8D9C);
        src/game/sys_80076000/code_80079D9C.c.o(.text);
        src/game/sys_80076000/code_80079D9C.c.o(.rodata .rdata);
        . = MAX(., 0x8EFC);
        src/game/sys_80076000/code_80079EFC.c.o(.text);
        src/game/sys_80076000/code_80079EFC.c.o(.rodata .rdata);
        . = MAX(., 0x9470);
        src/game/sys_80076000/code_8007A470.c.o(.text);
        src/game/sys_80076000/code_8007A470.c.o(.rodata .rdata);
        . = MAX(., 0x95A4);
        src/game/sys_80076000/code_8007A5A4.c.o(.text);
        src/game/sys_80076000/code_8007A5A4.c.o(.rodata .rdata);
        . = MAX(., 0x9758);
        src/game/sys_80076000/code_8007A758.c.o(.text);
        src/game/sys_80076000/code_8007A758.c.o(.rodata .rdata);
        . = MAX(., 0x979C);
        src/game/sys_80076000/code_8007A79C.c.o(.text);
        src/game/sys_80076000/code_8007A79C.c.o(.rodata .rdata);
        . = MAX(., 0x9968);
        src/game/sys_80076000/code_8007A968.c.o(.text);
        src/game/sys_80076000/code_8007A968.c.o(.rodata .rdata);
        . = MAX(., 0x9A70);
        src/game/sys_80076000/code_8007AA70.c.o(.text);
        src/game/sys_80076000/code_8007AA70.c.o(.rodata .rdata);
        . = MAX(., 0x9C20);
        src/game/sys_80076000/code_8007AC20.c.o(.text);
        src/game/sys_80076000/code_8007AC20.c.o(.rodata .rdata);
        . = MAX(., 0x9CC4);
        src/game/sys_80076000/code_8007ACC4.c.o(.text);
        src/game/sys_80076000/code_8007ACC4.c.o(.rodata .rdata);
        . = MAX(., 0x9D2C);
        src/game/sys_80076000/code_8007AD2C.c.o(.text);
        . = MAX(., 0xB58C);
        src/game/sys_80076000/code_8007C58C.c.o(.text);
        . = MAX(., 0xC2A0);
        src/game/sys_80076000/code_8007D2A0.c.o(.text);
        . = MAX(., 0xC42C);
        src/span_1000/8007D42C.c.o(.data.D_8007D42C);
        . = MAX(., 0xC430);
        src/game/sys_80076000/code_8007D430.c.o(.text);
        src/game/sys_80076000/code_8007D430.c.o(.rodata .rdata);
        . = MAX(., 0xD138);
        src/game/sys_80076000/code_8007D430.c.o(.data.D_8007E138);
        . = MAX(., 0xD140);
        src/game/sys_80076000/code_8007E140.c.o(.text);
        src/game/sys_80076000/code_8007E140.c.o(.rodata .rdata);
        . = MAX(., 0x12394);
        src/game/sys_80076000/code_80083394.c.o(.text);
        . = MAX(., 0x1533C);
        src/span_1000/8008633C.c.o(.data.D_8008633C);
        . = MAX(., 0x15378);
        src/game/sys_80076000/code_80086378.c.o(.text);
        src/game/sys_80076000/code_80086378.c.o(.rodata .rdata);
        . = MAX(., 0x153F4);
        src/game/sys_80076000/code_800863F4.c.o(.text);
        . = MAX(., 0x15B48);
        src/game/sys_80076000/code_80086B48.c.o(.text);
        . = MAX(., 0x17590);
        src/game/sys_80076000/code_80088590.c.o(.text);
        . = MAX(., 0x19D0C);
        src/span_1000/8008AD0C.c.o(.data.D_8008AD0C);
        . = MAX(., 0x19D10);
        src/game/sys_80076000/code_8008AD10.c.o(.text);
        src/game/sys_80076000/code_8008AD10.c.o(.rodata .rdata);
        . = MAX(., 0x19DE0);
        src/game/sys_80076000/code_8008ADE0.c.o(.text);
        . = MAX(., 0x1DC78);
        src/span_1000/8008EC78.c.o(.data.D_8008EC78);
        . = MAX(., 0x1DC80);
        src/game/sys_80076000/code_8008EC80.c.o(.text);
        src/game/sys_80076000/code_8008EC80.c.o(.rodata .rdata);
        . = MAX(., 0x1E040);
        src/game/sys_80076000/code_8008F040.c.o(.text);
        . = MAX(., 0x1FED8);
        src/span_1000/80090ED8.c.o(.data.D_80090ED8);
        . = MAX(., 0x1FEE0);
        src/game/sys_80076000/code_80090EE0.c.o(.text);
        src/game/sys_80076000/code_80090EE0.c.o(.rodata .rdata);
        . = MAX(., 0x2076C);
        src/game/sys_80076000/code_80090EE0.c.o(.data.D_8009176C);
        . = MAX(., 0x207C4);
        src/game/sys_80076000/code_800917C4.c.o(.text);
        src/game/sys_80076000/code_800917C4.c.o(.rodata .rdata);
        . = MAX(., 0x22D2C);
        src/game/sys_80076000/code_800917C4.c.o(.data.D_80093D2C);
        . = MAX(., 0x22D30);
        src/game/sys_80076000/code_80093D30.c.o(.text);
        src/game/sys_80076000/code_80093D30.c.o(.rodata .rdata);
        . = MAX(., 0x2305C);
        src/game/sys_80076000/code_80093D30.c.o(.data.D_8009405C);
        . = MAX(., 0x23060);
        src/game/sys_80076000/code_80094060.c.o(.text);
        src/game/sys_80076000/code_80094060.c.o(.rodata .rdata);
        . = MAX(., 0x232A8);
        src/game/sys_80076000/code_800942A8.c.o(.text);
        . = MAX(., 0x239B8);
        src/game/sys_80076000/code_800949B8.c.o(.text);
        src/game/sys_80076000/code_800949B8.c.o(.rodata .rdata);
        . = MAX(., 0x239D8);
        src/game/sys_80076000/code_800949D8.c.o(.text);
        src/game/sys_80076000/code_800949D8.c.o(.rodata .rdata);
        . = MAX(., 0x23C58);
        src/game/sys_80076000/code_80094C58.c.o(.text);
        . = MAX(., 0x2431C);
        src/game/sys_80076000/code_8009531C.c.o(.text);
        src/game/sys_80076000/code_8009531C.c.o(.rodata .rdata);
        . = MAX(., 0x243AC);
        src/game/sys_80076000/code_800953AC.c.o(.text);
        src/game/sys_80076000/code_800953AC.c.o(.rodata .rdata);
        . = MAX(., 0x24EAC);
        src/game/sys_80076000/code_80095EAC.c.o(.text);
        src/game/sys_80076000/code_80095EAC.c.o(.rodata .rdata);
        . = MAX(., 0x25760);
        src/game/sys_80076000/code_80096760.c.o(.text);
        src/game/sys_80076000/code_80096760.c.o(.rodata .rdata);
        . = MAX(., 0x25784);
        src/game/sys_80076000/code_80096784.c.o(.text);
        src/game/sys_80076000/code_80096784.c.o(.rodata .rdata);
        . = MAX(., 0x25834);
        src/game/sys_80076000/code_80096834.c.o(.text);
        src/game/sys_80076000/code_80096834.c.o(.rodata .rdata);
        . = MAX(., 0x25E74);
        src/game/sys_80076000/code_80096834.c.o(.data.D_80096E74);
        . = MAX(., 0x25E80);
        src/game/sys_80076000/code_80096E80.c.o(.text);
        src/game/sys_80076000/code_80096E80.c.o(.rodata .rdata);
        . = MAX(., 0x26C24);
        src/game/sys_80076000/code_80097C24.c.o(.text);
        src/game/sys_80076000/code_80097C24.c.o(.rodata .rdata);
        . = MAX(., 0x26C64);
        src/game/sys_80076000/code_80097C64.c.o(.text);
        src/game/sys_80076000/code_80097C64.c.o(.rodata .rdata);
        . = MAX(., 0x2D39C);
        src/game/sys_80076000/code_8009E39C.c.o(.text);
        src/game/sys_80076000/code_8009E39C.c.o(.rodata .rdata);
        . = MAX(., 0x2D3A4);
        src/game/sys_80076000/code_8009E3A4.c.o(.text);
        src/game/sys_80076000/code_8009E3A4.c.o(.rodata .rdata);
        . = MAX(., 0x2EB8C);
        src/game/sys_80076000/code_8009FB8C.c.o(.text);
        src/game/sys_80076000/code_8009FB8C.c.o(.rodata .rdata);
        . = MAX(., 0x2F3F8);
        src/game/sys_80076000/code_8009FB8C.c.o(.data.D_800A03F8);
        . = MAX(., 0x2F400);
        src/game/sys_80076000/code_800A0400.c.o(.text);
        src/game/sys_80076000/code_800A0400.c.o(.rodata .rdata);
        . = MAX(., 0x2FCD4);
        src/game/sys_80076000/code_800A0400.c.o(.data.D_800A0CD4);
        . = MAX(., 0x30170);
        src/game/sys_80076000/code_800A1170.c.o(.text);
        src/game/sys_80076000/code_800A1170.c.o(.rodata .rdata);
        . = MAX(., 0x31F48);
        src/game/sys_80076000/code_800A1170.c.o(.data.D_800A2F48);
        . = MAX(., 0x32070);
        src/game/sys_80076000/code_800A3070.c.o(.text);
        src/game/sys_80076000/code_800A3070.c.o(.rodata .rdata);
        . = MAX(., 0x320A8);
        src/game/sys_80076000/code_800A30A8.c.o(.text);
        src/game/sys_80076000/code_800A30A8.c.o(.rodata .rdata);
        . = MAX(., 0x332BC);
        src/game/sys_80076000/code_800A42BC.c.o(.text);
        src/game/sys_80076000/code_800A42BC.c.o(.rodata .rdata);
        . = MAX(., 0x332C4);
        src/game/sys_80076000/code_800A42C4.c.o(.text);
        src/game/sys_80076000/code_800A42C4.c.o(.rodata .rdata);
        . = MAX(., 0x33D10);
        src/game/sys_80076000/code_800A4D10.c.o(.text);
        src/game/sys_80076000/code_800A4D10.c.o(.rodata .rdata);
        . = MAX(., 0x33D34);
        src/game/sys_80076000/code_800A4D34.c.o(.text);
        src/game/sys_80076000/code_800A4D34.c.o(.rodata .rdata);
        . = MAX(., 0x34FE4);
        src/game/sys_80076000/code_800A4D34.c.o(.data.D_800A5FE4);
        . = MAX(., 0x34FF0);
        src/game/sys_80076000/code_800A5FF0.c.o(.text);
        src/game/sys_80076000/code_800A5FF0.c.o(.rodata .rdata);
        . = MAX(., 0x35798);
        src/game/sys_80076000/code_800A6798.c.o(.text);
        src/game/sys_80076000/code_800A6798.c.o(.rodata .rdata);
        . = MAX(., 0x36648);
        src/game/sys_80076000/code_800A6798.c.o(.data.D_800A7648);
        . = MAX(., 0x36650);
        src/game/sys_80076000/code_800A7650.c.o(.text);
        src/game/sys_80076000/code_800A7650.c.o(.rodata .rdata);
        . = MAX(., 0x366A0);
        src/game/sys_80076000/code_800A76A0.c.o(.text);
        src/game/sys_80076000/code_800A76A0.c.o(.rodata .rdata);
        . = MAX(., 0x366BC);
        src/game/sys_80076000/code_800A76BC.c.o(.text);
        src/game/sys_80076000/code_800A76BC.c.o(.rodata .rdata);
        . = MAX(., 0x36ABC);
        src/game/sys_80076000/code_800A7ABC.c.o(.text);
        src/game/sys_80076000/code_800A7ABC.c.o(.rodata .rdata);
        . = MAX(., 0x3741C);
        src/game/sys_80076000/code_800A841C.c.o(.text);
        src/game/sys_80076000/code_800A841C.c.o(.rodata .rdata);
        . = MAX(., 0x37940);
        src/game/sys_80076000/code_800A8940.c.o(.text);
        src/game/sys_80076000/code_800A8940.c.o(.rodata .rdata);
        . = MAX(., 0x38C14);
        src/game/sys_80076000/code_800A8940.c.o(.data.D_800A9C14);
        . = MAX(., 0x38C20);
        src/game/sys_80076000/code_800A9C20.c.o(.text);
        src/game/sys_80076000/code_800A9C20.c.o(.rodata .rdata);
        . = MAX(., 0x38CC4);
        src/game/sys_80076000/code_800A9CC4.c.o(.text);
        src/game/sys_80076000/code_800A9CC4.c.o(.rodata .rdata);
        . = MAX(., 0x38D40);
        src/game/sys_80076000/code_800A9D40.c.o(.text);
        src/game/sys_80076000/code_800A9D40.c.o(.rodata .rdata);
        . = MAX(., 0x38DA8);
        src/game/sys_80076000/code_800A9DA8.c.o(.text);
        src/game/sys_80076000/code_800A9DA8.c.o(.rodata .rdata);
        . = MAX(., 0x38EE0);
        src/game/sys_80076000/code_800A9EE0.c.o(.text);
        src/game/sys_80076000/code_800A9EE0.c.o(.rodata .rdata);
        . = MAX(., 0x38F80);
        src/game/sys_80076000/code_800A9F80.c.o(.text);
        src/game/sys_80076000/code_800A9F80.c.o(.rodata .rdata);
        . = MAX(., 0x39168);
        src/game/sys_80076000/code_800AA168.c.o(.text);
        src/game/sys_80076000/code_800AA168.c.o(.rodata .rdata);
        . = MAX(., 0x39280);
        src/game/sys_80076000/code_800AA280.c.o(.text);
        src/game/sys_80076000/code_800AA280.c.o(.rodata .rdata);
        . = MAX(., 0x39518);
        src/game/sys_80076000/code_800AA518.c.o(.text);
        src/game/sys_80076000/code_800AA518.c.o(.rodata .rdata);
        . = MAX(., 0x3A200);
        src/game/sys_80076000/code_800AB200.c.o(.text);
        src/game/sys_80076000/code_800AB200.c.o(.rodata .rdata);
        . = MAX(., 0x3A520);
        src/game/sys_80076000/code_800AB520.c.o(.text);
        src/game/sys_80076000/code_800AB520.c.o(.rodata .rdata);
        . = MAX(., 0x3A614);
        src/game/sys_80076000/code_800AB614.c.o(.text);
        src/game/sys_80076000/code_800AB614.c.o(.rodata .rdata);
        . = MAX(., 0x3A65C);
        src/game/sys_80076000/code_800AB65C.c.o(.text);
        src/game/sys_80076000/code_800AB65C.c.o(.rodata .rdata);
        . = MAX(., 0x3A91C);
        src/game/sys_80076000/code_800AB91C.c.o(.text);
        . = MAX(., 0x40520);
        src/game/sys_80076000/code_800B1520.c.o(.text);
        . = MAX(., 0x4750C);
        src/game/sys_80076000/code_800B850C.c.o(.text);
        src/game/sys_80076000/code_800B850C.c.o(.rodata .rdata);
        . = MAX(., 0x47750);
        src/game/sys_80076000/code_800B8750.c.o(.text);
        . = MAX(., 0x48C0C);
        src/game/sys_80076000/code_800B9C0C.c.o(.text);
        src/game/sys_80076000/code_800B9C0C.c.o(.rodata .rdata);
        . = MAX(., 0x48C34);
        src/game/sys_80076000/code_800B9C34.c.o(.text);
        src/game/sys_80076000/code_800B9C34.c.o(.rodata .rdata);
        . = MAX(., 0x4B214);
        src/game/sys_80076000/code_800BC214.c.o(.text);
        src/game/sys_80076000/code_800BC214.c.o(.rodata .rdata);
        . = MAX(., 0x4B448);
        src/game/sys_80076000/code_800BC448.c.o(.text);
        . = MAX(., 0x4C1F0);
        src/game/sys_80076000/code_800BD1F0.c.o(.text);
        src/game/sys_80076000/code_800BD1F0.c.o(.rodata .rdata);
        . = MAX(., 0x4EF68);
        src/game/sys_80076000/code_800BFF68.c.o(.text);
        . = MAX(., 0x4F880);
        src/game/sys_80076000/code_800C0880.c.o(.text);
        src/game/sys_80076000/code_800C0880.c.o(.rodata .rdata);
        . = MAX(., 0x52730);
        src/game/sys_80076000/code_800C3730.c.o(.text);
        . = MAX(., 0x544F0);
        src/game/sys_80076000/code_800C54F0.c.o(.text);
        src/game/sys_80076000/code_800C54F0.c.o(.rodata .rdata);
        . = MAX(., 0x54B90);
        src/game/sys_80076000/code_800C5B90.c.o(.text);
        src/game/sys_80076000/code_800C5B90.c.o(.rodata .rdata);
        . = MAX(., 0x5D214);
        src/game/sys_80076000/code_800CE214.c.o(.text);
        . = MAX(., 0x5FD28);
        src/span_1000/800D0D28.c.o(.data.D_800D0D28);
        . = MAX(., 0x5FD30);
        src/game/sys_80076000/code_800D0D30.c.o(.text);
        src/game/sys_80076000/code_800D0D30.c.o(.rodata .rdata);
        . = MAX(., 0x60404);
        src/game/sys_80076000/code_800D0D30.c.o(.data.D_800D1404);
        . = MAX(., 0x6053C);
        src/game/sys_80076000/code_800D153C.c.o(.text);
        src/game/sys_80076000/code_800D153C.c.o(.rodata .rdata);
        . = MAX(., 0x60EBC);
        src/game/sys_80076000/code_800D1EBC.c.o(.text);
        . = MAX(., 0x68074);
        src/span_1000/800D9074.c.o(.data.D_800D9074);
        . = MAX(., 0x68080);
        src/game/sys_80076000/code_800D9080.c.o(.text);
        src/game/sys_80076000/code_800D9080.c.o(.rodata .rdata);
        . = MAX(., 0x6C798);
        src/game/sys_80076000/code_800D9080.c.o(.data.D_800DD798);
        . = MAX(., 0x6C970);
        src/game/sys_80076000/code_800DD970.c.o(.text);
        src/game/sys_80076000/code_800DD970.c.o(.rodata .rdata);
        . = MAX(., 0x6CC5C);
        src/game/sys_80076000/code_800DD970.c.o(.data.D_800DDC5C);
        . = MAX(., 0x6CC60);
        src/game/sys_80076000/code_800DDC60.c.o(.text);
        src/game/sys_80076000/code_800DDC60.c.o(.rodata .rdata);
        . = MAX(., 0x6E214);
        src/game/sys_80076000/code_800DF214.c.o(.text);
        . = MAX(., 0x6FB00);
        src/game/sys_80076000/code_800E0B00.c.o(.text);
        . = MAX(., 0x70A14);
        src/span_1000/800E1A14.c.o(.data.D_800E1A14);
        . = MAX(., 0x70A20);
        src/game/sys_80076000/code_800E1A20.c.o(.text);
        src/game/sys_80076000/code_800E1A20.c.o(.rodata .rdata);
        . = MAX(., 0x71ACC);
        src/game/sys_80076000/code_800E2ACC.c.o(.text);
        . = MAX(., 0x72C18);
        src/game/sys_80076000/code_800E3C18.c.o(.text);
        src/game/sys_80076000/code_800E3C18.c.o(.rodata .rdata);
        . = MAX(., 0x72C34);
        src/game/sys_80076000/code_800E3C34.c.o(.text);
        src/game/sys_80076000/code_800E3C34.c.o(.rodata .rdata);
        . = MAX(., 0x7381C);
        src/game/sys_80076000/code_800E3C34.c.o(.data.D_800E481C);
        . = MAX(., 0x73820);
        src/game/sys_80076000/code_800E4820.c.o(.text);
        src/game/sys_80076000/code_800E4820.c.o(.rodata .rdata);
        . = MAX(., 0x7429C);
        src/game/sys_80076000/code_800E4820.c.o(.data.D_800E529C);
        . = MAX(., 0x742A0);
        src/game/sys_80076000/code_800E52A0.c.o(.text);
        src/game/sys_80076000/code_800E52A0.c.o(.rodata .rdata);
        . = MAX(., 0x75C14);
        src/game/sys_80076000/code_800E6C14.c.o(.text);
        . = MAX(., 0x75C5C);
        src/game/sys_80076000/code_800E6C5C.c.o(.text);
        src/game/sys_80076000/code_800E6C5C.c.o(.rodata .rdata);
        . = MAX(., 0x75C80);
        src/game/sys_80076000/code_800E6C80.c.o(.text);
        src/game/sys_80076000/code_800E6C80.c.o(.rodata .rdata);
        . = MAX(., 0x75CA4);
        src/game/sys_80076000/code_800E6CA4.c.o(.text);
        . = MAX(., 0x766D0);
        src/game/sys_80076000/code_800E76D0.c.o(.text);
        . = MAX(., 0x7767C);
        src/game/sys_80076000/code_800E867C.c.o(.text);
        . = MAX(., 0x776C8);
        src/game/sys_80076000/code_800E86C8.c.o(.text);
        . = MAX(., 0x77740);
        src/game/sys_80076000/code_800E8740.c.o(.text);
        . = MAX(., 0x77DFC);
        src/game/sys_80076000/code_800E8DFC.c.o(.text);
        . = MAX(., 0x782F0);
        src/game/sys_80076000/code_800E92F0.c.o(.text);
        . = MAX(., 0x78538);
        src/game/sys_80076000/code_800E9538.c.o(.text);
        . = MAX(., 0x785A8);
        src/game/sys_80076000/code_800E95A8.c.o(.text);
        src/game/sys_80076000/code_800E95A8.c.o(.rodata .rdata);
        . = MAX(., 0x787F0);
        src/game/sys_80076000/code_800E97F0.c.o(.text);
        src/game/sys_80076000/code_800E97F0.c.o(.rodata .rdata);
        . = MAX(., 0x78880);
        src/game/sys_80076000/code_800E9880.c.o(.text);
        src/game/sys_80076000/code_800E9880.c.o(.rodata .rdata);
        . = MAX(., 0x78894);
        src/game/sys_80076000/code_800E9894.c.o(.text);
        src/game/sys_80076000/code_800E9894.c.o(.rodata .rdata);
        . = MAX(., 0x789D4);
        src/game/sys_80076000/code_800E99D4.c.o(.text);
        src/game/sys_80076000/code_800E99D4.c.o(.rodata .rdata);
        . = MAX(., 0x789E0);
        src/game/sys_80076000/code_800E99E0.c.o(.text);
        src/game/sys_80076000/code_800E99E0.c.o(.rodata .rdata);
        . = MAX(., 0x78B9C);
        src/game/sys_80076000/code_800E9B9C.c.o(.text);
        . = MAX(., 0x78DA4);
        src/game/sys_80076000/code_800E9DA4.c.o(.text);
        . = MAX(., 0x79BA8);
        src/span_1000/800EABA8.c.o(.data.D_800EABA8);
        . = MAX(., 0x79BB0);
        src/game/sys_80076000/code_800EABB0.c.o(.text);
        src/game/sys_80076000/code_800EABB0.c.o(.rodata .rdata);
        . = MAX(., 0x7B3F0);
        src/game/sys_80076000/code_800EC3F0.c.o(.text);
        . = MAX(., 0x7BC04);
        src/span_1000/800ECC04.c.o(.data.D_800ECC04);
        . = MAX(., 0x7BC1C);
        src/game/sys_80076000/code_800ECC1C.c.o(.text);
        src/game/sys_80076000/code_800ECC1C.c.o(.rodata .rdata);
        . = MAX(., 0x7CB20);
        src/game/sys_80076000/code_800EDB20.c.o(.text);
        src/game/sys_80076000/code_800EDB20.c.o(.rodata .rdata);
        . = MAX(., 0x7E2D0);
        src/game/sys_80076000/code_800EF2D0.c.o(.text);
        src/game/sys_80076000/code_800EF2D0.c.o(.rodata .rdata);
        . = MAX(., 0x7F1D0);
        src/game/sys_80076000/code_800F01D0.c.o(.text);
        src/game/sys_80076000/code_800F01D0.c.o(.rodata .rdata);
        . = MAX(., 0x7F738);
        src/game/sys_80076000/code_800F0738.c.o(.text);
        . = MAX(., 0x81004);
        src/span_1000/800F2004.c.o(.data.D_800F2004);
        . = MAX(., 0x81010);
        src/game/sys_80076000/code_800F2010.c.o(.text);
        src/game/sys_80076000/code_800F2010.c.o(.rodata .rdata);
        . = MAX(., 0x82490);
        src/game/sys_80076000/code_800F3490.c.o(.text);
        . = MAX(., 0x82880);
        src/game/sys_80076000/code_800F3880.c.o(.text);
        . = MAX(., 0x82A14);
        src/game/sys_80076000/code_800F3A14.c.o(.text);
        src/game/sys_80076000/code_800F3A14.c.o(.rodata .rdata);
        . = MAX(., 0x82AE0);
        src/game/sys_80076000/code_800F3AE0.c.o(.text);
        src/game/sys_80076000/code_800F3AE0.c.o(.rodata .rdata);
        . = MAX(., 0x835C8);
        src/game/sys_80076000/code_800F45C8.c.o(.text);
        src/game/sys_80076000/code_800F45C8.c.o(.rodata .rdata);
        . = MAX(., 0x84128);
        src/game/sys_80076000/code_800F5128.c.o(.text);
        src/game/sys_80076000/code_800F5128.c.o(.rodata .rdata);
        . = MAX(., 0x9427C);
        src/game/sys_80076000/code_8010527C.c.o(.text);
        src/game/sys_80076000/code_8010527C.c.o(.rodata .rdata);
        . = MAX(., 0x943B0);
        src/game/sys_80076000/code_801053B0.c.o(.text);
        src/game/sys_80076000/code_801053B0.c.o(.rodata .rdata);
        . = MAX(., 0x944C0);
        src/game/sys_80076000/code_801054C0.c.o(.text);
        src/game/sys_80076000/code_801054C0.c.o(.rodata .rdata);
        . = MAX(., 0x9452C);
        src/game/sys_80076000/code_8010552C.c.o(.text);
        src/game/sys_80076000/code_8010552C.c.o(.rodata .rdata);
        . = MAX(., 0x94750);
        src/game/sys_80076000/code_80105750.c.o(.text);
        src/game/sys_80076000/code_80105750.c.o(.rodata .rdata);
        . = MAX(., 0x94C68);
        src/game/sys_80076000/code_80105C68.c.o(.text);
        src/game/sys_80076000/code_80105C68.c.o(.rodata .rdata);
        . = MAX(., 0x94D90);
        src/game/sys_80076000/code_80105D90.c.o(.text);
        src/game/sys_80076000/code_80105D90.c.o(.rodata .rdata);
        . = MAX(., 0x95B28);
        src/game/sys_80076000/code_80106B28.c.o(.text);
        src/game/sys_80076000/code_80106B28.c.o(.rodata .rdata);
        . = MAX(., 0x95B54);
        src/game/sys_80076000/code_80106B28.c.o(.data.D_80106B54);
        . = MAX(., 0x95B60);
        src/game/sys_80076000/code_80106B60.c.o(.text);
        src/game/sys_80076000/code_80106B60.c.o(.rodata .rdata);
        . = MAX(., 0x99A6C);
        src/game/sys_80076000/code_8010AA6C.c.o(.text);
        . = MAX(., 0x9AC08);
        src/game/sys_80076000/code_8010BC08.c.o(.text);
        . = MAX(., 0x9ADA0);
        src/game/sys_80076000/code_8010BDA0.c.o(.text);
        . = MAX(., 0x9AEFC);
        src/game/sys_80076000/code_8010BEFC.c.o(.text);
        . = MAX(., 0x9BB5C);
        src/span_1000/8010CB5C.c.o(.data.D_8010CB5C);
        . = MAX(., 0x9BB60);
        src/game/sys_80076000/code_8010CB60.c.o(.text);
        src/game/sys_80076000/code_8010CB60.c.o(.rodata .rdata);
        . = MAX(., 0x9C844);
        src/game/sys_80076000/code_8010CB60.c.o(.data.D_8010D844);
        . = MAX(., 0x9C850);
        src/game/sys_80076000/code_8010D850.c.o(.text);
        src/game/sys_80076000/code_8010D850.c.o(.rodata .rdata);
        . = MAX(., 0x9CF90);
        src/game/sys_80076000/code_8010DF90.c.o(.text);
        . = MAX(., 0x9D158);
        src/span_1000/8010E158.c.o(.data.D_8010E158);
        . = MAX(., 0x9D160);
        src/span_1000/8010E158.c.o(.data.D_8010E160);
        . = MAX(., 0x9D230);
        src/span_1000/8010E158.c.o(.data.D_8010E230);
        . = MAX(., 0x9E660);
        src/span_1000/8010E158.c.o(.data.D_8010F660);
        . = MAX(., 0x9F480);
        src/sdk/libultra/code_80110480.c.o(.text);
        src/sdk/libultra/code_80110480.c.o(.rodata .rdata);
        . = MAX(., 0x9F48C);
        src/sdk/libultra/code_80110480.c.o(.data.D_8011048C);
        . = MAX(., 0x9F490);
        src/sdk/libultra/code_80110490.c.o(.text);
        src/sdk/libultra/code_80110490.c.o(.rodata .rdata);
        . = MAX(., 0x9F6A0);
        src/sdk/libultra/bcopy.s.o(.text);
        src/sdk/libultra/bcopy.s.o(.rodata .rdata);
        . = MAX(., 0x9F9B8);
        src/sdk/libultra/code_801106A0.c.o(.text);
        src/sdk/libultra/code_801106A0.c.o(.rodata .rdata);
        . = MAX(., 0x9FC00);
        src/sdk/libultra/code_80110C00.c.o(.text);
        src/sdk/libultra/code_80110C00.c.o(.rodata .rdata);
        . = MAX(., 0x9FCA0);
        src/sdk/libultra/code_80110CA0.c.o(.text);
        src/sdk/libultra/code_80110CA0.c.o(.rodata .rdata);
        . = MAX(., 0x9FD24);
        src/sdk/libultra/code_80110CA0_80110D24.c.o(.text);
        src/sdk/libultra/code_80110CA0_80110D24.c.o(.rodata .rdata);
        . = MAX(., 0x9FD50);
        src/sdk/libultra/code_80110D50.c.o(.text);
        src/sdk/libultra/code_80110D50.c.o(.rodata .rdata);
        . = MAX(., 0x9FFE0);
        src/sdk/libultra/code_80110FE0.c.o(.text);
        src/sdk/libultra/code_80110FE0.c.o(.rodata .rdata);
        . = MAX(., 0xA03A0);
        src/sdk/libm/code_801113A0.c.o(.text);
        src/sdk/libm/code_801113A0.c.o(.rodata .rdata);
        . = MAX(., 0xA0510);
        src/sdk/libultra/code_80111510.c.o(.text);
        src/sdk/libultra/code_80111510.c.o(.rodata .rdata);
        . = MAX(., 0xA0540);
        src/sdk/libultra/code_80111540.c.o(.text);
        src/sdk/libultra/code_80111540.c.o(.rodata .rdata);
        . = MAX(., 0xA0690);
        src/sdk/libultra/__osException.s.o(.text);
        src/sdk/libultra/__osException.s.o(.rodata .rdata);
        . = MAX(., 0xA0BD4);
        src/sdk/libultra/code_80111690.c.o(.text);
        src/sdk/libultra/code_80111690.c.o(.rodata .rdata);
        . = MAX(., 0xA0CBC);
        src/sdk/libultra/__osEnqueueAndYield.s.o(.text);
        src/sdk/libultra/__osEnqueueAndYield.s.o(.rodata .rdata);
        . = MAX(., 0xA0DBC);
        src/sdk/libultra/code_80111DBC.c.o(.text);
        src/sdk/libultra/code_80111DBC.c.o(.rodata .rdata);
        . = MAX(., 0xA0E14);
        src/sdk/libultra/code_80111DBC.c.o(.data.D_80111E14);
        . = MAX(., 0xA0FA0);
        src/sdk/libultra/code_80111FA0.c.o(.text);
        src/sdk/libultra/code_80111FA0.c.o(.rodata .rdata);
        . = MAX(., 0xA10A0);
        src/sdk/libultra/code_801120A0.c.o(.text);
        src/sdk/libultra/code_801120A0.c.o(.rodata .rdata);
        . = MAX(., 0xA1130);
        src/sdk/libgultra/osGetCount.s.o(.text);
        src/sdk/libgultra/osGetCount.s.o(.rodata .rdata);
        . = MAX(., 0xA1140);
        src/sdk/libultra/code_80112140.c.o(.text);
        src/sdk/libultra/code_80112140.c.o(.rodata .rdata);
        . = MAX(., 0xA11A0);
        src/sdk/libultra/code_801121A0.c.o(.text);
        src/sdk/libultra/code_801121A0.c.o(.rodata .rdata);
        . = MAX(., 0xA11E0);
        src/sdk/libultra/code_801121E0.c.o(.text);
        src/sdk/libultra/code_801121E0.c.o(.rodata .rdata);
        . = MAX(., 0xA1470);
        src/sdk/libgultra/__osGetSR.s.o(.text);
        src/sdk/libgultra/__osGetSR.s.o(.rodata .rdata);
        . = MAX(., 0xA1480);
        src/sdk/libgultra/__osDisableInt.s.o(.text);
        src/sdk/libgultra/__osDisableInt.s.o(.rodata .rdata);
        . = MAX(., 0xA14A0);
        src/sdk/libgultra/__osRestoreInt.s.o(.text);
        src/sdk/libgultra/__osRestoreInt.s.o(.rodata .rdata);
        . = MAX(., 0xA14C0);
        src/sdk/libultra/osInvalDCache.s.o(.text);
        src/sdk/libultra/osInvalDCache.s.o(.rodata .rdata);
        . = MAX(., 0xA1570);
        src/sdk/libultra/osInvalICache.s.o(.text);
        src/sdk/libultra/osInvalICache.s.o(.rodata .rdata);
        . = MAX(., 0xA15F0);
        src/sdk/libultra/code_801125F0.c.o(.text);
        src/sdk/libultra/code_801125F0.c.o(.rodata .rdata);
        . = MAX(., 0xA1E70);
        src/sdk/libultra/code_80112E70.c.o(.text);
        src/sdk/libultra/code_80112E70.c.o(.rodata .rdata);
        . = MAX(., 0xA20A0);
        src/sdk/libultra/code_801130A0.c.o(.text);
        src/sdk/libultra/code_801130A0.c.o(.rodata .rdata);
        . = MAX(., 0xA21A0);
        src/sdk/libultra/code_801131A0.c.o(.text);
        src/sdk/libultra/code_801131A0.c.o(.rodata .rdata);
        . = MAX(., 0xA2460);
        src/sdk/libultra/code_80113460.c.o(.text);
        src/sdk/libultra/code_80113460.c.o(.rodata .rdata);
        . = MAX(., 0xA2790);
        src/sdk/libultra/osMapTLBRdb.s.o(.text);
        src/sdk/libultra/osMapTLBRdb.s.o(.rodata .rdata);
        . = MAX(., 0xA27F0);
        src/sdk/libultra/code_801137F0.c.o(.text);
        src/sdk/libultra/code_801137F0.c.o(.rodata .rdata);
        . = MAX(., 0xA2E10);
        src/sdk/libultra/code_80113E10.c.o(.text);
        src/sdk/libultra/code_80113E10.c.o(.rodata .rdata);
        . = MAX(., 0xA3520);
        src/sdk/libultra/code_80114520.c.o(.text);
        src/sdk/libultra/code_80114520.c.o(.rodata .rdata);
        . = MAX(., 0xA35D0);
        src/sdk/libultra/code_80114520_801145D0.c.o(.text);
        src/sdk/libultra/code_80114520_801145D0.c.o(.rodata .rdata);
        . = MAX(., 0xA36A0);
        src/sdk/libultra/code_80114520_801146A0.c.o(.text);
        src/sdk/libultra/code_80114520_801146A0.c.o(.rodata .rdata);
        . = MAX(., 0xA37A0);
        src/sdk/libultra/code_80114520_801147A0.c.o(.text);
        src/sdk/libultra/code_80114520_801147A0.c.o(.rodata .rdata);
        . = MAX(., 0xA3858);
        src/sdk/libultra/code_80114520_80114858.c.o(.text);
        src/sdk/libultra/code_80114520_80114858.c.o(.rodata .rdata);
        . = MAX(., 0xA3970);
        src/sdk/libultra/code_80114970.c.o(.text);
        src/sdk/libultra/code_80114970.c.o(.rodata .rdata);
        . = MAX(., 0xA3C00);
        src/sdk/libultra/code_80114C00.c.o(.text);
        src/sdk/libultra/code_80114C00.c.o(.rodata .rdata);
        . = MAX(., 0xA43B0);
        src/sdk/libultra/code_801153B0.c.o(.text);
        src/sdk/libultra/code_801153B0.c.o(.rodata .rdata);
        . = MAX(., 0xA4474);
        src/sdk/libultra/code_801153B0_80115474.c.o(.text);
        src/sdk/libultra/code_801153B0_80115474.c.o(.rodata .rdata);
        . = MAX(., 0xA4A24);
        src/sdk/libultra/code_801153B0_80115A24.c.o(.text);
        src/sdk/libultra/code_801153B0_80115A24.c.o(.rodata .rdata);
        . = MAX(., 0xA4C80);
        src/sdk/libultra/code_801153B0_80115C80.c.o(.text);
        src/sdk/libultra/code_801153B0_80115C80.c.o(.rodata .rdata);
        . = MAX(., 0xA4D7C);
        src/sdk/libultra/code_801153B0_80115D7C.c.o(.text);
        src/sdk/libultra/code_801153B0_80115D7C.c.o(.rodata .rdata);
        . = MAX(., 0xA5110);
        src/sdk/libultra/code_80116110.c.o(.text);
        src/sdk/libultra/code_80116110.c.o(.rodata .rdata);
        . = MAX(., 0xA5720);
        src/sdk/libultra/code_80116720.c.o(.text);
        src/sdk/libultra/code_80116720.c.o(.rodata .rdata);
        . = MAX(., 0xA5B60);
        src/sdk/libultra/code_80116B60.c.o(.text);
        src/sdk/libultra/code_80116B60.c.o(.rodata .rdata);
        . = MAX(., 0xA5C70);
        src/sdk/libultra/code_80116C70.c.o(.text);
        src/sdk/libultra/code_80116C70.c.o(.rodata .rdata);
        . = MAX(., 0xA5EE0);
        src/sdk/libultra/code_80116EE0.c.o(.text);
        src/sdk/libultra/code_80116EE0.c.o(.rodata .rdata);
        . = MAX(., 0xA6CB0);
        src/sdk/libultra/code_80117CB0.c.o(.text);
        src/sdk/libultra/code_80117CB0.c.o(.rodata .rdata);
        . = MAX(., 0xA71B0);
        src/sdk/libultra/code_801181B0.c.o(.text);
        src/sdk/libultra/code_801181B0.c.o(.rodata .rdata);
        . = MAX(., 0xA7410);
        src/sdk/libultra/code_80118410.c.o(.text);
        src/sdk/libultra/code_80118410.c.o(.rodata .rdata);
        . = MAX(., 0xA75D0);
        src/sdk/libultra/code_801185D0.c.o(.text);
        src/sdk/libultra/code_801185D0.c.o(.rodata .rdata);
        . = MAX(., 0xA76E0);
        src/sdk/libultra/code_801186E0.c.o(.text);
        src/sdk/libultra/code_801186E0.c.o(.rodata .rdata);
        . = MAX(., 0xA7860);
        src/sdk/libultra/code_80118860.c.o(.text);
        src/sdk/libultra/code_80118860.c.o(.rodata .rdata);
        . = MAX(., 0xA79F0);
        src/sdk/libultra/code_801189F0.c.o(.text);
        src/sdk/libultra/code_801189F0.c.o(.rodata .rdata);
        . = MAX(., 0xA7AF0);
        src/sdk/libultra/code_80118AF0.c.o(.text);
        src/sdk/libultra/code_80118AF0.c.o(.rodata .rdata);
        . = MAX(., 0xA8020);
        src/sdk/libultra/code_80119020.c.o(.text);
        src/sdk/libultra/code_80119020.c.o(.rodata .rdata);
        . = MAX(., 0xA8040);
        src/sdk/libultra/code_80119040.c.o(.text);
        src/sdk/libultra/code_80119040.c.o(.rodata .rdata);
        . = MAX(., 0xA8240);
        src/sdk/libultra/code_80119240.c.o(.text);
        src/sdk/libultra/code_80119240.c.o(.rodata .rdata);
        . = MAX(., 0xA8380);
        src/sdk/libultra/code_80119380.c.o(.text);
        src/sdk/libultra/code_80119380.c.o(.rodata .rdata);
        . = MAX(., 0xA83E0);
        src/sdk/libultra/code_801193E0.c.o(.text);
        src/sdk/libultra/code_801193E0.c.o(.rodata .rdata);
        . = MAX(., 0xA8530);
        src/sdk/libultra/code_80119530.c.o(.text);
        src/sdk/libultra/code_80119530.c.o(.rodata .rdata);
        . = MAX(., 0xA854C);
        src/sdk/libultra/code_80119530_8011954C.c.o(.text);
        src/sdk/libultra/code_80119530_8011954C.c.o(.rodata .rdata);
        . = MAX(., 0xA8578);
        src/sdk/libultra/code_80119530_80119578.c.o(.text);
        src/sdk/libultra/code_80119530_80119578.c.o(.rodata .rdata);
        . = MAX(., 0xA8B60);
        src/sdk/libultra/code_80119B60.c.o(.text);
        src/sdk/libultra/code_80119B60.c.o(.rodata .rdata);
        . = MAX(., 0xA8C34);
        src/sdk/libultra/code_80119B60_80119C34.c.o(.text);
        src/sdk/libultra/code_80119B60_80119C34.c.o(.rodata .rdata);
        . = MAX(., 0xA8CE8);
        src/sdk/libultra/code_80119B60_80119CE8.c.o(.text);
        src/sdk/libultra/code_80119B60_80119CE8.c.o(.rodata .rdata);
        . = MAX(., 0xA8D14);
        src/sdk/libultra/code_80119B60_80119D14.c.o(.text);
        src/sdk/libultra/code_80119B60_80119D14.c.o(.rodata .rdata);
        . = MAX(., 0xA8F70);
        src/sdk/libultra/code_80119B60_80119F70.c.o(.text);
        src/sdk/libultra/code_80119B60_80119F70.c.o(.rodata .rdata);
        . = MAX(., 0xA8FE0);
        src/sdk/libultra/code_80119B60_80119FE0.c.o(.text);
        src/sdk/libultra/code_80119B60_80119FE0.c.o(.rodata .rdata);
        . = MAX(., 0xA9134);
        src/sdk/libultra/code_80119B60_8011A134.c.o(.text);
        src/sdk/libultra/code_80119B60_8011A134.c.o(.rodata .rdata);
        . = MAX(., 0xA917C);
        src/sdk/libultra/code_80119B60_8011A17C.c.o(.text);
        src/sdk/libultra/code_80119B60_8011A17C.c.o(.rodata .rdata);
        . = MAX(., 0xAA4A0);
        src/sdk/libultra/code_8011B4A0.c.o(.text);
        src/sdk/libultra/code_8011B4A0.c.o(.rodata .rdata);
        . = MAX(., 0xAA7BC);
        src/sdk/libultra/code_8011B4A0_8011B7BC.c.o(.text);
        src/sdk/libultra/code_8011B4A0_8011B7BC.c.o(.rodata .rdata);
        . = MAX(., 0xAA830);
        src/sdk/libultra/code_8011B4A0_8011B830.c.o(.text);
        src/sdk/libultra/code_8011B4A0_8011B830.c.o(.rodata .rdata);
        . = MAX(., 0xAA8B0);
        src/sdk/libultra/code_8011B8B0.c.o(.text);
        src/sdk/libultra/code_8011B8B0.c.o(.rodata .rdata);
        . = MAX(., 0xAA8F0);
        src/sdk/libultra/code_8011B8F0.c.o(.text);
        src/sdk/libultra/code_8011B8F0.c.o(.rodata .rdata);
        . = MAX(., 0xAA920);
        src/sdk/libultra/code_8011B920.c.o(.text);
        src/sdk/libultra/code_8011B920.c.o(.rodata .rdata);
        . = MAX(., 0xAA960);
        src/sdk/libultra/code_8011B960.c.o(.text);
        src/sdk/libultra/code_8011B960.c.o(.rodata .rdata);
        . = MAX(., 0xAA9A0);
        src/sdk/libultra/code_8011B9A0.c.o(.text);
        src/sdk/libultra/code_8011B9A0.c.o(.rodata .rdata);
        . = MAX(., 0xAA9E0);
        src/sdk/libultra/code_8011B9E0.c.o(.text);
        src/sdk/libultra/code_8011B9E0.c.o(.rodata .rdata);
        . = MAX(., 0xAAA10);
        src/sdk/libultra/code_8011BA10.c.o(.text);
        src/sdk/libultra/code_8011BA10.c.o(.rodata .rdata);
        . = MAX(., 0xAAA80);
        src/sdk/libultra/__osSetFpcCsr.s.o(.text);
        src/sdk/libultra/__osSetFpcCsr.s.o(.rodata .rdata);
        . = MAX(., 0xAAA90);
        src/sdk/libultra/code_8011BA90.c.o(.text);
        src/sdk/libultra/code_8011BA90.c.o(.rodata .rdata);
        . = MAX(., 0xAAAE0);
        src/sdk/libultra/osSetIntMask.s.o(.text);
        src/sdk/libultra/osSetIntMask.s.o(.rodata .rdata);
        . = MAX(., 0xAAB80);
        src/sdk/libultra/__osSetSR.s.o(.text);
        src/sdk/libultra/__osSetSR.s.o(.rodata .rdata);
        . = MAX(., 0xAAB90);
        src/sdk/libultra/code_8011BB90.c.o(.text);
        src/sdk/libultra/code_8011BB90.c.o(.rodata .rdata);
        . = MAX(., 0xAAD50);
        src/sdk/libultra/code_8011BD50.c.o(.text);
        src/sdk/libultra/code_8011BD50.c.o(.rodata .rdata);
        . = MAX(., 0xAADE4);
        src/sdk/libultra/code_8011BDE4.c.o(.text);
        src/sdk/libultra/code_8011BDE4.c.o(.rodata .rdata);
        . = MAX(., 0xAAE10);
        src/sdk/libultra/code_8011BE10.c.o(.text);
        src/sdk/libultra/code_8011BE10.c.o(.rodata .rdata);
        . = MAX(., 0xAB07C);
        src/sdk/libultra/code_8011BE10.c.o(.data.D_8011C07C);
        . = MAX(., 0xAB080);
        src/sdk/libultra/code_8011C080.c.o(.text);
        src/sdk/libultra/code_8011C080.c.o(.rodata .rdata);
        . = MAX(., 0xAB0B0);
        src/sdk/libultra/code_8011C0B0.c.o(.text);
        src/sdk/libultra/code_8011C0B0.c.o(.rodata .rdata);
        . = MAX(., 0xAB150);
        src/sdk/libultra/code_8011C150.c.o(.text);
        src/sdk/libultra/code_8011C150.c.o(.rodata .rdata);
        . = MAX(., 0xAB210);
        src/sdk/libultra/code_8011C210.c.o(.text);
        src/sdk/libultra/code_8011C210.c.o(.rodata .rdata);
        . = MAX(., 0xAB2B0);
        src/sdk/libultra/code_8011C2B0.c.o(.text);
        src/sdk/libultra/code_8011C2B0.c.o(.rodata .rdata);
        . = MAX(., 0xAB300);
        src/sdk/libultra/code_8011C300.c.o(.text);
        src/sdk/libultra/code_8011C300.c.o(.rodata .rdata);
        . = MAX(., 0xAB320);
        src/sdk/libultra/code_8011C320.c.o(.text);
        src/sdk/libultra/code_8011C320.c.o(.rodata .rdata);
        . = MAX(., 0xABA30);
        src/sdk/libultra/code_8011CA30.c.o(.text);
        src/sdk/libultra/code_8011CA30.c.o(.rodata .rdata);
        . = MAX(., 0xABAA0);
        src/sdk/libultra/code_8011CAA0.c.o(.text);
        src/sdk/libultra/code_8011CAA0.c.o(.rodata .rdata);
        . = MAX(., 0xABB00);
        src/sdk/libultra/code_8011CB00.c.o(.text);
        src/sdk/libultra/code_8011CB00.c.o(.rodata .rdata);
        . = MAX(., 0xABB60);
        src/sdk/libultra/code_8011CB60.c.o(.text);
        src/sdk/libultra/code_8011CB60.c.o(.rodata .rdata);
        . = MAX(., 0xABBB0);
        src/sdk/libultra/code_8011CBB0.c.o(.text);
        src/sdk/libultra/code_8011CBB0.c.o(.rodata .rdata);
        . = MAX(., 0xABC10);
        src/sdk/libultra/code_8011CC10.c.o(.text);
        src/sdk/libultra/code_8011CC10.c.o(.rodata .rdata);
        . = MAX(., 0xABC60);
        src/sdk/libultra/code_8011CC60.c.o(.text);
        src/sdk/libultra/code_8011CC60.c.o(.rodata .rdata);
        . = MAX(., 0xABCE0);
        src/sdk/libultra/code_8011CCE0.c.o(.text);
        src/sdk/libultra/code_8011CCE0.c.o(.rodata .rdata);
        . = MAX(., 0xABFD0);
        src/sdk/libultra/code_8011CFD0.c.o(.text);
        src/sdk/libultra/code_8011CFD0.c.o(.rodata .rdata);
        . = MAX(., 0xAC000);
        src/sdk/libultra/code_8011D000.c.o(.text);
        src/sdk/libultra/code_8011D000.c.o(.rodata .rdata);
        . = MAX(., 0xAC090);
        src/sdk/libultra/code_8011D090.c.o(.text);
        src/sdk/libultra/code_8011D090.c.o(.rodata .rdata);
        . = MAX(., 0xAC0D0);
        src/sdk/libultra/code_8011D0D0.c.o(.text);
        src/sdk/libultra/code_8011D0D0.c.o(.rodata .rdata);
        . = MAX(., 0xAC0DC);
        src/sdk/libultra/code_8011D0D0.c.o(.data.D_8011D0DC);
        . = MAX(., 0xAC0E0);
        src/sdk/libultra/code_8011D0D0_8011D0E0.c.o(.text);
        src/sdk/libultra/code_8011D0D0_8011D0E0.c.o(.rodata .rdata);
        . = MAX(., 0xAC180);
        src/sdk/libultra/code_8011D0D0_8011D180.c.o(.text);
        src/sdk/libultra/code_8011D0D0_8011D180.c.o(.rodata .rdata);
        . = MAX(., 0xAC190);
        src/sdk/libm/code_8011D190.c.o(.text);
        src/sdk/libm/code_8011D190.c.o(.rodata .rdata);
        . = MAX(., 0xAC1A0);
        src/sdk/libultra/code_8011D1A0.c.o(.text);
        src/sdk/libultra/code_8011D1A0.c.o(.rodata .rdata);
        . = MAX(., 0xAC3DC);
        src/sdk/libultra/code_8011D1A0_8011D3DC.c.o(.text);
        src/sdk/libultra/code_8011D1A0_8011D3DC.c.o(.rodata .rdata);
        . = MAX(., 0xAC404);
        src/sdk/libultra/code_8011D1A0_8011D404.c.o(.text);
        src/sdk/libultra/code_8011D1A0_8011D404.c.o(.rodata .rdata);
        . = MAX(., 0xAC450);
        src/sdk/libultra/code_8011D450.c.o(.text);
        src/sdk/libultra/code_8011D450.c.o(.rodata .rdata);
        . = MAX(., 0xAC6D0);
        src/sdk/libultra/code_8011D6D0.c.o(.text);
        src/sdk/libultra/code_8011D6D0.c.o(.rodata .rdata);
        . = MAX(., 0xAC6D8);
        src/sdk/libultra/code_8011D6D0.c.o(.data.D_8011D6D8);
        . = MAX(., 0xAC6E0);
        src/sdk/libultra/code_8011D6E0.c.o(.text);
        src/sdk/libultra/code_8011D6E0.c.o(.rodata .rdata);
        . = MAX(., 0xAC830);
        src/sdk/libultra/code_8011D830.c.o(.text);
        src/sdk/libultra/code_8011D830.c.o(.rodata .rdata);
        . = MAX(., 0xAC8C0);
        src/sdk/libultra/code_8011D8C0.c.o(.text);
        src/sdk/libultra/code_8011D8C0.c.o(.rodata .rdata);
        . = MAX(., 0xAC950);
        src/sdk/libultra/code_8011D950.c.o(.text);
        src/sdk/libultra/code_8011D950.c.o(.rodata .rdata);
        . = MAX(., 0xACA00);
        src/sdk/libultra/code_8011DA00.c.o(.text);
        src/sdk/libultra/code_8011DA00.c.o(.rodata .rdata);
        . = MAX(., 0xACA90);
        src/sdk/libultra/code_8011DA90.c.o(.text);
        src/sdk/libultra/code_8011DA90.c.o(.rodata .rdata);
        . = MAX(., 0xACB80);
        src/sdk/libultra/code_8011DB80.c.o(.text);
        src/sdk/libultra/code_8011DB80.c.o(.rodata .rdata);
        . = MAX(., 0xACC00);
        src/sdk/libultra/code_8011DC00.c.o(.text);
        src/sdk/libultra/code_8011DC00.c.o(.rodata .rdata);
        . = MAX(., 0xAD3F0);
        src/sdk/libultra/code_8011E3F0.c.o(.text);
        src/sdk/libultra/code_8011E3F0.c.o(.rodata .rdata);
        . = MAX(., 0xAD4DC);
        src/sdk/libultra/code_8011E3F0_8011E4DC.c.o(.text);
        src/sdk/libultra/code_8011E3F0_8011E4DC.c.o(.rodata .rdata);
        . = MAX(., 0xAD564);
        src/sdk/libultra/code_8011E3F0_8011E564.c.o(.text);
        src/sdk/libultra/code_8011E3F0_8011E564.c.o(.rodata .rdata);
        . = MAX(., 0xAD60C);
        src/sdk/libultra/code_8011E3F0_8011E60C.c.o(.text);
        src/sdk/libultra/code_8011E3F0_8011E60C.c.o(.rodata .rdata);
        . = MAX(., 0xADB90);
        src/sdk/libultra/code_8011EB90.c.o(.text);
        src/sdk/libultra/code_8011EB90.c.o(.rodata .rdata);
        . = MAX(., 0xADBB8);
        src/sdk/libultra/code_8011EBB8.c.o(.text);
        src/sdk/libultra/code_8011EBB8.c.o(.rodata .rdata);
        . = MAX(., 0xADCA4);
        src/sdk/libultra/code_8011ECA4.c.o(.text);
        src/sdk/libultra/code_8011ECA4.c.o(.rodata .rdata);
        . = MAX(., 0xADD84);
        src/sdk/libultra/code_8011ED84.c.o(.text);
        src/sdk/libultra/code_8011ED84.c.o(.rodata .rdata);
        . = MAX(., 0xAE7F0);
        src/sdk/libultra/code_8011F7F0.c.o(.text);
        src/sdk/libultra/code_8011F7F0.c.o(.rodata .rdata);
        . = MAX(., 0xAE80C);
        src/span_1000/8011F80C.c.o(.data.D_8011F80C);
        . = MAX(., 0xAE810);
        src/sdk/libultra/code_8011F810.c.o(.text);
        src/sdk/libultra/code_8011F810.c.o(.rodata .rdata);
        . = MAX(., 0xAED90);
        src/sdk/libultra/code_8011FD90.c.o(.text);
        src/sdk/libultra/code_8011FD90.c.o(.rodata .rdata);
        . = MAX(., 0xAF360);
        src/sdk/libultra/code_80120360.c.o(.text);
        src/sdk/libultra/code_80120360.c.o(.rodata .rdata);
        . = MAX(., 0xAF7B0);
        src/sdk/libultra/code_801207B0.c.o(.text);
        src/sdk/libultra/code_801207B0.c.o(.rodata .rdata);
        . = MAX(., 0xB0400);
        src/sdk/libultra/code_80121400.c.o(.text);
        src/sdk/libultra/code_80121400.c.o(.rodata .rdata);
        . = MAX(., 0xB0560);
        src/sdk/libultra/code_80121560.c.o(.text);
        src/sdk/libultra/code_80121560.c.o(.rodata .rdata);
        . = MAX(., 0xB09A0);
        src/sdk/libultra/__osSetCompare.s.o(.text);
        src/sdk/libultra/__osSetCompare.s.o(.rodata .rdata);
        . = MAX(., 0xB09B0);
        src/sdk/libultra/code_801219B0.c.o(.text);
        src/sdk/libultra/code_801219B0.c.o(.rodata .rdata);
        . = MAX(., 0xB0B60);
        src/sdk/libultra/code_80121B60.c.o(.text);
        src/sdk/libultra/code_80121B60.c.o(.rodata .rdata);
        . = MAX(., 0xB0F00);
        src/sdk/libultra/code_80121F00.c.o(.text);
        src/sdk/libultra/code_80121F00.c.o(.rodata .rdata);
        . = MAX(., 0xB0F10);
        src/sdk/libultra/code_80121F10.c.o(.text);
        src/sdk/libultra/code_80121F10.c.o(.rodata .rdata);
        . = MAX(., 0xB0F8C);
        src/span_1000/80121F8C.c.o(.data.D_80121F8C);
        . = MAX(., 0xB0F90);
        src/sdk/libultra/__osProbeTLB.s.o(.text);
        src/sdk/libultra/__osProbeTLB.s.o(.rodata .rdata);
        . = MAX(., 0xB1050);
        src/sdk/libultra/code_80122050.c.o(.text);
        src/sdk/libultra/code_80122050.c.o(.rodata .rdata);
        . = MAX(., 0xB10C0);
        src/sdk/libultra/code_801220C0.c.o(.text);
        src/sdk/libultra/code_801220C0.c.o(.rodata .rdata);
        . = MAX(., 0xB1130);
        src/sdk/libultra/code_80122130.c.o(.text);
        src/sdk/libultra/code_80122130.c.o(.rodata .rdata);
        . = MAX(., 0xB12F0);
        src/sdk/libultra/code_801222F0.c.o(.text);
        src/sdk/libultra/code_801222F0.c.o(.rodata .rdata);
        . = MAX(., 0xB16A0);
        src/sdk/libultra/osWritebackDCache.s.o(.text);
        src/sdk/libultra/osWritebackDCache.s.o(.rodata .rdata);
        . = MAX(., 0xB1720);
        src/sdk/libgultra/osWritebackDCacheAll.s.o(.text);
        src/sdk/libgultra/osWritebackDCacheAll.s.o(.rodata .rdata);
        . = MAX(., 0xB1750);
        src/sdk/libultra/code_80122750.c.o(.text);
        src/sdk/libultra/code_80122750.c.o(.rodata .rdata);
        . = MAX(., 0xB2410);
        src/sdk/libultra/code_80123410.c.o(.text);
        src/sdk/libultra/code_80123410.c.o(.rodata .rdata);
        . = MAX(., 0xB2ED0);
        src/sdk/libultra/code_80123ED0.c.o(.text);
        src/sdk/libultra/code_80123ED0.c.o(.rodata .rdata);
        . = MAX(., 0xB3060);
        src/sdk/libultra/code_80124060.c.o(.text);
        src/sdk/libultra/code_80124060.c.o(.rodata .rdata);
        . = MAX(., 0xB3300);
        src/sdk/libultra/code_80124300.c.o(.text);
        src/sdk/libultra/code_80124300.c.o(.rodata .rdata);
        . = MAX(., 0xB3350);
        src/sdk/libgcc/code_80124350.c.o(.text);
        src/sdk/libgcc/code_80124350.c.o(.rodata .rdata);
        . = MAX(., 0xB393C);
        src/sdk/libgcc/code_80124350.c.o(.data.D_8012493C);
        . = MAX(., 0xB3940);
        src/sdk/libgcc/code_80124940.c.o(.text);
        src/sdk/libgcc/code_80124940.c.o(.rodata .rdata);
        . = MAX(., 0xB3EB8);
        src/sdk/libgcc/code_80124940.c.o(.data.D_80124EB8);
        . = MAX(., 0xB3EC0);
        src/sdk/libgcc/code_80124EC0.c.o(.text);
        src/sdk/libgcc/code_80124EC0.c.o(.rodata .rdata);
        . = MAX(., 0xB4444);
        src/sdk/libgcc/code_80124EC0.c.o(.data.D_80125444);
        . = MAX(., 0xB4450);
        src/sdk/libgcc/code_80125450.c.o(.text);
        src/sdk/libgcc/code_80125450.c.o(.rodata .rdata);
        . = MAX(., 0xB449C);
        src/sdk/libgcc/code_80125450.c.o(.data.D_8012549C);
        . = MAX(., 0xB44A0);
        src/sdk/libgcc/code_801254A0.c.o(.text);
        src/sdk/libgcc/code_801254A0.c.o(.rodata .rdata);
        . = MAX(., 0xB4550);
        src/sdk/libgcc/code_801254A0.c.o(.data.D_80125550);
        . = MAX(., 0xB4558);
        src/sdk/libgcc/code_801254A0.c.o(.data.D_80125558);
        . = MAX(., 0xB4568);
        src/sdk/libgcc/code_801254A0.c.o(.data.D_80125568);
        . = MAX(., 0xB46C0);
        src/sdk/libgcc/code_801254A0.c.o(.data.D_801256C0);
        . = MAX(., 0xB4710);
        src/sdk/libgcc/code_801254A0.c.o(.data.D_80125710);
        . = MAX(., 0xB4714);
        src/sdk/libgcc/code_801254A0.c.o(.data.D_80125714);
        . = MAX(., 0xB4764);
        src/sdk/libgcc/code_801254A0.c.o(.data.D_80125764);
        . = MAX(., 0xB4768);
        src/sdk/libgcc/code_801254A0.c.o(.data.D_80125768);
        . = MAX(., 0xB476C);
        src/sdk/libgcc/code_801254A0.c.o(.data.D_8012576C);
        . = MAX(., 0xB4770);
        src/sdk/libgcc/code_801254A0.c.o(.data.D_80125770);
        . = MAX(., 0xB4774);
        src/sdk/libgcc/code_801254A0.c.o(.data.D_80125774);
        . = MAX(., 0xB4778);
        src/sdk/libgcc/code_801254A0.c.o(.data.D_80125778);
        . = MAX(., 0xB4780);
        src/sdk/libgcc/code_801254A0.c.o(.data.D_80125780);
        . = MAX(., 0xB4788);
        src/sdk/libgcc/code_801254A0.c.o(.data.D_80125788);
        . = MAX(., 0xB478C);
        src/sdk/libgcc/code_801254A0.c.o(.data.D_8012578C);
        . = MAX(., 0xB4790);
        src/sdk/libgcc/code_801254A0.c.o(.data.D_80125790);
        . = MAX(., 0xB4794);
        src/sdk/libgcc/code_801254A0.c.o(.data.D_80125794);
        . = MAX(., 0xB47A0);
        src/sdk/libgcc/code_801254A0.c.o(.data.D_801257A0);
        . = MAX(., 0xB47A8);
        src/sdk/libgcc/code_801254A0.c.o(.data.D_801257A8);
        . = MAX(., 0xB47B0);
        src/sdk/libgcc/code_801254A0.c.o(.data.D_801257B0);
        . = MAX(., 0xB47B4);
        src/sdk/libgcc/code_801254A0.c.o(.data.D_801257B4);
        . = MAX(., 0xB47C4);
        src/sdk/libgcc/code_801254A0.c.o(.data.D_801257C4);
        . = MAX(., 0xB47C8);
        src/sdk/libgcc/code_801254A0.c.o(.data.D_801257C8);
        . = MAX(., 0xB47D0);
        src/sdk/libgcc/code_801254A0.c.o(.data.D_801257D0);
        . = MAX(., 0xB47E0);
        src/sdk/libgcc/code_801254A0.c.o(.data.D_801257E0);
        . = MAX(., 0xB47F0);
        src/sdk/libgcc/code_801254A0.c.o(.data.D_801257F0);
        . = MAX(., 0xB47F4);
        src/sdk/libgcc/code_801254A0.c.o(.data.D_801257F4);
        . = MAX(., 0xB4800);
        src/sdk/libgcc/code_801254A0.c.o(.data.D_80125800);
        . = MAX(., 0xB4808);
        src/sdk/libgcc/code_801254A0.c.o(.data.D_80125808);
        . = MAX(., 0xB4850);
        src/sdk/libgcc/code_801254A0.c.o(.data.D_80125850);
        . = MAX(., 0xB4854);
        src/sdk/libgcc/code_801254A0.c.o(.data.D_80125854);
        . = MAX(., 0xB4858);
        src/sdk/libgcc/code_801254A0.c.o(.data.D_80125858);
        . = MAX(., 0xB4860);
        src/sdk/libgcc/code_801254A0.c.o(.data.D_80125860);
        . = MAX(., 0xB48D8);
        src/sdk/libgcc/code_801254A0.c.o(.data.D_801258D8);
        . = MAX(., 0xB4A30);
        src/sdk/libgcc/code_801254A0.c.o(.data.D_80125A30);
        . = MAX(., 0xB4A68);
        src/sdk/libgcc/code_801254A0.c.o(.data.D_80125A68);
        . = MAX(., 0xB4A70);
        src/sdk/libgcc/code_801254A0.c.o(.data.D_80125A70);
        . = MAX(., 0xB4A78);
        src/sdk/libgcc/code_801254A0.c.o(.data.D_80125A78);
        . = MAX(., 0xB4C40);
        src/sdk/libgcc/code_801254A0.c.o(.data.D_80125C40);
        . = MAX(., 0xB4C44);
        src/sdk/libgcc/code_801254A0.c.o(.data.D_80125C44);
        . = MAX(., 0xB4D40);
        src/sdk/libgcc/code_801254A0.c.o(.data.D_80125D40);
        . = MAX(., 0xB4D44);
        src/sdk/libgcc/code_801254A0.c.o(.data.D_80125D44);
        . = MAX(., 0xB4D48);
        src/sdk/libgcc/code_801254A0.c.o(.data.D_80125D48);
        . = MAX(., 0xB4D50);
        src/sdk/libgcc/code_801254A0.c.o(.data.D_80125D50);
        . = MAX(., 0xB4EB0);
        src/sdk/libgcc/code_801254A0.c.o(.data.D_80125EB0);
        . = MAX(., 0xB4EC0);
        src/sdk/libgcc/code_801254A0.c.o(.data.D_80125EC0);
        . = MAX(., 0xB4EF0);
        src/sdk/libgcc/code_801254A0.c.o(.rodata.D_80125EF0 .rdata.D_80125EF0);
        . = MAX(., 0xB4F14);
        src/span_1000/80125F14.c.o(.data.D_80125F14);
        . = MAX(., 0xB4F18);
        src/span_1000/80125F14.c.o(.rodata.D_80125F18 .rdata.D_80125F18);
        . = MAX(., 0xB4F30);
        src/span_1000/80125F30.c.o(.data.D_80125F30);
        . = MAX(., 0xB4FA0);
        src/span_1000/80125F30.c.o(.data.D_80125FA0);
        . = MAX(., 0xB4FB0);
        src/span_1000/80125F30.c.o(.data.D_80125FB0);
        . = MAX(., 0xB4FD8);
        src/span_1000/80125F30.c.o(.rodata.D_80125FD8 .rdata.D_80125FD8);
        . = MAX(., 0xB4FDC);
        src/span_1000/80125FDC.c.o(.data.D_80125FDC);
        . = MAX(., 0xB5038);
        src/span_1000/80125FDC.c.o(.data.D_80126038);
        . = MAX(., 0xB507C);
        src/span_1000/80125FDC.c.o(.data.D_8012607C);
        . = MAX(., 0xB5080);
        src/span_1000/80125FDC.c.o(.data.D_80126080);
        . = MAX(., 0xB50A0);
        src/span_1000/80125FDC.c.o(.data.D_801260A0);
        . = MAX(., 0xB50A4);
        src/span_1000/80125FDC.c.o(.data.D_801260A4);
        . = MAX(., 0xB50A8);
        src/span_1000/80125FDC.c.o(.data.D_801260A8);
        . = MAX(., 0xB50F8);
        src/span_1000/80125FDC.c.o(.data.D_801260F8);
        . = MAX(., 0xB5110);
        src/span_1000/80125FDC.c.o(.data.D_80126110);
        . = MAX(., 0xB5114);
        src/span_1000/80125FDC.c.o(.data.D_80126114);
        . = MAX(., 0xB5128);
        src/span_1000/80125FDC.c.o(.data.D_80126128);
        . = MAX(., 0xB5140);
        src/span_1000/80125FDC.c.o(.data.D_80126140);
        . = MAX(., 0xB52C0);
        src/span_1000/80125FDC.c.o(.data.D_801262C0);
        . = MAX(., 0xB52C4);
        src/span_1000/80125FDC.c.o(.data.D_801262C4);
        . = MAX(., 0xB52D8);
        src/span_1000/80125FDC.c.o(.data.D_801262D8);
        . = MAX(., 0xB56F4);
        src/span_1000/80125FDC.c.o(.data.D_801266F4);
        . = MAX(., 0xB5700);
        src/span_1000/80125FDC.c.o(.rodata.D_80126700 .rdata.D_80126700);
        . = MAX(., 0xB5704);
        src/span_1000/80125FDC.c.o(.rodata.D_80126704 .rdata.D_80126704);
        . = MAX(., 0xB5708);
        src/span_1000/80126708.c.o(.data.D_80126708);
        . = MAX(., 0xB5710);
        src/span_1000/80126708.c.o(.data.D_80126710);
        . = MAX(., 0xB5714);
        src/span_1000/80126708.c.o(.data.D_80126714);
        . = MAX(., 0xB5718);
        src/span_1000/80126708.c.o(.data.D_80126718);
        . = MAX(., 0xB572C);
        src/span_1000/80126708.c.o(.rodata.D_8012672C .rdata.D_8012672C);
        . = MAX(., 0xB5730);
        src/span_1000/80126708.c.o(.rodata.D_80126730 .rdata.D_80126730);
        . = MAX(., 0xC127C);
        src/span_1000/80126708.c.o(.data.D_8013227C);
        . = MAX(., 0xC1298);
        src/span_1000/80126708.c.o(.data.D_80132298);
        . = MAX(., 0xC129C);
        src/span_1000/80126708.c.o(.data.D_8013229C);
        . = MAX(., 0xC12BC);
        src/span_1000/80126708.c.o(.data.D_801322BC);
        . = MAX(., 0xC12C0);
        src/span_1000/80126708.c.o(.data.D_801322C0);
        . = MAX(., 0xC12CC);
        src/span_1000/80126708.c.o(.data.D_801322CC);
        . = MAX(., 0xC12D0);
        src/span_1000/80126708.c.o(.data.D_801322D0);
        . = MAX(., 0xC12F0);
        src/span_1000/80126708.c.o(.data.D_801322F0);
        . = MAX(., 0xC12F4);
        src/span_1000/80126708.c.o(.data.D_801322F4);
        . = MAX(., 0xC1310);
        src/span_1000/80126708.c.o(.rodata.D_80132310 .rdata.D_80132310);
        . = MAX(., 0xC146C);
        src/span_1000/80126708.c.o(.rodata.D_8013246C .rdata.D_8013246C);
        . = MAX(., 0xC1490);
        src/span_1000/80126708.c.o(.rodata.D_80132490 .rdata.D_80132490);
        . = MAX(., 0xC14A0);
        src/span_1000/80126708.c.o(.rodata.D_801324A0 .rdata.D_801324A0);
        . = MAX(., 0xC14CC);
        src/span_1000/80126708.c.o(.rodata.D_801324CC .rdata.D_801324CC);
        . = MAX(., 0xC150C);
        src/span_1000/80126708.c.o(.data.D_8013250C);
        . = MAX(., 0xC159C);
        src/span_1000/80126708.c.o(.rodata.D_8013259C .rdata.D_8013259C);
        . = MAX(., 0xC1634);
        src/span_1000/80126708.c.o(.rodata.D_80132634 .rdata.D_80132634);
        . = MAX(., 0xC1660);
        src/span_1000/80126708.c.o(.rodata.D_80132660 .rdata.D_80132660);
        . = MAX(., 0xC169C);
        src/span_1000/80126708.c.o(.rodata.D_8013269C .rdata.D_8013269C);
        . = MAX(., 0xC16C4);
        src/span_1000/80126708.c.o(.rodata.D_801326C4 .rdata.D_801326C4);
        . = MAX(., 0xC1704);
        src/span_1000/80126708.c.o(.rodata.D_80132704 .rdata.D_80132704);
        . = MAX(., 0xC173C);
        src/span_1000/80126708.c.o(.rodata.D_8013273C .rdata.D_8013273C);
        . = MAX(., 0xC1754);
        src/span_1000/80126708.c.o(.rodata.D_80132754 .rdata.D_80132754);
        . = MAX(., 0xC1778);
        src/span_1000/80126708.c.o(.rodata.D_80132778 .rdata.D_80132778);
        . = MAX(., 0xC17A8);
        src/span_1000/80126708.c.o(.rodata.D_801327A8 .rdata.D_801327A8);
        . = MAX(., 0xC17C8);
        src/span_1000/80126708.c.o(.rodata.D_801327C8 .rdata.D_801327C8);
        . = MAX(., 0xC17EC);
        src/span_1000/80126708.c.o(.rodata.D_801327EC .rdata.D_801327EC);
        . = MAX(., 0xC181C);
        src/span_1000/80126708.c.o(.rodata.D_8013281C .rdata.D_8013281C);
        . = MAX(., 0xC185C);
        src/span_1000/80126708.c.o(.rodata.D_8013285C .rdata.D_8013285C);
        . = MAX(., 0xC18D8);
        src/span_1000/80126708.c.o(.data.D_801328D8);
        . = MAX(., 0xC197C);
        src/span_1000/80126708.c.o(.data.D_8013297C);
        . = MAX(., 0xC1994);
        src/span_1000/80126708.c.o(.rodata.D_80132994 .rdata.D_80132994);
        . = MAX(., 0xC19C8);
        src/span_1000/80126708.c.o(.rodata.D_801329C8 .rdata.D_801329C8);
        . = MAX(., 0xC1A04);
        src/span_1000/80126708.c.o(.rodata.D_80132A04 .rdata.D_80132A04);
        . = MAX(., 0xC1A34);
        src/span_1000/80126708.c.o(.rodata.D_80132A34 .rdata.D_80132A34);
        . = MAX(., 0xC1A78);
        src/span_1000/80126708.c.o(.rodata.D_80132A78 .rdata.D_80132A78);
        . = MAX(., 0xC1AA8);
        src/span_1000/80126708.c.o(.rodata.D_80132AA8 .rdata.D_80132AA8);
        . = MAX(., 0xC1AC8);
        src/span_1000/80126708.c.o(.rodata.D_80132AC8 .rdata.D_80132AC8);
        . = MAX(., 0xC1B04);
        src/span_1000/80126708.c.o(.data.D_80132B04);
        . = MAX(., 0xC1BB0);
        src/span_1000/80126708.c.o(.rodata.D_80132BB0 .rdata.D_80132BB0);
        . = MAX(., 0xC1C30);
        src/span_1000/80126708.c.o(.data.D_80132C30);
        . = MAX(., 0xC1C9C);
        src/span_1000/80126708.c.o(.rodata.D_80132C9C .rdata.D_80132C9C);
        . = MAX(., 0xC1CBC);
        src/span_1000/80126708.c.o(.rodata.D_80132CBC .rdata.D_80132CBC);
        . = MAX(., 0xC1CE8);
        src/span_1000/80126708.c.o(.rodata.D_80132CE8 .rdata.D_80132CE8);
        . = MAX(., 0xC1D40);
        src/span_1000/80126708.c.o(.rodata.D_80132D40 .rdata.D_80132D40);
        . = MAX(., 0xC1D6C);
        src/span_1000/80126708.c.o(.rodata.D_80132D6C .rdata.D_80132D6C);
        . = MAX(., 0xC1D88);
        src/span_1000/80126708.c.o(.rodata.D_80132D88 .rdata.D_80132D88);
        . = MAX(., 0xC1DA0);
        src/span_1000/80126708.c.o(.rodata.D_80132DA0 .rdata.D_80132DA0);
        . = MAX(., 0xC1EF0);
        src/span_1000/80132EF0.c.o(.data.D_80132EF0);
        . = MAX(., 0xC1F00);
        src/span_1000/80132EF0.c.o(.rodata.D_80132F00 .rdata.D_80132F00);
        . = MAX(., 0xC1F4C);
        src/span_1000/80132EF0.c.o(.rodata.D_80132F4C .rdata.D_80132F4C);
        . = MAX(., 0xC1F80);
        src/span_1000/80132EF0.c.o(.rodata.D_80132F80 .rdata.D_80132F80);
        . = MAX(., 0xC1FE0);
        src/span_1000/80132EF0.c.o(.rodata.D_80132FE0 .rdata.D_80132FE0);
        . = MAX(., 0xC2030);
        src/span_1000/80132EF0.c.o(.rodata.D_80133030 .rdata.D_80133030);
        . = MAX(., 0xC2070);
        src/span_1000/80132EF0.c.o(.rodata.D_80133070 .rdata.D_80133070);
        . = MAX(., 0xC20C4);
        src/span_1000/80132EF0.c.o(.rodata.D_801330C4 .rdata.D_801330C4);
        . = MAX(., 0xC20E4);
        src/span_1000/80132EF0.c.o(.rodata.D_801330E4 .rdata.D_801330E4);
        . = MAX(., 0xC2100);
        src/span_1000/80132EF0.c.o(.data.D_80133100);
        . = MAX(., 0xC2148);
        src/span_1000/80132EF0.c.o(.rodata.D_80133148 .rdata.D_80133148);
        . = MAX(., 0xC21A8);
        src/span_1000/80132EF0.c.o(.rodata.D_801331A8 .rdata.D_801331A8);
        . = MAX(., 0xC21D0);
        src/span_1000/80132EF0.c.o(.rodata.D_801331D0 .rdata.D_801331D0);
        . = MAX(., 0xC2220);
        src/span_1000/80132EF0.c.o(.rodata.D_80133220 .rdata.D_80133220);
        . = MAX(., 0xC2298);
        src/span_1000/80132EF0.c.o(.rodata.D_80133298 .rdata.D_80133298);
        . = MAX(., 0xC22FC);
        src/span_1000/80132EF0.c.o(.rodata.D_801332FC .rdata.D_801332FC);
        . = MAX(., 0xC2360);
        src/span_1000/80132EF0.c.o(.rodata.D_80133360 .rdata.D_80133360);
        . = MAX(., 0xC2394);
        src/span_1000/80132EF0.c.o(.rodata.D_80133394 .rdata.D_80133394);
        . = MAX(., 0xC2418);
        src/span_1000/80132EF0.c.o(.rodata.D_80133418 .rdata.D_80133418);
        . = MAX(., 0xC24C0);
        src/span_1000/80132EF0.c.o(.rodata.D_801334C0 .rdata.D_801334C0);
        . = MAX(., 0xC2538);
        src/span_1000/80132EF0.c.o(.rodata.D_80133538 .rdata.D_80133538);
        . = MAX(., 0xC2594);
        src/span_1000/80132EF0.c.o(.data.D_80133594);
        . = MAX(., 0xC25E8);
        src/span_1000/80132EF0.c.o(.rodata.D_801335E8 .rdata.D_801335E8);
        . = MAX(., 0xC2620);
        src/span_1000/80132EF0.c.o(.rodata.D_80133620 .rdata.D_80133620);
        . = MAX(., 0xC26A0);
        src/span_1000/80132EF0.c.o(.rodata.D_801336A0 .rdata.D_801336A0);
        . = MAX(., 0xC26F0);
        src/span_1000/80132EF0.c.o(.rodata.D_801336F0 .rdata.D_801336F0);
        . = MAX(., 0xC2778);
        src/span_1000/80132EF0.c.o(.rodata.D_80133778 .rdata.D_80133778);
        . = MAX(., 0xC27C8);
        src/span_1000/80132EF0.c.o(.rodata.D_801337C8 .rdata.D_801337C8);
        . = MAX(., 0xC2820);
        src/span_1000/80132EF0.c.o(.rodata.D_80133820 .rdata.D_80133820);
        . = MAX(., 0xC28BC);
        src/span_1000/80132EF0.c.o(.rodata.D_801338BC .rdata.D_801338BC);
        . = MAX(., 0xC2964);
        src/span_1000/80132EF0.c.o(.rodata.D_80133964 .rdata.D_80133964);
        . = MAX(., 0xC2A00);
        src/span_1000/80132EF0.c.o(.rodata.D_80133A00 .rdata.D_80133A00);
        . = MAX(., 0xC2A50);
        src/span_1000/80132EF0.c.o(.rodata.D_80133A50 .rdata.D_80133A50);
        . = MAX(., 0xC2AF4);
        src/span_1000/80132EF0.c.o(.rodata.D_80133AF4 .rdata.D_80133AF4);
        . = MAX(., 0xC2BB0);
        src/span_1000/80132EF0.c.o(.rodata.D_80133BB0 .rdata.D_80133BB0);
        . = MAX(., 0xC2BCC);
        src/span_1000/80132EF0.c.o(.rodata.D_80133BCC .rdata.D_80133BCC);
        . = MAX(., 0xC2C38);
        src/span_1000/80132EF0.c.o(.rodata.D_80133C38 .rdata.D_80133C38);
        . = MAX(., 0xC2CAC);
        src/span_1000/80132EF0.c.o(.rodata.D_80133CAC .rdata.D_80133CAC);
        . = MAX(., 0xC2D2C);
        src/span_1000/80132EF0.c.o(.rodata.D_80133D2C .rdata.D_80133D2C);
        . = MAX(., 0xC2D7C);
        src/span_1000/80132EF0.c.o(.rodata.D_80133D7C .rdata.D_80133D7C);
        . = MAX(., 0xC2E14);
        src/span_1000/80132EF0.c.o(.rodata.D_80133E14 .rdata.D_80133E14);
        . = MAX(., 0xC2E7C);
        src/span_1000/80133E7C.c.o(.data.D_80133E7C);
        . = MAX(., 0xC2E80);
        src/span_1000/80133E7C.c.o(.rodata.D_80133E80 .rdata.D_80133E80);
        . = MAX(., 0xC2FAC);
        src/span_1000/80133E7C.c.o(.rodata.D_80133FAC .rdata.D_80133FAC);
        . = MAX(., 0xC2FD4);
        src/span_1000/80133FD4.c.o(.data.D_80133FD4);
        . = MAX(., 0xC2FE0);
        src/span_1000/80133FD4.c.o(.data.D_80133FE0);
        . = MAX(., 0xC2FE4);
        src/span_1000/80133FD4.c.o(.data.D_80133FE4);
        . = MAX(., 0xC3010);
        src/span_1000/80133FD4.c.o(.data.D_80134010);
        . = MAX(., 0xC3020);
        src/span_1000/80133FD4.c.o(.data.D_80134020);
        . = MAX(., 0xC3024);
        src/span_1000/80133FD4.c.o(.data.D_80134024);
        . = MAX(., 0xC3058);
        src/span_1000/80133FD4.c.o(.data.D_80134058);
        . = MAX(., 0xC3080);
        src/span_1000/80133FD4.c.o(.data.D_80134080);
        . = MAX(., 0xC3A80);
        src/span_1000/80133FD4.c.o(.data.D_80134A80);
        . = MAX(., 0xC3AA8);
        src/span_1000/80133FD4.c.o(.data.D_80134AA8);
        . = MAX(., 0xC3AAC);
        src/span_1000/80133FD4.c.o(.data.D_80134AAC);
        . = MAX(., 0xC3E54);
        src/span_1000/80133FD4.c.o(.data.D_80134E54);
        . = MAX(., 0xC3E58);
        src/span_1000/80133FD4.c.o(.data.D_80134E58);
        . = MAX(., 0xC3E5C);
        src/span_1000/80133FD4.c.o(.data.D_80134E5C);
        . = MAX(., 0xC3E60);
        src/span_1000/80133FD4.c.o(.data.D_80134E60);
        . = MAX(., 0xC3E64);
        src/span_1000/80133FD4.c.o(.data.D_80134E64);
        . = MAX(., 0xC3E68);
        src/span_1000/80133FD4.c.o(.data.D_80134E68);
        . = MAX(., 0xC3E74);
        src/span_1000/80133FD4.c.o(.data.D_80134E74);
        . = MAX(., 0xC3E78);
        src/span_1000/80133FD4.c.o(.data.D_80134E78);
        . = MAX(., 0xC3E80);
        src/span_1000/80133FD4.c.o(.rodata.D_80134E80 .rdata.D_80134E80);
        . = MAX(., 0xC3F10);
        src/span_1000/80133FD4.c.o(.rodata.D_80134F10 .rdata.D_80134F10);
        . = MAX(., 0xC3F6C);
        src/span_1000/80133FD4.c.o(.rodata.D_80134F6C .rdata.D_80134F6C);
        . = MAX(., 0xC3F9C);
        src/span_1000/80133FD4.c.o(.rodata.D_80134F9C .rdata.D_80134F9C);
        . = MAX(., 0xC3FB4);
        src/span_1000/80134FB4.c.o(.data.D_80134FB4);
        . = MAX(., 0xC3FC0);
        src/span_1000/80134FB4.c.o(.data.D_80134FC0);
        . = MAX(., 0xC3FD4);
        src/span_1000/80134FB4.c.o(.data.D_80134FD4);
        . = MAX(., 0xC3FD8);
        src/span_1000/80134FB4.c.o(.data.D_80134FD8);
        . = MAX(., 0xC3FDC);
        src/span_1000/80134FB4.c.o(.data.D_80134FDC);
        . = MAX(., 0xC3FF0);
        src/span_1000/80134FB4.c.o(.data.D_80134FF0);
        . = MAX(., 0xC4034);
        src/span_1000/80134FB4.c.o(.data.D_80135034);
        . = MAX(., 0xC4058);
        src/span_1000/80134FB4.c.o(.rodata.D_80135058 .rdata.D_80135058);
        . = MAX(., 0xC4060);
        src/span_1000/80135060.c.o(.data.D_80135060);
        . = MAX(., 0xC41E4);
        src/span_1000/80135060.c.o(.rodata.D_801351E4 .rdata.D_801351E4);
        . = MAX(., 0xC41EC);
        src/span_1000/801351EC.c.o(.data.D_801351EC);
        . = MAX(., 0xC42A4);
        src/span_1000/801351EC.c.o(.data.D_801352A4);
        . = MAX(., 0xC42B0);
        src/span_1000/801351EC.c.o(.data.D_801352B0);
        . = MAX(., 0xC44EC);
        src/span_1000/801351EC.c.o(.data.D_801354EC);
        . = MAX(., 0xC466C);
        src/span_1000/801351EC.c.o(.data.D_8013566C);
        . = MAX(., 0xC4674);
        src/span_1000/801351EC.c.o(.data.D_80135674);
        . = MAX(., 0xC4680);
        src/span_1000/801351EC.c.o(.rodata.D_80135680 .rdata.D_80135680);
        . = MAX(., 0xC468C);
        src/span_1000/801351EC.c.o(.data.D_8013568C);
        . = MAX(., 0xC4698);
        src/span_1000/80135698.c.o(.data.D_80135698);
        . = MAX(., 0xC4760);
        src/span_1000/80135698.c.o(.data.D_80135760);
        . = MAX(., 0xC4764);
        src/span_1000/80135698.c.o(.data.D_80135764);
        . = MAX(., 0xC4768);
        src/span_1000/80135698.c.o(.data.D_80135768);
        . = MAX(., 0xC476C);
        src/span_1000/80135698.c.o(.data.D_8013576C);
        . = MAX(., 0xC4770);
        src/span_1000/80135698.c.o(.data.D_80135770);
        . = MAX(., 0xC4778);
        src/span_1000/80135698.c.o(.rodata.D_80135778 .rdata.D_80135778);
        . = MAX(., 0xC478C);
        src/span_1000/8013578C.c.o(.data.D_8013578C);
        . = MAX(., 0xC4820);
        src/span_1000/8013578C.c.o(.data.D_80135820);
        . = MAX(., 0xC4830);
        src/span_1000/8013578C.c.o(.data.D_80135830);
        . = MAX(., 0xC4834);
        src/span_1000/8013578C.c.o(.data.D_80135834);
        . = MAX(., 0xC4838);
        src/span_1000/8013578C.c.o(.data.D_80135838);
        . = MAX(., 0xC483C);
        src/span_1000/8013578C.c.o(.data.D_8013583C);
        . = MAX(., 0xC4840);
        src/span_1000/8013578C.c.o(.data.D_80135840);
        . = MAX(., 0xC4878);
        src/span_1000/8013578C.c.o(.rodata.D_80135878 .rdata.D_80135878);
        . = MAX(., 0xC487C);
        src/span_1000/8013587C.c.o(.data.D_8013587C);
        . = MAX(., 0xC4890);
        src/span_1000/8013587C.c.o(.data.D_80135890);
        . = MAX(., 0xC48A0);
        src/span_1000/8013587C.c.o(.data.D_801358A0);
        . = MAX(., 0xC48B0);
        src/span_1000/8013587C.c.o(.data.D_801358B0);
        . = MAX(., 0xC48C0);
        src/span_1000/8013587C.c.o(.data.D_801358C0);
        . = MAX(., 0xC4D80);
        src/span_1000/8013587C.c.o(.data.D_80135D80);
        . = MAX(., 0xC4DB4);
        src/span_1000/8013587C.c.o(.data.D_80135DB4);
        . = MAX(., 0xC4DDC);
        src/span_1000/8013587C.c.o(.data.D_80135DDC);
        . = MAX(., 0xC4E64);
        src/span_1000/8013587C.c.o(.data.D_80135E64);
        . = MAX(., 0xC4F84);
        src/span_1000/8013587C.c.o(.data.D_80135F84);
        . = MAX(., 0xC5078);
        src/span_1000/8013587C.c.o(.data.D_80136078);
        . = MAX(., 0xC50E8);
        src/span_1000/8013587C.c.o(.data.D_801360E8);
        . = MAX(., 0xC5164);
        src/span_1000/8013587C.c.o(.data.D_80136164);
        . = MAX(., 0xC51CC);
        src/span_1000/8013587C.c.o(.data.D_801361CC);
        . = MAX(., 0xC524C);
        src/span_1000/8013587C.c.o(.data.D_8013624C);
        . = MAX(., 0xC5280);
        src/span_1000/8013587C.c.o(.data.D_80136280);
        . = MAX(., 0xC52A8);
        src/span_1000/8013587C.c.o(.data.D_801362A8);
        . = MAX(., 0xC53E0);
        src/span_1000/8013587C.c.o(.data.D_801363E0);
        . = MAX(., 0xC5424);
        src/span_1000/8013587C.c.o(.data.D_80136424);
        . = MAX(., 0xC5458);
        src/span_1000/8013587C.c.o(.data.D_80136458);
        . = MAX(., 0xC5480);
        src/span_1000/8013587C.c.o(.data.D_80136480);
        . = MAX(., 0xC54E8);
        src/span_1000/8013587C.c.o(.data.D_801364E8);
        . = MAX(., 0xC552C);
        src/span_1000/8013587C.c.o(.data.D_8013652C);
        . = MAX(., 0xC5560);
        src/span_1000/8013587C.c.o(.data.D_80136560);
        . = MAX(., 0xC56A8);
        src/span_1000/8013587C.c.o(.data.D_801366A8);
        . = MAX(., 0xC56DC);
        src/span_1000/8013587C.c.o(.data.D_801366DC);
        . = MAX(., 0xC5774);
        src/span_1000/8013587C.c.o(.data.D_80136774);
        . = MAX(., 0xC5930);
        src/span_1000/8013587C.c.o(.data.D_80136930);
        . = MAX(., 0xC5A90);
        src/span_1000/8013587C.c.o(.data.D_80136A90);
        . = MAX(., 0xC5B00);
        src/span_1000/8013587C.c.o(.data.D_80136B00);
        . = MAX(., 0xC5C18);
        src/span_1000/8013587C.c.o(.data.D_80136C18);
        . = MAX(., 0xC5D78);
        src/span_1000/8013587C.c.o(.data.D_80136D78);
        . = MAX(., 0xC5ED8);
        src/span_1000/8013587C.c.o(.data.D_80136ED8);
        . = MAX(., 0xC6038);
        src/span_1000/8013587C.c.o(.data.D_80137038);
        . = MAX(., 0xC60E8);
        src/span_1000/8013587C.c.o(.data.D_801370E8);
        . = MAX(., 0xC61D0);
        src/span_1000/8013587C.c.o(.data.D_801371D0);
        . = MAX(., 0xC6210);
        src/span_1000/8013587C.c.o(.data.D_80137210);
        . = MAX(., 0xC6248);
        src/span_1000/8013587C.c.o(.data.D_80137248);
        . = MAX(., 0xC628C);
        src/span_1000/8013587C.c.o(.data.D_8013728C);
        . = MAX(., 0xC6310);
        src/span_1000/8013587C.c.o(.data.D_80137310);
        . = MAX(., 0xC6354);
        src/span_1000/8013587C.c.o(.data.D_80137354);
        . = MAX(., 0xC6398);
        src/span_1000/8013587C.c.o(.data.D_80137398);
        . = MAX(., 0xC641C);
        src/span_1000/8013587C.c.o(.data.D_8013741C);
        . = MAX(., 0xC6460);
        src/span_1000/8013587C.c.o(.data.D_80137460);
        . = MAX(., 0xC64A4);
        src/span_1000/8013587C.c.o(.data.D_801374A4);
        . = MAX(., 0xC6518);
        src/span_1000/8013587C.c.o(.data.D_80137518);
        . = MAX(., 0xC655C);
        src/span_1000/8013587C.c.o(.data.D_8013755C);
        . = MAX(., 0xC65A0);
        src/span_1000/8013587C.c.o(.data.D_801375A0);
        . = MAX(., 0xC6614);
        src/span_1000/8013587C.c.o(.data.D_80137614);
        . = MAX(., 0xC6648);
        src/span_1000/8013587C.c.o(.data.D_80137648);
        . = MAX(., 0xC6670);
        src/span_1000/8013587C.c.o(.data.D_80137670);
        . = MAX(., 0xC6730);
        src/span_1000/8013587C.c.o(.data.D_80137730);
        . = MAX(., 0xC67F8);
        src/span_1000/8013587C.c.o(.data.D_801377F8);
        . = MAX(., 0xC6888);
        src/span_1000/8013587C.c.o(.data.D_80137888);
        . = MAX(., 0xC6900);
        src/span_1000/8013587C.c.o(.data.D_80137900);
        . = MAX(., 0xC6904);
        src/span_1000/8013587C.c.o(.data.D_80137904);
        . = MAX(., 0xC6908);
        src/span_1000/8013587C.c.o(.data.D_80137908);
        . = MAX(., 0xC690C);
        src/span_1000/8013587C.c.o(.data.D_8013790C);
        . = MAX(., 0xC7F3C);
        src/span_1000/8013587C.c.o(.data.D_80138F3C);
        . = MAX(., 0xC7FBC);
        src/span_1000/8013587C.c.o(.data.D_80138FBC);
        . = MAX(., 0xC8048);
        src/span_1000/8013587C.c.o(.data.D_80139048);
        . = MAX(., 0xC85B8);
        src/span_1000/8013587C.c.o(.rodata.D_801395B8 .rdata.D_801395B8);
        . = MAX(., 0xC85BC);
        src/span_1000/801395BC.c.o(.data.D_801395BC);
        . = MAX(., 0xC8610);
        src/span_1000/801395BC.c.o(.data.D_80139610);
        . = MAX(., 0xC8620);
        src/span_1000/801395BC.c.o(.data.D_80139620);
        . = MAX(., 0xC8720);
        src/span_1000/801395BC.c.o(.data.D_80139720);
        . = MAX(., 0xC8724);
        src/span_1000/801395BC.c.o(.data.D_80139724);
        . = MAX(., 0xD0050);
        src/span_1000/801395BC.c.o(.data.D_80141050);
        . = MAX(., 0xD0120);
        src/span_1000/801395BC.c.o(.data.D_80141120);
        . = MAX(., 0xD0124);
        src/span_1000/801395BC.c.o(.data.D_80141124);
        . = MAX(., 0xD06EC);
        src/span_1000/801395BC.c.o(.data.D_801416EC);
        . = MAX(., 0xD06F0);
        src/span_1000/801395BC.c.o(.data.D_801416F0);
        . = MAX(., 0xD06F8);
        src/span_1000/801395BC.c.o(.data.D_801416F8);
        . = MAX(., 0xD18D8);
        src/span_1000/801395BC.c.o(.data.D_801428D8);
        . = MAX(., 0xD18E4);
        src/span_1000/801395BC.c.o(.data.D_801428E4);
        . = MAX(., 0xD1904);
        src/span_1000/801395BC.c.o(.data.D_80142904);
        . = MAX(., 0xD1908);
        src/span_1000/801395BC.c.o(.data.D_80142908);
        . = MAX(., 0xD190C);
        src/span_1000/801395BC.c.o(.data.D_8014290C);
        . = MAX(., 0xD1B50);
        src/span_1000/801395BC.c.o(.data.D_80142B50);
        . = MAX(., 0xD1B60);
        src/span_1000/801395BC.c.o(.data.D_80142B60);
        . = MAX(., 0xD1B70);
        src/span_1000/801395BC.c.o(.data.D_80142B70);
        . = MAX(., 0xD1CAC);
        src/span_1000/801395BC.c.o(.rodata.D_80142CAC .rdata.D_80142CAC);
        . = MAX(., 0xD1CB0);
        src/span_1000/80142CB0.c.o(.data.D_80142CB0);
        . = MAX(., 0xD1CC0);
        src/span_1000/80142CB0.c.o(.data.D_80142CC0);
        . = MAX(., 0xD1CD0);
        src/span_1000/80142CB0.c.o(.data.D_80142CD0);
        . = MAX(., 0xD1CD4);
        src/span_1000/80142CB0.c.o(.data.D_80142CD4);
        . = MAX(., 0xD1CD8);
        src/span_1000/80142CB0.c.o(.data.D_80142CD8);
        . = MAX(., 0xD4AA0);
        src/span_1000/80142CB0.c.o(.data.D_80145AA0);
        . = MAX(., 0xD4D60);
        src/span_1000/80142CB0.c.o(.data.D_80145D60);
        . = MAX(., 0xD4D84);
        src/span_1000/80142CB0.c.o(.data.D_80145D84);
        . = MAX(., 0xD4DA0);
        src/span_1000/80142CB0.c.o(.data.D_80145DA0);
        . = MAX(., 0xD4DA8);
        src/span_1000/80142CB0.c.o(.data.D_80145DA8);
        . = MAX(., 0xD4DAC);
        src/span_1000/80142CB0.c.o(.data.D_80145DAC);
        . = MAX(., 0xD4DB0);
        src/span_1000/80142CB0.c.o(.data.D_80145DB0);
        . = MAX(., 0xD4DE0);
        src/span_1000/80142CB0.c.o(.data.D_80145DE0);
        . = MAX(., 0xD4DF0);
        src/span_1000/80142CB0.c.o(.data.D_80145DF0);
        . = MAX(., 0xD4E10);
        src/span_1000/80142CB0.c.o(.data.D_80145E10);
        . = MAX(., 0xD4E20);
        src/span_1000/80142CB0.c.o(.data.D_80145E20);
        . = MAX(., 0xD50F8);
        src/span_1000/80142CB0.c.o(.data.D_801460F8);
        . = MAX(., 0xD5100);
        src/span_1000/80142CB0.c.o(.data.D_80146100);
        . = MAX(., 0xD5104);
        src/span_1000/80142CB0.c.o(.data.D_80146104);
        . = MAX(., 0xD5110);
        src/span_1000/80142CB0.c.o(.data.D_80146110);
        . = MAX(., 0xD5154);
        src/span_1000/80142CB0.c.o(.data.D_80146154);
        . = MAX(., 0xD51B0);
        src/span_1000/80142CB0.c.o(.data.D_801461B0);
        . = MAX(., 0xD5FC0);
        src/span_1000/80142CB0.c.o(.rodata.D_80146FC0 .rdata.D_80146FC0);
        . = MAX(., 0xD5FE4);
        src/span_1000/80142CB0.c.o(.rodata.D_80146FE4 .rdata.D_80146FE4);
        . = MAX(., 0xD6008);
        src/span_1000/80147008.c.o(.data.D_80147008);
        . = MAX(., 0xD6010);
        src/span_1000/80147008.c.o(.rodata.D_80147010 .rdata.D_80147010);
        . = MAX(., 0xD6024);
        src/span_1000/80147008.c.o(.rodata.D_80147024 .rdata.D_80147024);
        . = MAX(., 0xD6038);
        src/span_1000/80147038.c.o(.data.D_80147038);
    }
    .span_1000.bss (NOLOAD) :
    {
        src/span_1000/80071000.c.o(.bss .sbss COMMON);
        src/game/sys_80076000/code_800768E4.c.o(.bss .sbss COMMON);
        src/span_1000/80071070.c.o(.bss .sbss COMMON);
        src/span_1000/80071084.c.o(.bss .sbss COMMON);
        src/span_1000/80071098.c.o(.bss .sbss COMMON);
        src/game/sys_80076000/code_80078F60.c.o(.bss .sbss COMMON);
        src/span_1000/800710E0.c.o(.bss .sbss COMMON);
        src/span_1000/800710E8.c.o(.bss .sbss COMMON);
        src/game/sys_80076000/code_8007AD2C.c.o(.bss .sbss COMMON);
        src/span_1000/80071138.c.o(.bss .sbss COMMON);
        src/span_1000/80071178.c.o(.bss .sbss COMMON);
        src/game/sys_80076000/code_8007C58C.c.o(.bss .sbss COMMON);
        src/game/sys_80076000/code_8007D2A0.c.o(.bss .sbss COMMON);
        src/span_1000/800713D0.c.o(.bss .sbss COMMON);
        src/span_1000/80071460.c.o(.bss .sbss COMMON);
        src/span_1000/80071490.c.o(.bss .sbss COMMON);
        src/game/sys_80076000/code_80083394.c.o(.bss .sbss COMMON);
        src/span_1000/80071518.c.o(.bss .sbss COMMON);
        src/span_1000/80071538.c.o(.bss .sbss COMMON);
        src/span_1000/80071560.c.o(.bss .sbss COMMON);
        src/game/sys_80076000/code_800863F4.c.o(.bss .sbss COMMON);
        src/game/sys_80076000/code_80086B48.c.o(.bss .sbss COMMON);
        src/game/sys_80076000/code_80088590.c.o(.bss .sbss COMMON);
        src/span_1000/80071768.c.o(.bss .sbss COMMON);
        src/span_1000/80071838.c.o(.bss .sbss COMMON);
        src/span_1000/80071894.c.o(.bss .sbss COMMON);
        src/game/sys_80076000/code_8008ADE0.c.o(.bss .sbss COMMON);
        src/span_1000/800719E8.c.o(.bss .sbss COMMON);
        src/span_1000/80071A70.c.o(.bss .sbss COMMON);
        src/span_1000/80071A98.c.o(.bss .sbss COMMON);
        src/span_1000/80071B00.c.o(.bss .sbss COMMON);
        src/span_1000/80071B54.c.o(.bss .sbss COMMON);
        src/span_1000/80071BAC.c.o(.bss .sbss COMMON);
        src/span_1000/80071BD0.c.o(.bss .sbss COMMON);
        src/span_1000/80071BE8.c.o(.bss .sbss COMMON);
        src/span_1000/80071C48.c.o(.bss .sbss COMMON);
        src/game/sys_80076000/code_8008F040.c.o(.bss .sbss COMMON);
        src/span_1000/80071C7C.c.o(.bss .sbss COMMON);
        src/span_1000/80071CC0.c.o(.bss .sbss COMMON);
        src/span_1000/80071CF8.c.o(.bss .sbss COMMON);
        src/span_1000/80071D88.c.o(.bss .sbss COMMON);
        src/span_1000/80071E90.c.o(.bss .sbss COMMON);
        src/span_1000/80071EA8.c.o(.bss .sbss COMMON);
        src/span_1000/80071F50.c.o(.bss .sbss COMMON);
        src/span_1000/80072008.c.o(.bss .sbss COMMON);
        src/span_1000/80072020.c.o(.bss .sbss COMMON);
        src/game/sys_80076000/code_800942A8.c.o(.bss .sbss COMMON);
        src/game/sys_80076000/code_80094C58.c.o(.bss .sbss COMMON);
        src/span_1000/800720F0.c.o(.bss .sbss COMMON);
        src/span_1000/80072120.c.o(.bss .sbss COMMON);
        src/span_1000/80072150.c.o(.bss .sbss COMMON);
        src/span_1000/80072190.c.o(.bss .sbss COMMON);
        src/span_1000/800721A8.c.o(.bss .sbss COMMON);
        src/span_1000/80072248.c.o(.bss .sbss COMMON);
        src/span_1000/80072298.c.o(.bss .sbss COMMON);
        src/span_1000/800722B8.c.o(.bss .sbss COMMON);
        src/span_1000/800722F8.c.o(.bss .sbss COMMON);
        src/span_1000/80072378.c.o(.bss .sbss COMMON);
        src/span_1000/800723B0.c.o(.bss .sbss COMMON);
        src/span_1000/800724A8.c.o(.bss .sbss COMMON);
        src/span_1000/800724C8.c.o(.bss .sbss COMMON);
        src/span_1000/80072528.c.o(.bss .sbss COMMON);
        src/span_1000/80072540.c.o(.bss .sbss COMMON);
        src/span_1000/80072580.c.o(.bss .sbss COMMON);
        src/span_1000/800725B8.c.o(.bss .sbss COMMON);
        src/span_1000/800725C8.c.o(.bss .sbss COMMON);
        src/span_1000/80072630.c.o(.bss .sbss COMMON);
        src/span_1000/80072678.c.o(.bss .sbss COMMON);
        src/span_1000/80072698.c.o(.bss .sbss COMMON);
        src/span_1000/80072700.c.o(.bss .sbss COMMON);
        src/span_1000/80072780.c.o(.bss .sbss COMMON);
        src/span_1000/80072884.c.o(.bss .sbss COMMON);
        src/span_1000/800728B0.c.o(.bss .sbss COMMON);
        src/span_1000/80072908.c.o(.bss .sbss COMMON);
        src/span_1000/80072A48.c.o(.bss .sbss COMMON);
        src/span_1000/80072A80.c.o(.bss .sbss COMMON);
        src/span_1000/80072A90.c.o(.bss .sbss COMMON);
        src/span_1000/80072B24.c.o(.bss .sbss COMMON);
        src/span_1000/80072C78.c.o(.bss .sbss COMMON);
        src/span_1000/80072CD0.c.o(.bss .sbss COMMON);
        src/span_1000/80072CD8.c.o(.bss .sbss COMMON);
        src/span_1000/80072DA0.c.o(.bss .sbss COMMON);
        src/span_1000/80073020.c.o(.bss .sbss COMMON);
        src/span_1000/80073050.c.o(.bss .sbss COMMON);
        src/span_1000/80073098.c.o(.bss .sbss COMMON);
        src/span_1000/800730B0.c.o(.bss .sbss COMMON);
        src/span_1000/800730E0.c.o(.bss .sbss COMMON);
        src/game/sys_80076000/code_800AB91C.c.o(.bss .sbss COMMON);
        src/span_1000/80073128.c.o(.bss .sbss COMMON);
        src/span_1000/80073168.c.o(.bss .sbss COMMON);
        src/span_1000/80073180.c.o(.bss .sbss COMMON);
        src/span_1000/800731B0.c.o(.bss .sbss COMMON);
        src/game/sys_80076000/code_800B1520.c.o(.bss .sbss COMMON);
        src/span_1000/800733B4.c.o(.bss .sbss COMMON);
        src/game/sys_80076000/code_800B8750.c.o(.bss .sbss COMMON);
        src/span_1000/80073400.c.o(.bss .sbss COMMON);
        src/game/sys_80076000/code_800BC448.c.o(.bss .sbss COMMON);
        src/span_1000/80073470.c.o(.bss .sbss COMMON);
        src/game/sys_80076000/code_800BFF68.c.o(.bss .sbss COMMON);
        src/span_1000/80073500.c.o(.bss .sbss COMMON);
        src/game/sys_80076000/code_800C3730.c.o(.bss .sbss COMMON);
        src/span_1000/800735A0.c.o(.bss .sbss COMMON);
        src/span_1000/80073698.c.o(.bss .sbss COMMON);
        src/span_1000/80073710.c.o(.bss .sbss COMMON);
        src/span_1000/800737C0.c.o(.bss .sbss COMMON);
        src/game/sys_80076000/code_800CE214.c.o(.bss .sbss COMMON);
        src/span_1000/800738F0.c.o(.bss .sbss COMMON);
        src/span_1000/80073B88.c.o(.bss .sbss COMMON);
        src/span_1000/80073BE8.c.o(.bss .sbss COMMON);
        src/span_1000/80073C18.c.o(.bss .sbss COMMON);
        src/span_1000/80073C64.c.o(.bss .sbss COMMON);
        src/span_1000/80073C70.c.o(.bss .sbss COMMON);
        src/span_1000/80073C80.c.o(.bss .sbss COMMON);
        src/game/sys_80076000/code_800D1EBC.c.o(.bss .sbss COMMON);
        src/span_1000/80073D48.c.o(.bss .sbss COMMON);
        src/span_1000/80073EF8.c.o(.bss .sbss COMMON);
        src/span_1000/800740AC.c.o(.bss .sbss COMMON);
        src/span_1000/80074130.c.o(.bss .sbss COMMON);
        src/span_1000/80074268.c.o(.bss .sbss COMMON);
        src/span_1000/800742E4.c.o(.bss .sbss COMMON);
        src/span_1000/8007438C.c.o(.bss .sbss COMMON);
        src/game/sys_80076000/code_800DF214.c.o(.bss .sbss COMMON);
        src/game/sys_80076000/code_800E0B00.c.o(.bss .sbss COMMON);
        src/span_1000/800744D0.c.o(.bss .sbss COMMON);
        src/span_1000/800744E0.c.o(.bss .sbss COMMON);
        src/span_1000/80074500.c.o(.bss .sbss COMMON);
        src/game/sys_80076000/code_800E2ACC.c.o(.bss .sbss COMMON);
        src/span_1000/80074650.c.o(.bss .sbss COMMON);
        src/span_1000/80074668.c.o(.bss .sbss COMMON);
        src/game/sys_80076000/code_800E6C14.c.o(.bss .sbss COMMON);
        src/game/sys_80076000/code_800E6CA4.c.o(.bss .sbss COMMON);
        src/game/sys_80076000/code_800E76D0.c.o(.bss .sbss COMMON);
        src/game/sys_80076000/code_800E867C.c.o(.bss .sbss COMMON);
        src/game/sys_80076000/code_800E86C8.c.o(.bss .sbss COMMON);
        src/game/sys_80076000/code_800E8740.c.o(.bss .sbss COMMON);
        src/game/sys_80076000/code_800E8DFC.c.o(.bss .sbss COMMON);
        src/game/sys_80076000/code_800E92F0.c.o(.bss .sbss COMMON);
        src/game/sys_80076000/code_800E9538.c.o(.bss .sbss COMMON);
        src/span_1000/800748E4.c.o(.bss .sbss COMMON);
        src/game/sys_80076000/code_800E9B9C.c.o(.bss .sbss COMMON);
        src/game/sys_80076000/code_800E9DA4.c.o(.bss .sbss COMMON);
        src/game/sys_80076000/code_800EC3F0.c.o(.bss .sbss COMMON);
        src/span_1000/800749F0.c.o(.bss .sbss COMMON);
        src/span_1000/80074A08.c.o(.bss .sbss COMMON);
        src/span_1000/80074B30.c.o(.bss .sbss COMMON);
        src/span_1000/80074B40.c.o(.bss .sbss COMMON);
        src/span_1000/80074B58.c.o(.bss .sbss COMMON);
        src/span_1000/80074B68.c.o(.bss .sbss COMMON);
        src/span_1000/80074BB8.c.o(.bss .sbss COMMON);
        src/span_1000/80074BC8.c.o(.bss .sbss COMMON);
        src/span_1000/80074C20.c.o(.bss .sbss COMMON);
        src/span_1000/80074C74.c.o(.bss .sbss COMMON);
        src/game/sys_80076000/code_800F0738.c.o(.bss .sbss COMMON);
        src/span_1000/80074DBC.c.o(.bss .sbss COMMON);
        src/span_1000/80074DF8.c.o(.bss .sbss COMMON);
        src/span_1000/80074E4C.c.o(.bss .sbss COMMON);
        src/span_1000/80074E70.c.o(.bss .sbss COMMON);
        src/span_1000/80074ED4.c.o(.bss .sbss COMMON);
        src/game/sys_80076000/code_800F3490.c.o(.bss .sbss COMMON);
        src/game/sys_80076000/code_800F3880.c.o(.bss .sbss COMMON);
        src/span_1000/80074F50.c.o(.bss .sbss COMMON);
        src/span_1000/80074F60.c.o(.bss .sbss COMMON);
        src/span_1000/80074FCC.c.o(.bss .sbss COMMON);
        src/span_1000/80075000.c.o(.bss .sbss COMMON);
        src/span_1000/80075090.c.o(.bss .sbss COMMON);
        src/span_1000/800750A8.c.o(.bss .sbss COMMON);
        src/span_1000/80075420.c.o(.bss .sbss COMMON);
        src/game/sys_80076000/code_8010AA6C.c.o(.bss .sbss COMMON);
        src/game/sys_80076000/code_8010BC08.c.o(.bss .sbss COMMON);
        src/span_1000/80075510.c.o(.bss .sbss COMMON);
        src/game/sys_80076000/code_8010BDA0.c.o(.bss .sbss COMMON);
        src/game/sys_80076000/code_8010BEFC.c.o(.bss .sbss COMMON);
        src/span_1000/80075564.c.o(.bss .sbss COMMON);
        src/span_1000/800755B0.c.o(.bss .sbss COMMON);
        src/span_1000/800755C0.c.o(.bss .sbss COMMON);
        src/span_1000/80075614.c.o(.bss .sbss COMMON);
        src/game/sys_80076000/code_8010DF90.c.o(.bss .sbss COMMON);
        src/span_1000/80075930.c.o(.bss .sbss COMMON);
        src/span_1000/80075958.c.o(.bss .sbss COMMON);
        src/span_1000/80075980.c.o(.bss .sbss COMMON);
        src/span_1000/800759F0.c.o(.bss .sbss COMMON);
        src/span_1000/80075A00.c.o(.bss .sbss COMMON);
        src/span_1000/80075A10.c.o(.bss .sbss COMMON);
        src/span_1000/80075A30.c.o(.bss .sbss COMMON);
        src/span_1000/80075C80.c.o(.bss .sbss COMMON);
        src/span_1000/80075D18.c.o(.bss .sbss COMMON);
        src/span_1000/80075D60.c.o(.bss .sbss COMMON);
        src/span_1000/80075D90.c.o(.bss .sbss COMMON);
        src/span_1000/80075DA0.c.o(.bss .sbss COMMON);
        src/span_1000/80075E30.c.o(.bss .sbss COMMON);
        src/span_1000/80075E58.c.o(.bss .sbss COMMON);
        src/span_1000/80075E70.c.o(.bss .sbss COMMON);
        src/span_1000/80075EA4.c.o(.bss .sbss COMMON);
        src/span_1000/80075EC4.c.o(.bss .sbss COMMON);
        src/span_1000/80075FA0.c.o(.bss .sbss COMMON);
        src/span_1000/80075FE8.c.o(.bss .sbss COMMON);
        src/span_1000/80075FF8.c.o(.bss .sbss COMMON);
        src/game/sys_80076000/code_80076000.c.o(.bss .sbss COMMON);
        src/span_1000/80077098.c.o(.bss .sbss COMMON);
        src/game/sys_80076000/code_80077110.c.o(.bss .sbss COMMON);
        src/game/sys_80076000/code_80077B10.c.o(.bss .sbss COMMON);
        src/span_1000/800795A8.c.o(.bss .sbss COMMON);
        src/game/sys_80076000/code_800795B0.c.o(.bss .sbss COMMON);
        src/game/sys_80076000/code_8007961C.c.o(.bss .sbss COMMON);
        src/game/sys_80076000/code_8007967C.c.o(.bss .sbss COMMON);
        src/game/sys_80076000/code_800796B4.c.o(.bss .sbss COMMON);
        src/game/sys_80076000/code_800798C0.c.o(.bss .sbss COMMON);
        src/game/sys_80076000/code_800799C0.c.o(.bss .sbss COMMON);
        src/game/sys_80076000/code_80079A5C.c.o(.bss .sbss COMMON);
        src/game/sys_80076000/code_80079BB4.c.o(.bss .sbss COMMON);
        src/game/sys_80076000/code_80079BF4.c.o(.bss .sbss COMMON);
        src/game/sys_80076000/code_80079D58.c.o(.bss .sbss COMMON);
        src/game/sys_80076000/code_80079D9C.c.o(.bss .sbss COMMON);
        src/game/sys_80076000/code_80079EFC.c.o(.bss .sbss COMMON);
        src/game/sys_80076000/code_8007A470.c.o(.bss .sbss COMMON);
        src/game/sys_80076000/code_8007A5A4.c.o(.bss .sbss COMMON);
        src/game/sys_80076000/code_8007A758.c.o(.bss .sbss COMMON);
        src/game/sys_80076000/code_8007A79C.c.o(.bss .sbss COMMON);
        src/game/sys_80076000/code_8007A968.c.o(.bss .sbss COMMON);
        src/game/sys_80076000/code_8007AA70.c.o(.bss .sbss COMMON);
        src/game/sys_80076000/code_8007AC20.c.o(.bss .sbss COMMON);
        src/game/sys_80076000/code_8007ACC4.c.o(.bss .sbss COMMON);
        src/span_1000/8007D42C.c.o(.bss .sbss COMMON);
        src/game/sys_80076000/code_8007D430.c.o(.bss .sbss COMMON);
        src/game/sys_80076000/code_8007E140.c.o(.bss .sbss COMMON);
        src/span_1000/8008633C.c.o(.bss .sbss COMMON);
        src/game/sys_80076000/code_80086378.c.o(.bss .sbss COMMON);
        src/span_1000/8008AD0C.c.o(.bss .sbss COMMON);
        src/game/sys_80076000/code_8008AD10.c.o(.bss .sbss COMMON);
        src/span_1000/8008EC78.c.o(.bss .sbss COMMON);
        src/game/sys_80076000/code_8008EC80.c.o(.bss .sbss COMMON);
        src/span_1000/80090ED8.c.o(.bss .sbss COMMON);
        src/game/sys_80076000/code_80090EE0.c.o(.bss .sbss COMMON);
        src/game/sys_80076000/code_800917C4.c.o(.bss .sbss COMMON);
        src/game/sys_80076000/code_80093D30.c.o(.bss .sbss COMMON);
        src/game/sys_80076000/code_80094060.c.o(.bss .sbss COMMON);
        src/game/sys_80076000/code_800949B8.c.o(.bss .sbss COMMON);
        src/game/sys_80076000/code_800949D8.c.o(.bss .sbss COMMON);
        src/game/sys_80076000/code_8009531C.c.o(.bss .sbss COMMON);
        src/game/sys_80076000/code_800953AC.c.o(.bss .sbss COMMON);
        src/game/sys_80076000/code_80095EAC.c.o(.bss .sbss COMMON);
        src/game/sys_80076000/code_80096760.c.o(.bss .sbss COMMON);
        src/game/sys_80076000/code_80096784.c.o(.bss .sbss COMMON);
        src/game/sys_80076000/code_80096834.c.o(.bss .sbss COMMON);
        src/game/sys_80076000/code_80096E80.c.o(.bss .sbss COMMON);
        src/game/sys_80076000/code_80097C24.c.o(.bss .sbss COMMON);
        src/game/sys_80076000/code_80097C64.c.o(.bss .sbss COMMON);
        src/game/sys_80076000/code_8009E39C.c.o(.bss .sbss COMMON);
        src/game/sys_80076000/code_8009E3A4.c.o(.bss .sbss COMMON);
        src/game/sys_80076000/code_8009FB8C.c.o(.bss .sbss COMMON);
        src/game/sys_80076000/code_800A0400.c.o(.bss .sbss COMMON);
        src/game/sys_80076000/code_800A1170.c.o(.bss .sbss COMMON);
        src/game/sys_80076000/code_800A3070.c.o(.bss .sbss COMMON);
        src/game/sys_80076000/code_800A30A8.c.o(.bss .sbss COMMON);
        src/game/sys_80076000/code_800A42BC.c.o(.bss .sbss COMMON);
        src/game/sys_80076000/code_800A42C4.c.o(.bss .sbss COMMON);
        src/game/sys_80076000/code_800A4D10.c.o(.bss .sbss COMMON);
        src/game/sys_80076000/code_800A4D34.c.o(.bss .sbss COMMON);
        src/game/sys_80076000/code_800A5FF0.c.o(.bss .sbss COMMON);
        src/game/sys_80076000/code_800A6798.c.o(.bss .sbss COMMON);
        src/game/sys_80076000/code_800A7650.c.o(.bss .sbss COMMON);
        src/game/sys_80076000/code_800A76A0.c.o(.bss .sbss COMMON);
        src/game/sys_80076000/code_800A76BC.c.o(.bss .sbss COMMON);
        src/game/sys_80076000/code_800A7ABC.c.o(.bss .sbss COMMON);
        src/game/sys_80076000/code_800A841C.c.o(.bss .sbss COMMON);
        src/game/sys_80076000/code_800A8940.c.o(.bss .sbss COMMON);
        src/game/sys_80076000/code_800A9C20.c.o(.bss .sbss COMMON);
        src/game/sys_80076000/code_800A9CC4.c.o(.bss .sbss COMMON);
        src/game/sys_80076000/code_800A9D40.c.o(.bss .sbss COMMON);
        src/game/sys_80076000/code_800A9DA8.c.o(.bss .sbss COMMON);
        src/game/sys_80076000/code_800A9EE0.c.o(.bss .sbss COMMON);
        src/game/sys_80076000/code_800A9F80.c.o(.bss .sbss COMMON);
        src/game/sys_80076000/code_800AA168.c.o(.bss .sbss COMMON);
        src/game/sys_80076000/code_800AA280.c.o(.bss .sbss COMMON);
        src/game/sys_80076000/code_800AA518.c.o(.bss .sbss COMMON);
        src/game/sys_80076000/code_800AB200.c.o(.bss .sbss COMMON);
        src/game/sys_80076000/code_800AB520.c.o(.bss .sbss COMMON);
        src/game/sys_80076000/code_800AB614.c.o(.bss .sbss COMMON);
        src/game/sys_80076000/code_800AB65C.c.o(.bss .sbss COMMON);
        src/game/sys_80076000/code_800B850C.c.o(.bss .sbss COMMON);
        src/game/sys_80076000/code_800B9C0C.c.o(.bss .sbss COMMON);
        src/game/sys_80076000/code_800B9C34.c.o(.bss .sbss COMMON);
        src/game/sys_80076000/code_800BC214.c.o(.bss .sbss COMMON);
        src/game/sys_80076000/code_800BD1F0.c.o(.bss .sbss COMMON);
        src/game/sys_80076000/code_800C0880.c.o(.bss .sbss COMMON);
        src/game/sys_80076000/code_800C54F0.c.o(.bss .sbss COMMON);
        src/game/sys_80076000/code_800C5B90.c.o(.bss .sbss COMMON);
        src/span_1000/800D0D28.c.o(.bss .sbss COMMON);
        src/game/sys_80076000/code_800D0D30.c.o(.bss .sbss COMMON);
        src/game/sys_80076000/code_800D153C.c.o(.bss .sbss COMMON);
        src/span_1000/800D9074.c.o(.bss .sbss COMMON);
        src/game/sys_80076000/code_800D9080.c.o(.bss .sbss COMMON);
        src/game/sys_80076000/code_800DD970.c.o(.bss .sbss COMMON);
        src/game/sys_80076000/code_800DDC60.c.o(.bss .sbss COMMON);
        src/span_1000/800E1A14.c.o(.bss .sbss COMMON);
        src/game/sys_80076000/code_800E1A20.c.o(.bss .sbss COMMON);
        src/game/sys_80076000/code_800E3C18.c.o(.bss .sbss COMMON);
        src/game/sys_80076000/code_800E3C34.c.o(.bss .sbss COMMON);
        src/game/sys_80076000/code_800E4820.c.o(.bss .sbss COMMON);
        src/game/sys_80076000/code_800E52A0.c.o(.bss .sbss COMMON);
        src/game/sys_80076000/code_800E6C5C.c.o(.bss .sbss COMMON);
        src/game/sys_80076000/code_800E6C80.c.o(.bss .sbss COMMON);
        src/game/sys_80076000/code_800E95A8.c.o(.bss .sbss COMMON);
        src/game/sys_80076000/code_800E97F0.c.o(.bss .sbss COMMON);
        src/game/sys_80076000/code_800E9880.c.o(.bss .sbss COMMON);
        src/game/sys_80076000/code_800E9894.c.o(.bss .sbss COMMON);
        src/game/sys_80076000/code_800E99D4.c.o(.bss .sbss COMMON);
        src/game/sys_80076000/code_800E99E0.c.o(.bss .sbss COMMON);
        src/span_1000/800EABA8.c.o(.bss .sbss COMMON);
        src/game/sys_80076000/code_800EABB0.c.o(.bss .sbss COMMON);
        src/span_1000/800ECC04.c.o(.bss .sbss COMMON);
        src/game/sys_80076000/code_800ECC1C.c.o(.bss .sbss COMMON);
        src/game/sys_80076000/code_800EDB20.c.o(.bss .sbss COMMON);
        src/game/sys_80076000/code_800EF2D0.c.o(.bss .sbss COMMON);
        src/game/sys_80076000/code_800F01D0.c.o(.bss .sbss COMMON);
        src/span_1000/800F2004.c.o(.bss .sbss COMMON);
        src/game/sys_80076000/code_800F2010.c.o(.bss .sbss COMMON);
        src/game/sys_80076000/code_800F3A14.c.o(.bss .sbss COMMON);
        src/game/sys_80076000/code_800F3AE0.c.o(.bss .sbss COMMON);
        src/game/sys_80076000/code_800F45C8.c.o(.bss .sbss COMMON);
        src/game/sys_80076000/code_800F5128.c.o(.bss .sbss COMMON);
        src/game/sys_80076000/code_8010527C.c.o(.bss .sbss COMMON);
        src/game/sys_80076000/code_801053B0.c.o(.bss .sbss COMMON);
        src/game/sys_80076000/code_801054C0.c.o(.bss .sbss COMMON);
        src/game/sys_80076000/code_8010552C.c.o(.bss .sbss COMMON);
        src/game/sys_80076000/code_80105750.c.o(.bss .sbss COMMON);
        src/game/sys_80076000/code_80105C68.c.o(.bss .sbss COMMON);
        src/game/sys_80076000/code_80105D90.c.o(.bss .sbss COMMON);
        src/game/sys_80076000/code_80106B28.c.o(.bss .sbss COMMON);
        src/game/sys_80076000/code_80106B60.c.o(.bss .sbss COMMON);
        src/span_1000/8010CB5C.c.o(.bss .sbss COMMON);
        src/game/sys_80076000/code_8010CB60.c.o(.bss .sbss COMMON);
        src/game/sys_80076000/code_8010D850.c.o(.bss .sbss COMMON);
        src/span_1000/8010E158.c.o(.bss .sbss COMMON);
        src/sdk/libultra/code_80110480.c.o(.bss .sbss COMMON);
        src/sdk/libultra/code_80110490.c.o(.bss .sbss COMMON);
        src/sdk/libultra/bcopy.s.o(.bss .sbss COMMON);
        src/sdk/libultra/code_801106A0.c.o(.bss .sbss COMMON);
        src/sdk/libultra/code_80110C00.c.o(.bss .sbss COMMON);
        src/sdk/libultra/code_80110CA0.c.o(.bss .sbss COMMON);
        src/sdk/libultra/code_80110CA0_80110D24.c.o(.bss .sbss COMMON);
        src/sdk/libultra/code_80110D50.c.o(.bss .sbss COMMON);
        src/sdk/libultra/code_80110FE0.c.o(.bss .sbss COMMON);
        src/sdk/libm/code_801113A0.c.o(.bss .sbss COMMON);
        src/sdk/libultra/code_80111510.c.o(.bss .sbss COMMON);
        src/sdk/libultra/code_80111540.c.o(.bss .sbss COMMON);
        src/sdk/libultra/__osException.s.o(.bss .sbss COMMON);
        src/sdk/libultra/code_80111690.c.o(.bss .sbss COMMON);
        src/sdk/libultra/__osEnqueueAndYield.s.o(.bss .sbss COMMON);
        src/sdk/libultra/code_80111DBC.c.o(.bss .sbss COMMON);
        src/sdk/libultra/code_80111FA0.c.o(.bss .sbss COMMON);
        src/sdk/libultra/code_801120A0.c.o(.bss .sbss COMMON);
        src/sdk/libgultra/osGetCount.s.o(.bss .sbss COMMON);
        src/sdk/libultra/code_80112140.c.o(.bss .sbss COMMON);
        src/sdk/libultra/code_801121A0.c.o(.bss .sbss COMMON);
        src/sdk/libultra/code_801121E0.c.o(.bss .sbss COMMON);
        src/sdk/libgultra/__osGetSR.s.o(.bss .sbss COMMON);
        src/sdk/libgultra/__osDisableInt.s.o(.bss .sbss COMMON);
        src/sdk/libgultra/__osRestoreInt.s.o(.bss .sbss COMMON);
        src/sdk/libultra/osInvalDCache.s.o(.bss .sbss COMMON);
        src/sdk/libultra/osInvalICache.s.o(.bss .sbss COMMON);
        src/sdk/libultra/code_801125F0.c.o(.bss .sbss COMMON);
        src/sdk/libultra/code_80112E70.c.o(.bss .sbss COMMON);
        src/sdk/libultra/code_801130A0.c.o(.bss .sbss COMMON);
        src/sdk/libultra/code_801131A0.c.o(.bss .sbss COMMON);
        src/sdk/libultra/code_80113460.c.o(.bss .sbss COMMON);
        src/sdk/libultra/osMapTLBRdb.s.o(.bss .sbss COMMON);
        src/sdk/libultra/code_801137F0.c.o(.bss .sbss COMMON);
        src/sdk/libultra/code_80113E10.c.o(.bss .sbss COMMON);
        src/sdk/libultra/code_80114520.c.o(.bss .sbss COMMON);
        src/sdk/libultra/code_80114520_801145D0.c.o(.bss .sbss COMMON);
        src/sdk/libultra/code_80114520_801146A0.c.o(.bss .sbss COMMON);
        src/sdk/libultra/code_80114520_801147A0.c.o(.bss .sbss COMMON);
        src/sdk/libultra/code_80114520_80114858.c.o(.bss .sbss COMMON);
        src/sdk/libultra/code_80114970.c.o(.bss .sbss COMMON);
        src/sdk/libultra/code_80114C00.c.o(.bss .sbss COMMON);
        src/sdk/libultra/code_801153B0.c.o(.bss .sbss COMMON);
        src/sdk/libultra/code_801153B0_80115474.c.o(.bss .sbss COMMON);
        src/sdk/libultra/code_801153B0_80115A24.c.o(.bss .sbss COMMON);
        src/sdk/libultra/code_801153B0_80115C80.c.o(.bss .sbss COMMON);
        src/sdk/libultra/code_801153B0_80115D7C.c.o(.bss .sbss COMMON);
        src/sdk/libultra/code_80116110.c.o(.bss .sbss COMMON);
        src/sdk/libultra/code_80116720.c.o(.bss .sbss COMMON);
        src/sdk/libultra/code_80116B60.c.o(.bss .sbss COMMON);
        src/sdk/libultra/code_80116C70.c.o(.bss .sbss COMMON);
        src/sdk/libultra/code_80116EE0.c.o(.bss .sbss COMMON);
        src/sdk/libultra/code_80117CB0.c.o(.bss .sbss COMMON);
        src/sdk/libultra/code_801181B0.c.o(.bss .sbss COMMON);
        src/sdk/libultra/code_80118410.c.o(.bss .sbss COMMON);
        src/sdk/libultra/code_801185D0.c.o(.bss .sbss COMMON);
        src/sdk/libultra/code_801186E0.c.o(.bss .sbss COMMON);
        src/sdk/libultra/code_80118860.c.o(.bss .sbss COMMON);
        src/sdk/libultra/code_801189F0.c.o(.bss .sbss COMMON);
        src/sdk/libultra/code_80118AF0.c.o(.bss .sbss COMMON);
        src/sdk/libultra/code_80119020.c.o(.bss .sbss COMMON);
        src/sdk/libultra/code_80119040.c.o(.bss .sbss COMMON);
        src/sdk/libultra/code_80119240.c.o(.bss .sbss COMMON);
        src/sdk/libultra/code_80119380.c.o(.bss .sbss COMMON);
        src/sdk/libultra/code_801193E0.c.o(.bss .sbss COMMON);
        src/sdk/libultra/code_80119530.c.o(.bss .sbss COMMON);
        src/sdk/libultra/code_80119530_8011954C.c.o(.bss .sbss COMMON);
        src/sdk/libultra/code_80119530_80119578.c.o(.bss .sbss COMMON);
        src/sdk/libultra/code_80119B60.c.o(.bss .sbss COMMON);
        src/sdk/libultra/code_80119B60_80119C34.c.o(.bss .sbss COMMON);
        src/sdk/libultra/code_80119B60_80119CE8.c.o(.bss .sbss COMMON);
        src/sdk/libultra/code_80119B60_80119D14.c.o(.bss .sbss COMMON);
        src/sdk/libultra/code_80119B60_80119F70.c.o(.bss .sbss COMMON);
        src/sdk/libultra/code_80119B60_80119FE0.c.o(.bss .sbss COMMON);
        src/sdk/libultra/code_80119B60_8011A134.c.o(.bss .sbss COMMON);
        src/sdk/libultra/code_80119B60_8011A17C.c.o(.bss .sbss COMMON);
        src/sdk/libultra/code_8011B4A0.c.o(.bss .sbss COMMON);
        src/sdk/libultra/code_8011B4A0_8011B7BC.c.o(.bss .sbss COMMON);
        src/sdk/libultra/code_8011B4A0_8011B830.c.o(.bss .sbss COMMON);
        src/sdk/libultra/code_8011B8B0.c.o(.bss .sbss COMMON);
        src/sdk/libultra/code_8011B8F0.c.o(.bss .sbss COMMON);
        src/sdk/libultra/code_8011B920.c.o(.bss .sbss COMMON);
        src/sdk/libultra/code_8011B960.c.o(.bss .sbss COMMON);
        src/sdk/libultra/code_8011B9A0.c.o(.bss .sbss COMMON);
        src/sdk/libultra/code_8011B9E0.c.o(.bss .sbss COMMON);
        src/sdk/libultra/code_8011BA10.c.o(.bss .sbss COMMON);
        src/sdk/libultra/__osSetFpcCsr.s.o(.bss .sbss COMMON);
        src/sdk/libultra/code_8011BA90.c.o(.bss .sbss COMMON);
        src/sdk/libultra/osSetIntMask.s.o(.bss .sbss COMMON);
        src/sdk/libultra/__osSetSR.s.o(.bss .sbss COMMON);
        src/sdk/libultra/code_8011BB90.c.o(.bss .sbss COMMON);
        src/sdk/libultra/code_8011BD50.c.o(.bss .sbss COMMON);
        src/sdk/libultra/code_8011BDE4.c.o(.bss .sbss COMMON);
        src/sdk/libultra/code_8011BE10.c.o(.bss .sbss COMMON);
        src/sdk/libultra/code_8011C080.c.o(.bss .sbss COMMON);
        src/sdk/libultra/code_8011C0B0.c.o(.bss .sbss COMMON);
        src/sdk/libultra/code_8011C150.c.o(.bss .sbss COMMON);
        src/sdk/libultra/code_8011C210.c.o(.bss .sbss COMMON);
        src/sdk/libultra/code_8011C2B0.c.o(.bss .sbss COMMON);
        src/sdk/libultra/code_8011C300.c.o(.bss .sbss COMMON);
        src/sdk/libultra/code_8011C320.c.o(.bss .sbss COMMON);
        src/sdk/libultra/code_8011CA30.c.o(.bss .sbss COMMON);
        src/sdk/libultra/code_8011CAA0.c.o(.bss .sbss COMMON);
        src/sdk/libultra/code_8011CB00.c.o(.bss .sbss COMMON);
        src/sdk/libultra/code_8011CB60.c.o(.bss .sbss COMMON);
        src/sdk/libultra/code_8011CBB0.c.o(.bss .sbss COMMON);
        src/sdk/libultra/code_8011CC10.c.o(.bss .sbss COMMON);
        src/sdk/libultra/code_8011CC60.c.o(.bss .sbss COMMON);
        src/sdk/libultra/code_8011CCE0.c.o(.bss .sbss COMMON);
        src/sdk/libultra/code_8011CFD0.c.o(.bss .sbss COMMON);
        src/sdk/libultra/code_8011D000.c.o(.bss .sbss COMMON);
        src/sdk/libultra/code_8011D090.c.o(.bss .sbss COMMON);
        src/sdk/libultra/code_8011D0D0.c.o(.bss .sbss COMMON);
        src/sdk/libultra/code_8011D0D0_8011D0E0.c.o(.bss .sbss COMMON);
        src/sdk/libultra/code_8011D0D0_8011D180.c.o(.bss .sbss COMMON);
        src/sdk/libm/code_8011D190.c.o(.bss .sbss COMMON);
        src/sdk/libultra/code_8011D1A0.c.o(.bss .sbss COMMON);
        src/sdk/libultra/code_8011D1A0_8011D3DC.c.o(.bss .sbss COMMON);
        src/sdk/libultra/code_8011D1A0_8011D404.c.o(.bss .sbss COMMON);
        src/sdk/libultra/code_8011D450.c.o(.bss .sbss COMMON);
        src/sdk/libultra/code_8011D6D0.c.o(.bss .sbss COMMON);
        src/sdk/libultra/code_8011D6E0.c.o(.bss .sbss COMMON);
        src/sdk/libultra/code_8011D830.c.o(.bss .sbss COMMON);
        src/sdk/libultra/code_8011D8C0.c.o(.bss .sbss COMMON);
        src/sdk/libultra/code_8011D950.c.o(.bss .sbss COMMON);
        src/sdk/libultra/code_8011DA00.c.o(.bss .sbss COMMON);
        src/sdk/libultra/code_8011DA90.c.o(.bss .sbss COMMON);
        src/sdk/libultra/code_8011DB80.c.o(.bss .sbss COMMON);
        src/sdk/libultra/code_8011DC00.c.o(.bss .sbss COMMON);
        src/sdk/libultra/code_8011E3F0.c.o(.bss .sbss COMMON);
        src/sdk/libultra/code_8011E3F0_8011E4DC.c.o(.bss .sbss COMMON);
        src/sdk/libultra/code_8011E3F0_8011E564.c.o(.bss .sbss COMMON);
        src/sdk/libultra/code_8011E3F0_8011E60C.c.o(.bss .sbss COMMON);
        src/sdk/libultra/code_8011EB90.c.o(.bss .sbss COMMON);
        src/sdk/libultra/code_8011EBB8.c.o(.bss .sbss COMMON);
        src/sdk/libultra/code_8011ECA4.c.o(.bss .sbss COMMON);
        src/sdk/libultra/code_8011ED84.c.o(.bss .sbss COMMON);
        src/sdk/libultra/code_8011F7F0.c.o(.bss .sbss COMMON);
        src/span_1000/8011F80C.c.o(.bss .sbss COMMON);
        src/sdk/libultra/code_8011F810.c.o(.bss .sbss COMMON);
        src/sdk/libultra/code_8011FD90.c.o(.bss .sbss COMMON);
        src/sdk/libultra/code_80120360.c.o(.bss .sbss COMMON);
        src/sdk/libultra/code_801207B0.c.o(.bss .sbss COMMON);
        src/sdk/libultra/code_80121400.c.o(.bss .sbss COMMON);
        src/sdk/libultra/code_80121560.c.o(.bss .sbss COMMON);
        src/sdk/libultra/__osSetCompare.s.o(.bss .sbss COMMON);
        src/sdk/libultra/code_801219B0.c.o(.bss .sbss COMMON);
        src/sdk/libultra/code_80121B60.c.o(.bss .sbss COMMON);
        src/sdk/libultra/code_80121F00.c.o(.bss .sbss COMMON);
        src/sdk/libultra/code_80121F10.c.o(.bss .sbss COMMON);
        src/span_1000/80121F8C.c.o(.bss .sbss COMMON);
        src/sdk/libultra/__osProbeTLB.s.o(.bss .sbss COMMON);
        src/sdk/libultra/code_80122050.c.o(.bss .sbss COMMON);
        src/sdk/libultra/code_801220C0.c.o(.bss .sbss COMMON);
        src/sdk/libultra/code_80122130.c.o(.bss .sbss COMMON);
        src/sdk/libultra/code_801222F0.c.o(.bss .sbss COMMON);
        src/sdk/libultra/osWritebackDCache.s.o(.bss .sbss COMMON);
        src/sdk/libgultra/osWritebackDCacheAll.s.o(.bss .sbss COMMON);
        src/sdk/libultra/code_80122750.c.o(.bss .sbss COMMON);
        src/sdk/libultra/code_80123410.c.o(.bss .sbss COMMON);
        src/sdk/libultra/code_80123ED0.c.o(.bss .sbss COMMON);
        src/sdk/libultra/code_80124060.c.o(.bss .sbss COMMON);
        src/sdk/libultra/code_80124300.c.o(.bss .sbss COMMON);
        src/sdk/libgcc/code_80124350.c.o(.bss .sbss COMMON);
        src/sdk/libgcc/code_80124940.c.o(.bss .sbss COMMON);
        src/sdk/libgcc/code_80124EC0.c.o(.bss .sbss COMMON);
        src/sdk/libgcc/code_80125450.c.o(.bss .sbss COMMON);
        src/sdk/libgcc/code_801254A0.c.o(.bss .sbss COMMON);
        src/span_1000/80125F14.c.o(.bss .sbss COMMON);
        src/span_1000/80125F30.c.o(.bss .sbss COMMON);
        src/span_1000/80125FDC.c.o(.bss .sbss COMMON);
        src/span_1000/80126708.c.o(.bss .sbss COMMON);
        src/span_1000/80132EF0.c.o(.bss .sbss COMMON);
        src/span_1000/80133E7C.c.o(.bss .sbss COMMON);
        src/span_1000/80133FD4.c.o(.bss .sbss COMMON);
        src/span_1000/80134FB4.c.o(.bss .sbss COMMON);
        src/span_1000/80135060.c.o(.bss .sbss COMMON);
        src/span_1000/801351EC.c.o(.bss .sbss COMMON);
        src/span_1000/80135698.c.o(.bss .sbss COMMON);
        src/span_1000/8013578C.c.o(.bss .sbss COMMON);
        src/span_1000/8013587C.c.o(.bss .sbss COMMON);
        src/span_1000/801395BC.c.o(.bss .sbss COMMON);
        src/span_1000/80142CB0.c.o(.bss .sbss COMMON);
        src/span_1000/80147008.c.o(.bss .sbss COMMON);
        src/span_1000/80147038.c.o(.bss .sbss COMMON);
    }
    .retained_D7040 0x000D7040 : AT(0xD7040) SUBALIGN(1)
    {
        assets/retained_D7040.bin.o(.data);
    }
    /DISCARD/ : { *(.MIPS.abiflags .reginfo .pdr .mdebug* .options .debug* .comment .note* .gnu.attributes) }
}
INCLUDE undefined_syms.ld
